## CMakeLists.txt
```
cmake_minimum_required(VERSION 3.20.0)
find_package(Zephyr REQUIRED HINTS $ENV{ZEPHYR_BASE})
project(data)

FILE(GLOB app_sources src/stubs.cpp
                      src/test_flashfs.cpp
)
target_sources(app PRIVATE ${app_sources}
	../../common/src/fs/flashfs.cpp
)


zephyr_include_directories(../../include)
zephyr_include_directories(../../common/src)
#zephyr_include_directories(../../app-axo-x1/src)

zephyr_compile_options(-Wno-pointer-arith -Wno-unused-variable -Wno-psabi)
```

## prj.conf
```kconfig
CONFIG_ZTEST=y
CONFIG_ZTEST_NEW_API=y

CONFIG_MAIN_STACK_SIZE=8192
#4096

CONFIG_ZTEST_STACK_SIZE=65536
#32768

CONFIG_LOG=y
CONFIG_PRINTK=y
CONFIG_CPLUSPLUS=y
CONFIG_LIB_CPLUSPLUS=y
CONFIG_EXCEPTIONS=n
CONFIG_STD_CPP17=y
CONFIG_NEWLIB_LIBC=y
CONFIG_NEWLIB_LIBC_MIN_REQUIRED_HEAP_SIZE=4096

# disable assert macros
CONFIG_ASSERT=n
CONFIG_ASSERT_TEST=n

# memory usage
CONFIG_MEM_SLAB_TRACE_MAX_UTILIZATION=y 
CONFIG_SYS_HEAP_RUNTIME_STATS=y

CONFIG_HEAP_MEM_POOL_SIZE=16384

CONFIG_CBPRINTF_FP_SUPPORT=y

# CJSON
CONFIG_NEWLIB_LIBC_FLOAT_PRINTF=y
CONFIG_CJSON_LIB=y

CONFIG_NUM_COOP_PRIORITIES=10
CONFIG_NUM_PREEMPT_PRIORITIES=10
CONFIG_SCHED_SCALABLE=y

# Enable thread awareness for debugging tools supporting it
CONFIG_INIT_STACKS=y
CONFIG_THREAD_NAME=y
CONFIG_THREAD_STACK_INFO=y
CONFIG_THREAD_RUNTIME_STATS=y
CONFIG_THREAD_MONITOR=y
CONFIG_DEBUG_THREAD_INFO=y

#CONFIG_UNIT_TEST=y
CONFIG_UNIT_TEST_FS=y
CONFIG_COVERAGE=y
CONFIG_COVERAGE_DUMP=y
```

## src/stubs.cpp
```c
#define private public
#include "rtos/mbox.h"
#include "rtos/mpelem.h"
#include "rtos/mpool.h"
#include "rtos/mqueue.h"
#include "rtos/task.h"
#include "rtos/task.h"

//#include "bus/spi/spibus.h"
//#include "drv/spi/fram.h"
//#include "drv/spi/adxl37x.h"
#include "pm/reset_ctrl.h"
//#include "./version.h"


#include "stubs.h"


// -------------------------------------------------------------------------

bool gbRetVal;
int gIntVal;
char gBuf[1024];

int32_t mysleep(int32_t y) { return 0; }


int fs_open(struct fs_file_t *filp, const char *fs_path, fs_mode_t flags) {
    return gIntVal;
}
ssize_t fs_read(struct fs_file_t *filp, void *dest, size_t nbytes) {
    uint8_t* des = (uint8_t*)dest;
    des[0] = 1;
    des[1] = 2;
    des[2] = 1;
    des[3] = 3;
    des[4] = 1;
    return nbytes;
}
ssize_t fs_write(struct fs_file_t *filp, const void *src, size_t nbytes) {
    uint8_t* p8 = (uint8_t*)src;
    gBuf[0] = p8[0];
    gBuf[1] = p8[1];
    gBuf[2] = p8[2];
    return nbytes;
}
int fs_seek(struct fs_file_t *filp, off_t off, int whence) {
    return 0;
}
off_t fs_tell(struct fs_file_t *filp) {
    return 0;
}
int fs_truncate(struct fs_file_t *filp, off_t length) {
    return 0;
}
int fs_sync(struct fs_file_t *filp) {
    return 0;
}
int fs_close(struct fs_file_t *filp) {
    return 0;
}
int fs_opendir(struct fs_dir_t *dirp, const char *fs_path) {
    if (gIntVal == -7) {
        return gIntVal;
    }
    return 0;
}
int fs_readdir(struct fs_dir_t *dirp, struct fs_dirent *entry) {
    static int iPassed = 0;
    if (gbRetVal) {
        if (gIntVal == -7) {
            entry->name[0] = 0;
            return gIntVal;
        } else if (gIntVal == -6) {
            entry->name[0] = 'a';
            return gIntVal;
        } else if (gIntVal == 1) {
            entry->name[0] = 0;
            return gIntVal;
        } else if (gIntVal == 2) {
            entry->name[0] = 'a';
            entry->type = FS_DIR_ENTRY_DIR;
            //printk("fs_readdir: gIntVal = %d,  iPassed = %d, entry.type = %d\n\n", gIntVal, iPassed, entry->type);
            if (iPassed == 1) {
                entry->type = FS_DIR_ENTRY_FILE;
                //printk("fs_readdir: gIntVal = %d,  iPassed = %d, entry.type = %d\n\n", gIntVal, iPassed, entry->type);
                gIntVal = -7;
                iPassed = 0;
                return 0;
            } /*else if (iPassed == 2) {
                iPassed = 0;
                entry->name[0] = 0;
                //printk("fs_readdir: gIntVal = %d,  iPassed = %d, entry.type = %d\n\n", gIntVal, iPassed, entry->type);
                return 2;
            }*/
            iPassed++;
        } else if (gIntVal == 3) {
            entry->name[0] = 'a';
            entry->type = FS_DIR_ENTRY_DIR;
            if (iPassed == 2) {
                iPassed = 0;
                entry->name[0] = 0;
                gIntVal = 0;
                return 0;
            }
            iPassed++;
        } else if (gIntVal == 4) {
            entry->name[0] = 0;
            gIntVal = -7;
            return 0;
        } else if (gIntVal == 5) {
            entry->name[0] = 'a';
            entry->type = FS_DIR_ENTRY_DIR;
            //printk("fs_readdir: gIntVal = %d,  iPassed = %d, entry.type = %d\n\n", gIntVal, iPassed, entry->type);
            if (iPassed == 1) {
                iPassed = 0;
                entry->name[0] = 0;
                //printk("fs_readdir: gIntVal = %d,  iPassed = %d, entry.type = %d\n\n", gIntVal, iPassed, entry->type);
                return 2;
            }
            iPassed++;
        }
    } else {
        if (gIntVal == -17) {
            entry->name[0] = 0;
            return gIntVal;
        } else if (gIntVal == -16) {
            entry->name[0] = 'a';
            return gIntVal;
        } else if (gIntVal == 11) {
            entry->name[0] = 0;
            return 0;
        } else if (gIntVal == 12) {
            entry->name[0] = 'a';
            entry->type = FS_DIR_ENTRY_DIR;
            printk("fs_readdir: gIntVal = %d,  iPassed = %d, entry.type = %d\n\n", gIntVal, iPassed, entry->type);
            if (iPassed == 1) {
                entry->type = FS_DIR_ENTRY_FILE;
                printk("fs_readdir: gIntVal = %d,  iPassed = %d, entry.type = %d\n\n", gIntVal, iPassed, entry->type);
            } else if (iPassed == 2) {
                iPassed = 0;
                entry->name[0] = 0;
                printk("fs_readdir: gIntVal = %d,  iPassed = %d, entry.type = %d\n\n", gIntVal, iPassed, entry->type);
                return gIntVal;
            }
            iPassed++;
        } else if (gIntVal == 13) {
            entry->name[0] = 'a';
            entry->type = FS_DIR_ENTRY_FILE;
            gIntVal = 11;
        } else if (gIntVal == 14) {
            entry->name[0] = 'a';
            entry->type = FS_DIR_ENTRY_DIR;
            gbRetVal = true;
            gIntVal = 4;
        }
    }
    return 0;
}
int fs_closedir(struct fs_dir_t *dirp) {
    if (gIntVal == -7) {
        return 0;
    }
    return gIntVal;
}
int fs_mount(struct fs_mount_t *mountp) {
    return gIntVal;
}
int fs_unmount(struct fs_mount_t *mountp) {
    return gIntVal;
}
int fs_unlink(const char *name) {
    return 0;
}
int fs_rename(const char *from, const char *to) {
    return 0;
}
int fs_mkdir(const char *name) {
    return 0;
}
int fs_stat(const char *path, struct fs_dirent *entry) {
    return gIntVal;
}
int fs_statvfs(const char *path,struct fs_statvfs *stat) {
    stat->f_bfree = 0;
    stat->f_frsize = 0;
    if (gIntVal) {
        stat->f_bfree = 7;
        stat->f_frsize = 700;
    }
    return gIntVal;
}

void fs_file_t_init(struct fs_file_t *zfp) { }
void fs_dir_t_init(struct fs_dir_t *zdp) { }

int lfs_dir_rewind(lfs_t *lfs, lfs_dir_t *dir) {
    return 0;
}

lfs_soff_t lfs_file_size(lfs_t *lfs, lfs_file_t *file) {
    return gIntVal;
}

int lfs_dir_seek(lfs_t *lfs, lfs_dir_t *dir, lfs_off_t off) {
    return 0;
}
lfs_soff_t lfs_dir_tell(lfs_t *lfs, lfs_dir_t *dir) {
    return 0;
}


int flash_area_open(uint8_t id, const struct flash_area **fa) {
    *fa = NULL;
    return 0;
}

void flash_area_close(const struct flash_area *fa) { 
    return;
}

int flash_area_erase(const struct flash_area *fa, uint32_t off, uint32_t len) {
    return 0;
}

void ResetCtrl::performSwReset() {}
```

## src/stubs.h
```c
#ifndef __STUBS_H__
#define __STUBS_H__

#include <stdio.h>
#include <stdlib.h>
    #include <fcntl.h>
    #include <unistd.h>

extern bool gbRetVal;
extern int gIntVal;
extern char gBuf[1024];

// --------------------------------------------------------------------------------------

#define k_sleep(x)  mysleep(x)
#ifdef LOG_PRINTK
    #undef LOG_PRINTK
#endif    
#define LOG_PRINTK(x,...) 

int32_t mysleep(int32_t y);
// --------------------------------------------------------------------------------------

#define MAX_FILE_NAME 255

#define FS_LITTLEFS_DECLARE_DEFAULT_CONFIG(x)  

enum lfs_error {
    LFS_ERR_OK          = 0,    // No error
    LFS_ERR_IO          = -5,   // Error during device operation
    LFS_ERR_CORRUPT     = -84,  // Corrupted
    LFS_ERR_NOENT       = -2,   // No directory entry
    LFS_ERR_EXIST       = -17,  // Entry already exists
    LFS_ERR_NOTDIR      = -20,  // Entry is not a dir
    LFS_ERR_ISDIR       = -21,  // Entry is a dir
    LFS_ERR_NOTEMPTY    = -39,  // Dir is not empty
    LFS_ERR_BADF        = -9,   // Bad file number
    LFS_ERR_FBIG        = -27,  // File too large
    LFS_ERR_INVAL       = -22,  // Invalid parameter
    LFS_ERR_NOSPC       = -28,  // No space left on device
    LFS_ERR_NOMEM       = -12,  // No more memory available
    LFS_ERR_NOATTR      = -61,  // No data/attr available
    LFS_ERR_NAMETOOLONG = -36,  // File name too long
};

enum {
	FS_FATFS = 0,
	FS_LITTLEFS,
	FS_TYPE_EXTERNAL_BASE,
};

/*struct _dnode {
	union {
		struct _dnode *head; 
		struct _dnode *next; 
	};
	union {
		struct _dnode *tail; 
		struct _dnode *prev; 
	};
};

typedef struct _dnode sys_dlist_t;
typedef struct _dnode sys_dnode_t;*/

typedef uint8_t fs_mode_t;

typedef uint32_t lfs_size_t;
typedef uint32_t lfs_off_t;

typedef int32_t  lfs_ssize_t;
typedef int32_t  lfs_soff_t;

typedef uint32_t lfs_block_t;

struct fs_file_system_t;

struct fs_mount_t {
	//sys_dnode_t node;
	int type;
	const char *mnt_point;
	void *fs_data;
	void *storage_dev;
	/* fields filled by file system core */
	size_t mountp_len;
	const struct fs_file_system_t *fs;
	uint8_t flags;
};

struct fs_file_t {
	void *filep;
	const struct fs_mount_t *mp;
	fs_mode_t flags;
};

struct fs_dir_t {
	void *dirp;
	const struct fs_mount_t *mp;
};

enum fs_dir_entry_type {
        FS_DIR_ENTRY_FILE = 0,
        FS_DIR_ENTRY_DIR
};
 struct fs_dirent {
        enum fs_dir_entry_type type;
        char name[MAX_FILE_NAME + 1];
        size_t size;
};
 
struct fs_statvfs {
        unsigned long f_bsize;
        unsigned long f_frsize;
        unsigned long f_blocks;
        unsigned long f_bfree;
};

// Configuration provided during initialization of the littlefs
struct lfs_config {
    // Opaque user provided context that can be used to pass
    // information to the block device operations
    void *context;

    // Read a region in a block. Negative error codes are propagated
    // to the user.
    int (*read)(const struct lfs_config *c, lfs_block_t block,
            lfs_off_t off, void *buffer, lfs_size_t size);

    // Program a region in a block. The block must have previously
    // been erased. Negative error codes are propagated to the user.
    // May return LFS_ERR_CORRUPT if the block should be considered bad.
    int (*prog)(const struct lfs_config *c, lfs_block_t block,
            lfs_off_t off, const void *buffer, lfs_size_t size);

    // Erase a block. A block must be erased before being programmed.
    // The state of an erased block is undefined. Negative error codes
    // are propagated to the user.
    // May return LFS_ERR_CORRUPT if the block should be considered bad.
    int (*erase)(const struct lfs_config *c, lfs_block_t block);

    // Sync the state of the underlying block device. Negative error codes
    // are propagated to the user.
    int (*sync)(const struct lfs_config *c);

#ifdef LFS_THREADSAFE
    // Lock the underlying block device. Negative error codes
    // are propagated to the user.
    int (*lock)(const struct lfs_config *c);

    // Unlock the underlying block device. Negative error codes
    // are propagated to the user.
    int (*unlock)(const struct lfs_config *c);
#endif

    // Minimum size of a block read in bytes. All read operations will be a
    // multiple of this value.
    lfs_size_t read_size;

    // Minimum size of a block program in bytes. All program operations will be
    // a multiple of this value.
    lfs_size_t prog_size;

    // Size of an erasable block in bytes. This does not impact ram consumption
    // and may be larger than the physical erase size. However, non-inlined
    // files take up at minimum one block. Must be a multiple of the read and
    // program sizes.
    lfs_size_t block_size;

    // Number of erasable blocks on the device.
    lfs_size_t block_count;

    // Number of erase cycles before littlefs evicts metadata logs and moves
    // the metadata to another block. Suggested values are in the
    // range 100-1000, with large values having better performance at the cost
    // of less consistent wear distribution.
    //
    // Set to -1 to disable block-level wear-leveling.
    int32_t block_cycles;

    // Size of block caches in bytes. Each cache buffers a portion of a block in
    // RAM. The littlefs needs a read cache, a program cache, and one additional
    // cache per file. Larger caches can improve performance by storing more
    // data and reducing the number of disk accesses. Must be a multiple of the
    // read and program sizes, and a factor of the block size.
    lfs_size_t cache_size;

    // Size of the lookahead buffer in bytes. A larger lookahead buffer
    // increases the number of blocks found during an allocation pass. The
    // lookahead buffer is stored as a compact bitmap, so each byte of RAM
    // can track 8 blocks. Must be a multiple of 8.
    lfs_size_t lookahead_size;

    // Optional statically allocated read buffer. Must be cache_size.
    // By default lfs_malloc is used to allocate this buffer.
    void *read_buffer;

    // Optional statically allocated program buffer. Must be cache_size.
    // By default lfs_malloc is used to allocate this buffer.
    void *prog_buffer;

    // Optional statically allocated lookahead buffer. Must be lookahead_size
    // and aligned to a 32-bit boundary. By default lfs_malloc is used to
    // allocate this buffer.
    void *lookahead_buffer;

    // Optional upper limit on length of file names in bytes. No downside for
    // larger names except the size of the info struct which is controlled by
    // the LFS_NAME_MAX define. Defaults to LFS_NAME_MAX when zero. Stored in
    // superblock and must be respected by other littlefs drivers.
    lfs_size_t name_max;

    // Optional upper limit on files in bytes. No downside for larger files
    // but must be <= LFS_FILE_MAX. Defaults to LFS_FILE_MAX when zero. Stored
    // in superblock and must be respected by other littlefs drivers.
    lfs_size_t file_max;

    // Optional upper limit on custom attributes in bytes. No downside for
    // larger attributes size but must be <= LFS_ATTR_MAX. Defaults to
    // LFS_ATTR_MAX when zero.
    lfs_size_t attr_max;

    // Optional upper limit on total space given to metadata pairs in bytes. On
    // devices with large blocks (e.g. 128kB) setting this to a low size (2-8kB)
    // can help bound the metadata compaction time. Must be <= block_size.
    // Defaults to block_size when zero.
    lfs_size_t metadata_max;
};

typedef struct lfs_mdir {
    lfs_block_t pair[2];
    uint32_t rev;
    lfs_off_t off;
    uint32_t etag;
    uint16_t count;
    bool erased;
    bool split;
    lfs_block_t tail[2];
} lfs_mdir_t;

// littlefs directory type
typedef struct lfs_dir {
    struct lfs_dir *next;
    uint16_t id;
    uint8_t type;
    lfs_mdir_t m;

    lfs_off_t pos;
    lfs_block_t head[2];
} lfs_dir_t;

typedef struct lfs_gstate {
    uint32_t tag;
    lfs_block_t pair[2];
} lfs_gstate_t;

typedef struct lfs_cache {
    lfs_block_t block;
    lfs_off_t off;
    lfs_size_t size;
    uint8_t *buffer;
} lfs_cache_t;


// The littlefs filesystem type
typedef struct lfs {
    lfs_cache_t rcache;
    lfs_cache_t pcache;

    lfs_block_t root[2];
    struct lfs_mlist {
        struct lfs_mlist *next;
        uint16_t id;
        uint8_t type;
        lfs_mdir_t m;
    } *mlist;
    uint32_t seed;

    lfs_gstate_t gstate;
    lfs_gstate_t gdisk;
    lfs_gstate_t gdelta;

    struct lfs_free {
        lfs_block_t off;
        lfs_block_t size;
        lfs_block_t i;
        lfs_block_t ack;
        uint32_t *buffer;
    } free;

    const struct lfs_config *cfg;
    lfs_size_t name_max;
    lfs_size_t file_max;
    lfs_size_t attr_max;

} lfs_t;


/// internal littlefs data structures ///
/*typedef struct lfs_cache {
    lfs_block_t block;
    lfs_off_t off;
    lfs_size_t size;
    uint8_t *buffer;
} lfs_cache_t;

typedef struct lfs_mdir {
    lfs_block_t pair[2];
    uint32_t rev;
    lfs_off_t off;
    uint32_t etag;
    uint16_t count;
    bool erased;
    bool split;
    lfs_block_t tail[2];
} lfs_mdir_t;

// littlefs directory type
typedef struct lfs_dir {
    struct lfs_dir *next;
    uint16_t id;
    uint8_t type;
    lfs_mdir_t m;

    lfs_off_t pos;
    lfs_block_t head[2];
} lfs_dir_t;*/

// littlefs file type
typedef struct lfs_file {
    struct lfs_file *next;
    uint16_t id;
    uint8_t type;
    lfs_mdir_t m;

    struct lfs_ctz {
        lfs_block_t head;
        lfs_size_t size;
    } ctz;

    uint32_t flags;
    lfs_off_t pos;
    lfs_block_t block;
    lfs_off_t off;
    lfs_cache_t cache;

    const struct lfs_file_config *cfg;
} lfs_file_t;




#define CONFIG_FS_LITTLEFS_LOOKAHEAD_SIZE 1024
struct fs_littlefs {
	/* Defaulted in driver, customizable before mount. */
	struct lfs_config cfg;

	/* Must be cfg.cache_size */
	uint8_t *read_buffer;

	/* Must be cfg.cache_size */
	uint8_t *prog_buffer;

	/* Must be cfg.lookahead_size/4 elements, and
	 * cfg.lookahead_size must be a multiple of 8.
	 */
	uint32_t *lookahead_buffer[CONFIG_FS_LITTLEFS_LOOKAHEAD_SIZE / sizeof(uint32_t)];

	/* These structures are filled automatically at mount. */
	struct lfs lfs;
	void *backend;
	///struct k_mutex mutex;
};


int open(struct fs_file_t *filp, const char *fs_path, fs_mode_t flags);
ssize_t read(struct fs_file_t *filp, void *dest, size_t nbytes);
ssize_t write(struct fs_file_t *filp, const void *src, size_t nbytes);
int lseek(struct fs_file_t *filp, off_t off, int whence);
off_t tell(struct fs_file_t *filp);
int truncate(struct fs_file_t *filp, off_t length);
int sync(struct fs_file_t *filp);
int close(struct fs_file_t *filp);
int opendir(struct fs_dir_t *dirp, const char *fs_path);
int readdir(struct fs_dir_t *dirp, struct fs_dirent *entry);
int closedir(struct fs_dir_t *dirp);
int mount(struct fs_mount_t *mountp);
int unmount(struct fs_mount_t *mountp);
int unlink(struct fs_mount_t *mountp, const char *name);
int rename(struct fs_mount_t *mountp, const char *from, const char *to);
int mkdir(struct fs_mount_t *mountp, const char *name);
int stat(struct fs_mount_t *mountp, const char *path, struct fs_dirent *entry);
int statvfs(struct fs_mount_t *mountp, const char *path,struct fs_statvfs *stat);

int fs_open(struct fs_file_t *filp, const char *fs_path, fs_mode_t flags);
ssize_t fs_read(struct fs_file_t *filp, void *dest, size_t nbytes);
ssize_t fs_write(struct fs_file_t *filp, const void *src, size_t nbytes);
int fs_seek(struct fs_file_t *filp, off_t off, int whence);
off_t fs_tell(struct fs_file_t *filp);
int fs_truncate(struct fs_file_t *filp, off_t length);
int fs_sync(struct fs_file_t *filp);
int fs_close(struct fs_file_t *filp);
int fs_opendir(struct fs_dir_t *dirp, const char *fs_path);
int fs_readdir(struct fs_dir_t *dirp, struct fs_dirent *entry);
int fs_closedir(struct fs_dir_t *dirp);
int fs_mount(struct fs_mount_t *mountp);
int fs_unmount(struct fs_mount_t *mountp);
int fs_unlink(const char *name);
int fs_rename(const char *from, const char *to);
int fs_mkdir(const char *name);
int fs_stat(const char *path, struct fs_dirent *entry);
int fs_statvfs(const char *path,struct fs_statvfs *stat);

void fs_file_t_init(struct fs_file_t *zfp);
void fs_dir_t_init(struct fs_dir_t *zdp);
int lfs_dir_rewind(lfs_t *lfs, lfs_dir_t *dir);

struct fs_file_system_t {
	/* File operations */
	int (*open)(struct fs_file_t *filp, const char *fs_path,
		    fs_mode_t flags);
	ssize_t (*read)(struct fs_file_t *filp, void *dest, size_t nbytes);
	ssize_t (*write)(struct fs_file_t *filp,
					const void *src, size_t nbytes);
	int (*lseek)(struct fs_file_t *filp, off_t off, int whence);
	off_t (*tell)(struct fs_file_t *filp);
	int (*truncate)(struct fs_file_t *filp, off_t length);
	int (*sync)(struct fs_file_t *filp);
	int (*close)(struct fs_file_t *filp);
	/* Directory operations */
	int (*opendir)(struct fs_dir_t *dirp, const char *fs_path);
	int (*readdir)(struct fs_dir_t *dirp, struct fs_dirent *entry);
	int (*closedir)(struct fs_dir_t *dirp);
	/* File system level operations */
	int (*mount)(struct fs_mount_t *mountp);
	int (*unmount)(struct fs_mount_t *mountp);
	int (*unlink)(struct fs_mount_t *mountp, const char *name);
	int (*rename)(struct fs_mount_t *mountp, const char *from,
					const char *to);
	int (*mkdir)(struct fs_mount_t *mountp, const char *name);
	int (*stat)(struct fs_mount_t *mountp, const char *path,
					struct fs_dirent *entry);
	int (*statvfs)(struct fs_mount_t *mountp, const char *path,
					struct fs_statvfs *stat);
/*#if defined(CONFIG_FILE_SYSTEM_MKFS)
	int (*mkfs)(uintptr_t dev_id, void *cfg, int flags);
#endif*/
};

lfs_soff_t lfs_file_size(lfs_t *lfs, lfs_file_t *file);
int lfs_dir_seek(lfs_t *lfs, lfs_dir_t *dir, lfs_off_t off);
lfs_soff_t lfs_dir_tell(lfs_t *lfs, lfs_dir_t *dir);

// -------------------------------------------------------------------------

struct flash_area {
  uint8_t  fa_id;         /** The slot/scratch identification */
  uint16_t pad16;
  uint32_t fa_off;        /** The flash offset from the beginning */
  uint32_t fa_size;       /** The size of this sector */
  const struct device *fa_dev;
};

int flash_area_open(uint8_t id, const struct flash_area **fa);
void flash_area_close(const struct flash_area *fa);
int flash_area_erase(const struct flash_area *fa, uint32_t off, uint32_t len);



#endif // __STUBS_H__
```

## src/test_flashfs.cpp
```c
#include <zephyr/ztest.h>
#include <vector>
#include <algorithm>

#define private public
#include "fs/flashfs.h"

#include "stubs.h"

ZTEST_SUITE(tests_fs_flashfs, NULL, NULL, NULL, NULL, NULL);

// test constructor and destructor
ZTEST(tests_fs_flashfs, test_fs_flashfs_constructor)
{
	FlashFS* pFs = new FlashFS("lfs");
	zassert_not_null(pFs, "memory alloc failed");
	delete pFs;
}

// MISSING for 100% branch coverage static instantiation does not deliver NULL
// here code line 
// static FlashFS myInstance("fs", &lfs_storage_mnt);
// delete f; in function file_open
// delete d; in function dir_open
// are not covered completly.



// test constructor and destructor
ZTEST(tests_fs_flashfs, test_fs_flashfs_constructor2)
{
	struct fs_mount_t m;

	FlashFS* pFs = new FlashFS("lfs", &m);
	zassert_not_null(pFs, "memory alloc failed");
	delete pFs;
}

// test function lfs_toerror
ZTEST(tests_fs_flashfs, test_fs_flashfs_lfs_toerror)
{
	int iRet;

	iRet = FlashFS::inst().lfs_toerror(LFS_ERR_OK);
	zassert_equal(iRet, 0, "iRet != 0");
	iRet = FlashFS::inst().lfs_toerror(LFS_ERR_IO);
	zassert_equal(iRet, -EIO, "iRet != -EIO");
	iRet = FlashFS::inst().lfs_toerror(LFS_ERR_NOENT);
	zassert_equal(iRet, -ENOENT, "iRet != -ENOENT");
	iRet = FlashFS::inst().lfs_toerror(LFS_ERR_EXIST);
	zassert_equal(iRet, -EEXIST, "iRet != -EEXIST");
	iRet = FlashFS::inst().lfs_toerror(LFS_ERR_NOTDIR);
	zassert_equal(iRet, -ENOTDIR, "iRet != -ENOTDIR");
	iRet = FlashFS::inst().lfs_toerror(LFS_ERR_ISDIR);
	zassert_equal(iRet, -EISDIR, "iRet != -EISDIR");
	iRet = FlashFS::inst().lfs_toerror(LFS_ERR_INVAL);
	zassert_equal(iRet, -EINVAL, "iRet != -EINVAL");
	iRet = FlashFS::inst().lfs_toerror(LFS_ERR_NOSPC);
	zassert_equal(iRet, -ENOSPC, "iRet != -ENOSPC");
	iRet = FlashFS::inst().lfs_toerror(LFS_ERR_NOMEM);
	zassert_equal(iRet, -ENOMEM, "iRet != -ENOMEM");
	iRet = FlashFS::inst().lfs_toerror(LFS_ERR_CORRUPT);
	zassert_equal(iRet, -EILSEQ, "iRet != -EILSEQ");
	iRet = FlashFS::inst().lfs_toerror(0xFF);
	zassert_equal(iRet, 0xFF, "iRet != 0xFF");
}

// test function erase
ZTEST(tests_fs_flashfs, test_fs_flashfs_erase)
{
	int iRet;
	struct fs_mount_t m;

	FlashFS* pFs = new FlashFS("lfs", &m);
	zassert_not_null(pFs, "memory alloc failed");
	iRet = pFs->erase(&m);
	zassert_equal(iRet, 0, "iRet != 0");

	delete pFs;
}

static struct fs_mount_t lfs_storage_mnt;

// test function eraseFs
ZTEST(tests_fs_flashfs, test_fs_flashfs_eraseFs)
{
	int iRet=0;

	FlashFS* pFs = new FlashFS("lfs", &lfs_storage_mnt);
	zassert_not_null(pFs, "memory alloc failed");
	pFs->eraseFs();
	zassert_equal(iRet, 0, "iRet != 0");

	delete pFs;
}

// test function mount
ZTEST(tests_fs_flashfs, test_fs_flashfs_mount)
{
	int iRet;
	struct fs_mount_t m;

	gIntVal = 0;
	iRet = FlashFS::inst().mount(&m);
	zassert_equal(iRet, 0, "iRet != 0");

	gIntVal = -17;
	iRet = FlashFS::inst().mount(&m);
	zassert_equal(iRet, -17, "iRet != -17");
}

// test function unmount
ZTEST(tests_fs_flashfs, test_fs_flashfs_unmount)
{
	int iRet;
	struct fs_mount_t m;

	gIntVal = 0;
	iRet = FlashFS::inst().unmount();
	zassert_equal(iRet, 0, "iRet != 0");

	gIntVal = -17;
	iRet = FlashFS::inst().unmount();
	zassert_equal(iRet, -17, "iRet != -17");
}

// test function format
ZTEST(tests_fs_flashfs, test_fs_flashfs_format)
{
	int iRet;
	struct fs_mount_t m;

	iRet = FlashFS::inst().format(&m);
	zassert_equal(iRet, 0, "iRet != 0");
}

// test function remove
ZTEST(tests_fs_flashfs, test_fs_flashfs_remove)
{
	int iRet;
	iRet = FlashFS::inst().remove("filename");
	zassert_equal(iRet, 0, "iRet != 0");
}

// test function rename
ZTEST(tests_fs_flashfs, test_fs_flashfs_rename)
{
	int iRet;
	iRet = FlashFS::inst().rename("oldname", "newname");
	zassert_equal(iRet, 0, "iRet != 0");
}

// test function mkdir
ZTEST(tests_fs_flashfs, test_fs_flashfs_mkdir)
{
	int iRet;
	iRet = FlashFS::inst().mkdir("dirname", 0);
	zassert_equal(iRet, 0, "iRet != 0");
}

// test function stat
ZTEST(tests_fs_flashfs, test_fs_flashfs_stat)
{
	int iRet;
	struct fs_dirent d;

	gIntVal = 0;
	iRet = FlashFS::inst().stat("dirname", &d);
	zassert_equal(iRet, 0, "iRet != 0");
}

// test function statvfs
ZTEST(tests_fs_flashfs, test_fs_flashfs_statvfs)
{
	int iRet;
	struct fs_statvfs st;

    gIntVal = 0;
	iRet = FlashFS::inst().statvfs("dirname", &st);
	zassert_equal(iRet, 0, "iRet != 0");

    gIntVal = 7;
	iRet = FlashFS::inst().statvfs("dirname", &st);
	zassert_equal(iRet, 7, "iRet != 7");
}

// test function file_open
ZTEST(tests_fs_flashfs, test_fs_flashfs_file_open)
{
	fs_file_t* pf;
	struct fs_dirent d;

    gIntVal = 0;
	pf = FlashFS::inst().file_open("filename", 0);
	zassert_not_null(pf, "memory alloc failed");

    gIntVal = 7;
	pf = FlashFS::inst().file_open("filename", 0);
	zassert_is_null(pf, "pf != NULL");
}

// test function file_close
ZTEST(tests_fs_flashfs, test_fs_flashfs_file_close)
{
	int iRet;
	fs_file_t* f = new fs_file_t;

	iRet = FlashFS::inst().file_close(f);
	zassert_equal(iRet, 0, "iRet != 0");
	
	f = NULL;
	iRet = FlashFS::inst().file_close(f);
	zassert_equal(iRet, 0, "iRet != 0");
}

// test function file_read
ZTEST(tests_fs_flashfs, test_fs_flashfs_file_read)
{
	ssize_t iRet;
	uint8_t buf[5];
	fs_file_t f;

	iRet = FlashFS::inst().file_read(&f, buf, 5);
	zassert_equal(iRet, 5, "iRet != 5");
	zassert_equal(buf[0], 1, "buf wrong");
	zassert_equal(buf[1], 2, "buf wrong");
	zassert_equal(buf[2], 1, "buf wrong");
	zassert_equal(buf[3], 3, "buf wrong");
	zassert_equal(buf[4], 1, "buf wrong");
}

// test function file_write
ZTEST(tests_fs_flashfs, test_fs_flashfs_file_write)
{
	ssize_t iRet;
	uint8_t buf[3] = {7,17,27};
	fs_file_t f;

	iRet = FlashFS::inst().file_write(&f, buf, 3);
	zassert_equal(iRet, 3, "iRet != 3");
	zassert_equal(gBuf[0], 7, "buf wrong");
	zassert_equal(gBuf[1], 17, "buf wrong");
	zassert_equal(gBuf[2], 27, "buf wrong");
}

// test function file_sync
ZTEST(tests_fs_flashfs, test_fs_flashfs_file_sync)
{
	ssize_t iRet;
	fs_file_t f;

	iRet = FlashFS::inst().file_sync(&f);
	zassert_equal(iRet, 0, "iRet != 0");
}

// test function file_seek
ZTEST(tests_fs_flashfs, test_fs_flashfs_file_seek)
{
	ssize_t iRet;
	fs_file_t f;

	iRet = FlashFS::inst().file_seek(&f, 10, 0);
	zassert_equal(iRet, 0, "iRet != 0");
}

// test function file_tell
ZTEST(tests_fs_flashfs, test_fs_flashfs_file_tell)
{
	ssize_t iRet;
	fs_file_t f;

	iRet = FlashFS::inst().file_tell(&f);
	zassert_equal(iRet, 0, "iRet != 0");
}

// test function file_size
ZTEST(tests_fs_flashfs, test_fs_flashfs_file_size)
{
	ssize_t iRet;
	fs_file_t f;

	gIntVal = 0;
	iRet = FlashFS::inst().file_size(&f);
	zassert_equal(iRet, 0, "iRet != 0");

	gIntVal = -7;
	iRet = FlashFS::inst().file_size(&f);
	zassert_equal(iRet, -7, "iRet != -7");
}

// test function file_truncate
ZTEST(tests_fs_flashfs, test_fs_flashfs_file_truncate)
{
	ssize_t iRet;
	fs_file_t f;

	iRet = FlashFS::inst().file_truncate(&f, 5);
	zassert_equal(iRet, 0, "iRet != 0");
}

// test function file_exists
ZTEST(tests_fs_flashfs, test_fs_flashfs_file_exists)
{
	bool bRet;

	gIntVal = 0;
	bRet = FlashFS::inst().file_exists("path");
	zassert_true(bRet, "bRet != true");

	gIntVal = -7;
	bRet = FlashFS::inst().file_exists("path");
	zassert_false(bRet, "bRet != false");
}

// test function dir_open
ZTEST(tests_fs_flashfs, test_fs_flashfs_dir_open)
{
	fs_dir_t* pf;

	gIntVal = 0;
	pf = FlashFS::inst().dir_open("path");
	zassert_not_null(pf, "memory alloc failed");

	gIntVal = -7;
	pf = FlashFS::inst().dir_open("path");
	zassert_is_null(pf, "pf != NULL");
}

// test function dir_close
ZTEST(tests_fs_flashfs, test_fs_flashfs_dir_close)
{
	int iRet;
	fs_dir_t* d = new fs_dir_t;

	iRet = FlashFS::inst().dir_close(d);
	zassert_equal(iRet, 0, "iRet != 0");

	d = NULL;
	iRet = FlashFS::inst().dir_close(d);
	zassert_equal(iRet, 0, "iRet != 0");
}

// test function dir_read
ZTEST(tests_fs_flashfs, test_fs_flashfs_dir_read)
{
	int iRet;
	fs_dir_t d;
	struct fs_dirent e;

	iRet = FlashFS::inst().dir_read(&d, &e);
	//printk("XXXXX iRet = %d\n\n", iRet);
	zassert_equal(iRet, -7, "iRet != -7");
}

// test function dir_seek
ZTEST(tests_fs_flashfs, test_fs_flashfs_dir_seek)
{
	fs_dir_t d;

	FlashFS::inst().dir_seek(&d, 6);
}

// test function dir_tell
ZTEST(tests_fs_flashfs, test_fs_flashfs_dir_tell)
{
	int iRet;
	fs_dir_t d;

	iRet = FlashFS::inst().dir_tell(&d);
	zassert_equal(iRet, 0, "iRet != 0");
}

// test function dir_rewind
ZTEST(tests_fs_flashfs, test_fs_flashfs_dir_rewind)
{
	int iRet;
	fs_dir_t d;

	iRet = FlashFS::inst().dir_rewind(&d);
	zassert_equal(iRet, 0, "iRet != 0");
}

// test function dir_list
ZTEST(tests_fs_flashfs, test_fs_flashfs_dir_list)
{
	int iRet;

	gbRetVal = true;

	gIntVal = 0;
	iRet = FlashFS::inst().dir_list("path");
	zassert_equal(iRet, 0, "iRet != 0");

	gIntVal = 7;
	iRet = FlashFS::inst().dir_list("path");
	zassert_equal(iRet, 7, "iRet != 7");

	gIntVal = 6;
	iRet = FlashFS::inst().dir_list("path");
	zassert_equal(iRet, 6, "iRet != 6");

	gIntVal = -7;
	iRet = FlashFS::inst().dir_list("path");
	zassert_equal(iRet, -7, "iRet != -7");

	gIntVal = -6;
	iRet = FlashFS::inst().dir_list("path");
	zassert_equal(iRet, -6, "iRet != -6");

	gIntVal = 1;
	iRet = FlashFS::inst().dir_list("path");
	zassert_equal(iRet, 1, "iRet != 1");

	gIntVal = 2;
	iRet = FlashFS::inst().dir_list("path");
	//printk("XXXXX iRet = %d\n\n", iRet);
	zassert_equal(iRet, 2, "iRet != 2");
}

// test function file_tree
ZTEST(tests_fs_flashfs, test_fs_flashfs_file_tree)
{
	int iRet;

	gbRetVal = true;

	gIntVal = 0;
	iRet = FlashFS::inst().file_tree("path");
	zassert_equal(iRet, 0, "iRet != 0");

	gIntVal = 7;
	iRet = FlashFS::inst().file_tree("path");
	zassert_equal(iRet, 7, "iRet != 7");

	gIntVal = 6;
	iRet = FlashFS::inst().file_tree("path");
	zassert_equal(iRet, 6, "iRet != 6");

	gIntVal = -7;
	iRet = FlashFS::inst().file_tree("path");
	zassert_equal(iRet, -7, "iRet != -7");

	gIntVal = -6;
	iRet = FlashFS::inst().file_tree("path");
	zassert_equal(iRet, -6, "iRet != -6");

	gIntVal = 1;
	iRet = FlashFS::inst().file_tree("path");
	zassert_equal(iRet, 1, "iRet != 1");

	gIntVal = 2;
	iRet = FlashFS::inst().file_tree("path");
	//printk("XXXXX iRet = %d\n\n", iRet);
	zassert_equal(iRet, 0, "iRet != 0");

	gIntVal = 3;
	iRet = FlashFS::inst().file_tree("path");
	//printk("XXXXX iRet = %d\n\n", iRet);
	zassert_equal(iRet, 0, "iRet != 0");

	gIntVal = 5;
	iRet = FlashFS::inst().file_tree("path");
	//printk("XXXXX iRet = %d\n\n", iRet);
	zassert_equal(iRet, 5, "iRet != 5");

}

// test function CheckAvailableSpace
ZTEST(tests_fs_flashfs, test_fs_flashfs_CheckAvailableSpace)
{
	gIntVal = 0;
	FlashFS::inst().CheckAvailableSpace();
	gIntVal = 7;
	FlashFS::inst().CheckAvailableSpace();
}

// test function GetFsStat
ZTEST(tests_fs_flashfs, test_fs_flashfs_GetFsStat)
{
	unsigned char* pOut;

	gIntVal = 0;
	pOut = FlashFS::inst().GetFsStat("path");

	gIntVal = 7;
	pOut = FlashFS::inst().GetFsStat("path");

	gIntVal = 6;
	FlashFS::inst().GetFsStat("path");

	gIntVal = -7;
	FlashFS::inst().GetFsStat("path");

	gbRetVal = false;
	gIntVal = -17;
	FlashFS::inst().GetFsStat("path");

	gbRetVal = false;
	gIntVal = -16;
	FlashFS::inst().GetFsStat("path");

	gbRetVal = false;
	gIntVal = 11;
	FlashFS::inst().GetFsStat("path");

	gbRetVal = false;
	gIntVal = 12;
	FlashFS::inst().GetFsStat("path");

	gbRetVal = false;
	gIntVal = 13;
	FlashFS::inst().GetFsStat("path");

	gbRetVal = false;
	gIntVal = 14;
	FlashFS::inst().GetFsStat("path");
}

// test function shell_file_tree
ZTEST(tests_fs_flashfs, test_fs_flashfs_shell_file_tree)
{
	int iRet;

	iRet = FlashFS::inst().shell_file_tree(NULL, 0, NULL);
	zassert_equal(iRet, 0, "iRet != 0");
}

// test function shell_fs_stat
ZTEST(tests_fs_flashfs, test_fs_flashfs_shell_fs_stat)
{
	int iRet;

	iRet = FlashFS::inst().shell_fs_stat(NULL, 0, NULL);
	zassert_equal(iRet, 0, "iRet != 0");
}

// test function clear_fs
ZTEST(tests_fs_flashfs, test_fs_flashfs_clear_fs)
{
	int iRet=0;

	FlashFS* pFs = new FlashFS("lfs", &lfs_storage_mnt);
	zassert_not_null(pFs, "memory alloc failed");
	pFs->clear_fs(NULL, 0, NULL);
	printk("clear_fs passed\n");
	zassert_equal(iRet, 0, "iRet != 0");

	delete pFs;
}
```
