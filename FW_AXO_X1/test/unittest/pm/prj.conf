## CMakeLists.txt
```
cmake_minimum_required(VERSION 3.20.0)
find_package(Zephyr REQUIRED HINTS $ENV{ZEPHYR_BASE})
project(pm)

FILE(GLOB app_sources src/stubs.cpp
                      src/test_boot_cnt.cpp                      
                      src/test_power_mgr.cpp                      
                      src/test_power_mgr_x1.cpp                      
                      src/test_reset_ctrl.cpp                      
                      src/test_reset_reason.cpp                      
)
target_sources(app PRIVATE ${app_sources}
	../../common/src/pm/boot_cnt.cpp
	../../common/src/pm/power_mgr.cpp
	../../common/src/pm/power_mgr_x1.cpp
	../../common/src/pm/reset_ctrl.cpp
	../../common/src/pm/reset_reason.cpp
    ../../common/src/rtos/mutex.cpp
    ../../common/src/rtos/mbox.cpp
    ../../common/src/rtos/mpool.cpp
    ../../common/src/rtos/task.cpp
    ../../common/src/rtos/timer.cpp
)


zephyr_include_directories(../../include)
zephyr_include_directories(../../common/src)
zephyr_include_directories(../../app-axo-x1/src)

zephyr_compile_options(-Wno-pointer-arith -Wno-unused-variable -Wno-psabi)
```

## prj.conf
```kconfig
CONFIG_ZTEST=y
CONFIG_ZTEST_NEW_API=y

CONFIG_MAIN_STACK_SIZE=8192
#4096

CONFIG_ZTEST_STACK_SIZE=65536
#32768

CONFIG_LOG=y
CONFIG_PRINTK=y
CONFIG_CPLUSPLUS=y
CONFIG_LIB_CPLUSPLUS=y
CONFIG_EXCEPTIONS=n
CONFIG_STD_CPP17=y
CONFIG_NEWLIB_LIBC=y
CONFIG_NEWLIB_LIBC_MIN_REQUIRED_HEAP_SIZE=4096

# disable assert macros
CONFIG_ASSERT=n
CONFIG_ASSERT_TEST=n

# memory usage
CONFIG_MEM_SLAB_TRACE_MAX_UTILIZATION=y 
CONFIG_SYS_HEAP_RUNTIME_STATS=y

CONFIG_HEAP_MEM_POOL_SIZE=16384

CONFIG_CBPRINTF_FP_SUPPORT=y

# CJSON
CONFIG_NEWLIB_LIBC_FLOAT_PRINTF=y
CONFIG_CJSON_LIB=y

CONFIG_NUM_COOP_PRIORITIES=10
CONFIG_NUM_PREEMPT_PRIORITIES=10
CONFIG_SCHED_SCALABLE=y

# Enable thread awareness for debugging tools supporting it
CONFIG_INIT_STACKS=y
CONFIG_THREAD_NAME=y
CONFIG_THREAD_STACK_INFO=y
CONFIG_THREAD_RUNTIME_STATS=y
CONFIG_THREAD_MONITOR=y
CONFIG_DEBUG_THREAD_INFO=y

CONFIG_UNIT_TEST=y
CONFIG_UNIT_TEST_PM=y
CONFIG_COVERAGE=y
CONFIG_COVERAGE_DUMP=y
```

## src/stubs.cpp
```c
#include "string.h"

#define private public
#include "rtos/mbox.h"
#include "rtos/mpelem.h"
#include "rtos/mpool.h"
#include "rtos/mqueue.h"
#include "rtos/task.h"
#include "rtos/timer.h"

//#include "bus/spi/spibus.h"
//#include "drv/spi/fram.h"
//#include "drv/spi/adxl37x.h"
#include "conf/config.h"
//#include "./version.h"


#include "stubs.h"


// -------------------------------------------------------------------------

bool gbRetVal;
uint32_t gu32Val;
int gIntVal;

// -------------------------------------------------------------------------
std::allocator<uint8_t> allocBytes;


void Mbox::sendMsg(enum msgType mType, MboxId senderId, MboxId receiverId) {
    PoolElem* e1 = new PoolElem(mType, senderId);
    e1->buf = NULL;
    e1->bufLen = 0;
    //printk("mType = %d, senderId = %d, receiverId = %d, %x\n", mType, senderId, receiverId, (unsigned int)e1);
    Mbox::send(e1, receiverId);
}

void Mbox::sendMsg(enum msgType mType, MboxId senderId, MboxId receiverId,
                   uint8_t u8DataByte) {
    PoolElem* e1 = new PoolElem(mType, senderId);
    e1->p1 = u8DataByte;
    e1->buf = NULL;
    e1->bufLen = 0;
    //printk("mType = %d, senderId = %d, receiverId = %d, %x\n", mType, senderId, receiverId, (unsigned int)e1);
    Mbox::send(e1, receiverId);
}

void Mbox::sendMsg(enum msgType mType, MboxId senderId, MboxId receiverId,
                   int8_t s8DataByte) {
    PoolElem* e1 = new PoolElem(mType, senderId);
    e1->p2 = s8DataByte;
    e1->buf = NULL;
    e1->bufLen = 0;
    //printk("mType = %d, senderId = %d, receiverId = %d, %x\n", mType, senderId, receiverId, (unsigned int)e1);
    Mbox::send(e1, receiverId);
}

void Mbox::sendMsg(enum msgType mType, MboxId senderId, MboxId receiverId,
                        uint8_t* pData, uint16_t dataLen) {
    PoolElem* e1 = new PoolElem(mType, senderId);
        
    uint8_t* b = allocBytes.allocate(2048);
    memcpy(b, pData, dataLen);
    e1->buf = reinterpret_cast<uint8_t (*)[2048]>(b);
    //printk("sendMsg():  e1->buf = 0x%X\n\n", (unsigned int)e1->buf);
    e1->bufLen = dataLen;
    e1->mtype = mType;
    e1->from = senderId;
    //printk("mType = %d, senderId = %d, receiverId = %d, %x\n", mType, senderId, receiverId, (unsigned int)e1);
    Mbox::send(e1, receiverId);
}

void Mbox::sendMsg(enum msgType mType, MboxId senderId, MboxId receiverId,
                   const std::string& str) {
    PoolElem* e1 = new PoolElem(mType, senderId);
    size_t dataLen = str.size() + 1;
    uint8_t* b = allocBytes.allocate(2048);
    auto rc = snprintf(reinterpret_cast<char*>(b), dataLen, "%s", str.c_str());
    int strLen = strlen(reinterpret_cast<const char*>(b));
    dataLen = strLen ? strLen + 1 : 0;
    e1->buf = (uint8_t (*)[2048])(b);
    e1->bufLen = dataLen;
    e1->mtype = mType;
    e1->from = senderId;
    //printk("mType = %d, senderId = %d, receiverId = %d, %x\n", mType, senderId, receiverId, (unsigned int)e1);
    Mbox::send(e1, receiverId);
}

// -------------------------------------------------------------------------

uint8_t* PoolElem::getBuffer(void) { return *buf; }

void PoolElem::putString(const char* s) {
    std::string str = s;
    size_t dataLen = str.size() + 1;
    uint8_t* b = allocBytes.allocate(2048);
    auto rc = snprintf(reinterpret_cast<char*>(b), dataLen, "%s", str.c_str());
    int strLen = strlen(reinterpret_cast<const char*>(b));
    dataLen = strLen ? strLen + 1 : 0;
    this->buf = (uint8_t (*)[2048])(b);
    this->bufLen = dataLen;
}

void PoolElem::putData(const void* pdata, size_t len) {
    uint8_t* b = allocBytes.allocate(2048);
    memcpy(b, pdata, len);
    this->buf = reinterpret_cast<uint8_t (*)[2048]>(b);
    this->bufLen = len;
}

void PoolElem::Dump() { }

void PoolElem::free() {
    uint8_t* b = reinterpret_cast<uint8_t*>(this->buf);
    //printk("free():  this->buf = 0x%X\n\n", (unsigned int)this->buf);
    //printk("free():  0x%.2X%.2X%.2X%.2X\n\n", (*(uint8_t*)this->buf[0]), 
    //                                  (*(uint8_t*)this->buf[1]),
    //                                  (*(uint8_t*)this->buf[2]), 
    //                                  (*(uint8_t*)this->buf[3]));
    if (this->buf != NULL) {
        allocBytes.deallocate(reinterpret_cast<uint8_t*>(this->buf), 2048);
        this->buf = NULL;
        this->bufLen = 0;
    }
    delete this;
}

// -------------------------------------------------------------------------

/*void* k_timer_user_data_get(k_timer* timer) {
    return reinterpret_cast<void*>(timer);
}*/

void* my_k_timer_user_data_get(k_timer* timer) {
    return reinterpret_cast<void*>(timer);
}

int64_t my_k_uptime_get (void) {
    return gIntVal;
}

// -------------------------------------------------------------------------

Config* Config::inst() {
    static Config myInstance;
    return &myInstance;
}

Config::Config() { }

Config::~Config() { }

stCfgGeneral* Config::getCfgGeneral() { 
    // 	std::string name;    //!< Name of the device class
	// std::string type;    //!< Type of the device
	// std::string version; //!< Version of the configuration 
    static stCfgGeneral ret = {"a","a","a"};
    return &ret;
}

stCfgMetrics* Config::getCfgMetrics() { 
    // std::string interval;
    //static stCfgMetrics ret = {"a"};
    //return &ret;
    return &cfgMetrics;
}

stCfgDatalog* Config::getCfgDatalog() {
    // std::string dispmodeoff; 
    // std::string rawtransferon; 
    // std::string disptransferon;  
    // std::string rms_thres;   
    // std::string max_raw_per_day;
    static stCfgDatalog ret_true = {"true","true","true","25","5"};
    static stCfgDatalog ret_false = {"false","false","false","25","5"};
    if (gbRetVal) {
        return &ret_true;
    } else {
        return &ret_false;
    }
}

stCfgDisplacement* Config::getCfgDisplacement() { 
    // std::string b1;
    static stCfgDisplacement ret = {"0.0"};
    return &ret;
}

stCfgSensor*  Config::getCfgSensor(enCfgSensorId id) { 
    // std::string name;       //!< Name of the sensor
	// std::string type;       //!< Type of the sensor
	// std::string actthres;   //!< Activation threshold
	// std::string deactthres; //!< Deactivation threshold
    static stCfgSensor ret = {"a","a","a","a"};
    return &ret;
}

/*/ -------------------------------------------------------------------------

const char* getFwVersion() { return "9.77"; }

// -------------------------------------------------------------------------
*/
struct gpio_dt_spec gGpioDtSpec;

int gpio_pin_configure_dt (const struct gpio_dt_spec *spec, gpio_flags_t extra_flags) {
    return 0;
}

int gpio_pin_set_dt (const struct gpio_dt_spec *spec, int value) {
    return 0;
}

int gpio_pin_get_raw (const struct device *port, gpio_pin_t pin) {
    return 0;
}


// -------------------------------------------------------------------------

char gBuf[1024];

static struct fs_file_t stFile;

FlashFS::FlashFS(const char* name) { }

FlashFS& FlashFS::inst() {
    static FlashFS myInstance("fs");
    return myInstance;
}

FlashFS::~FlashFS() { }


bool FlashFS::file_exists(const char* path) {
    return gbRetVal;
}

int FlashFS::file_sync(fs_file_t* file) {
    return 0;
}

off_t FlashFS::file_seek(fs_file_t* file, off_t offset, int whence) {
    return 0;
}

fs_file_t* FlashFS::file_open(const char* path, int flags) {
    return reinterpret_cast<fs_file_t*>(this);
}

int FlashFS::file_close(fs_file_t* file) {
    return 0;
}

ssize_t FlashFS::file_read(fs_file_t* file, void* buffer, size_t len) {
    strncpy((char*)buffer, gBuf, 1024);
    return len;
}

ssize_t FlashFS::file_write(fs_file_t* file, const void* buffer, size_t len) {
    strncpy(gBuf, (char*)buffer, 1024);
    return len;
}

int FlashFS::remove(const char* filename) {
    return 0; 
}

// -------------------------------------------------------------------------

int mqtt_helper_disconnect(void) {
    return gbRetVal;
}

// -------------------------------------------------------------------------

int nrf_modem_at_printf(const char* fmt, ...) {
    return gbRetVal;
}


// -------------------------------------------------------------------------

uint32_t nrfx_reset_reason_get(void) {
    return gu32Val;
}

void nrfx_reset_reason_clear(uint32_t mask) { }

// -------------------------------------------------------------------------

int popcount32(unsigned int x) {
    return gIntVal;
}

// -------------------------------------------------------------------------

void sys_reboot (int type) { }

int pm_device_action_run (const struct device *dev, enum pm_device_action action) { 
    return 0;
}

bool my_device_is_ready(const struct device *dev) {
    /*if (gbReady) {
        return true;
    }
    return false;*/
    return true;
}
```

## src/stubs.h
```c
#ifndef __STUBS_H__
#define __STUBS_H__

#include <stdio.h>
#include <stdlib.h>
    #include <fcntl.h>
    #include <unistd.h>

#define SYS_REBOOT_COLD 8

extern bool gbRetVal;
extern uint32_t gu32Val;
extern int gIntVal;
extern char gBuf[1024];

#define k_timer_user_data_get(x) my_k_timer_user_data_get(x)
#define k_sleep(x)  
#define k_uptime_get() my_k_uptime_get()

void* my_k_timer_user_data_get(k_timer* timer);
void sys_reboot (int type);
int64_t my_k_uptime_get (void);

// ---------------c----------------------------------------------------------------

#define zephyr_user 77

extern struct gpio_dt_spec gGpioDtSpec;

#ifdef DEVICE_DT_GET
    #undef DEVICE_DT_GET
#endif
#define DEVICE_DT_GET(x) x

#ifdef DT_NODELABEL
    #undef DT_NODELABEL
#endif    
#define DT_NODELABEL(x) 0


#ifdef GPIO_DT_SPEC_GET
    #undef GPIO_DT_SPEC_GET
#endif    
#define GPIO_DT_SPEC_GET(x,y) gGpioDtSpec

#define GPIO_OUTPUT_INACTIVE 0
#define GPIO_OUTPUT_ACTIVE 1

#define GPIO_INPUT   BIT(16)
#define GPIO_OUTPUT  BIT(17)

typedef uint8_t gpio_pin_t;
typedef uint16_t gpio_dt_flags_t;
typedef uint16_t spi_operation_t;
typedef uint16_t pwm_flags_t;
typedef uint32_t gpio_flags_t;

struct device {
        const char *name;
        const void *config;
        const void *api;
        //struct device_state *state;
        void *data;
        //struct device_ops ops;
        //device_flags_t flags;
};
struct gpio_dt_spec {
        const struct device *port;
        gpio_pin_t pin;
        gpio_dt_flags_t dt_flags;
};


int gpio_pin_configure_dt (const struct gpio_dt_spec *spec, gpio_flags_t extra_flags);
int gpio_pin_set_dt (const struct gpio_dt_spec *spec, int value);
int gpio_pin_get_raw (const struct device *port, gpio_pin_t pin);

#define device_is_ready(dev) my_device_is_ready(dev)

bool my_device_is_ready(const struct device *dev);


// -----------------------------------------------------------------------------------


struct fs_file_t {
   FILE* pF;
};
//#define FS_O_CREATE | FS_O_RDWR "w"
#define FS_O_CREATE 0x01
#define FS_O_RDWR 0x02
#define FS_O_READ 0x04
#define FS_SEEK_SET 0

//int file_remove(const char* path);

class FlashFS {
 public:
    explicit FlashFS(const char* name = "??");

    static FlashFS& inst();
    FlashFS() = delete;
    virtual ~FlashFS();
    bool file_exists(const char* path);
    int file_sync(fs_file_t* file);
    off_t file_seek(fs_file_t* file, off_t offset, int whence);    
    fs_file_t* file_open(const char* path, int flags);
    int file_close(fs_file_t* file);
    ssize_t file_read(fs_file_t* file, void* buffer, size_t size);
    ssize_t file_write(fs_file_t* file, const void* buffer, size_t size);
    int remove(const char* path);
};

// -----------------------------------------------------------------------------------

int mqtt_helper_disconnect(void);


// -----------------------------------------------------------------------------------

int nrf_modem_at_printf(const char* fmt, ...);

// -----------------------------------------------------------------------------------

typedef enum
{
    NRFX_RESET_REASON_RESETPIN_MASK   = 0x00000001,
    NRFX_RESET_REASON_DOG0_MASK       = 0x00000002,
    NRFX_RESET_REASON_DOG_MASK        = 0x00000004, 
    NRFX_RESET_REASON_CTRLAP_MASK     = 0x00000008,
    NRFX_RESET_REASON_SREQ_MASK       = 0x00000010,
    NRFX_RESET_REASON_LOCKUP_MASK     = 0x00000020,
    NRFX_RESET_REASON_OFF_MASK        = 0x00000040,
    NRFX_RESET_REASON_LPCOMP_MASK     = 0x00000080,
    NRFX_RESET_REASON_DIF_MASK        = 0x00000100,
    NRFX_RESET_REASON_LSREQ_MASK      = 0x00000200,
    NRFX_RESET_REASON_LLOCKUP_MASK    = 0x00000400,
    NRFX_RESET_REASON_LDOG_MASK       = 0x00000800,
    NRFX_RESET_REASON_MFORCEOFF_MASK  = 0x00001000,
    NRFX_RESET_REASON_NFC_MASK        = 0x00002000,
    NRFX_RESET_REASON_DOG1_MASK       = 0x00004000,
    NRFX_RESET_REASON_VBUS_MASK       = 0x00008000,
    NRFX_RESET_REASON_LCTRLAP_MASK    = 0x00010000,
    NRFX_RESET_REASON_CTRLAPSOFT_MASK = 0x00020000,
    NRFX_RESET_REASON_CTRLAPHARD_MASK = 0x00040000,
    NRFX_RESET_REASON_CTRLAPPIN_MASK  = 0x00080000,
    NRFX_RESET_REASON_GRTC_MASK       = 0x00100000,
    NRFX_RESET_REASON_SECTAMPER_MASK  = 0x00200000,
} nrfx_reset_reason_mask_t;


uint32_t nrfx_reset_reason_get(void);
void nrfx_reset_reason_clear(uint32_t mask);

// -----------------------------------------------------------------------------------

int popcount32(unsigned int x);

// -----------------------------------------------------------------------------------


enum pm_device_action { 
    PM_DEVICE_ACTION_SUSPEND , 
    PM_DEVICE_ACTION_RESUME , 
    PM_DEVICE_ACTION_TURN_OFF , 
    PM_DEVICE_ACTION_TURN_ON 
};

int pm_device_action_run (const struct device *dev, enum pm_device_action action);


#endif // __STUBS_H__
```

## src/test_boot_cnt.cpp
```c
#include <zephyr/ztest.h>
#include <string.h>


#define private public
#include "pm/boot_cnt.h"

#include "stubs.h"

ZTEST_SUITE(tests_pm_boot_cnt, NULL, NULL, NULL, NULL, NULL);

// test constructor and destructor
ZTEST(tests_pm_boot_cnt, test_pm_boot_cnt_constructor)
{
	memset(gBuf, 0, sizeof(gBuf));
	BootCnt* pBootCnt = new BootCnt();
	zassert_not_null(pBootCnt, "memory alloc failed");
	zassert_equal(pBootCnt->boot_count, 1, "boot_count != 1");

	delete pBootCnt;
}

// MISSING for 100% branch coverage static instantiation does not deliver NULL
// here code line 
// static BootCnt myInstance;
// are not covered completly.



// test constructor and destructor
ZTEST(tests_pm_boot_cnt, test_pm_boot_cnt_constructor2)
{
	memset(gBuf, -7, sizeof(gBuf));
	BootCnt* pBootCnt = new BootCnt();
	zassert_not_null(pBootCnt, "memory alloc failed");
	zassert_equal(pBootCnt->boot_count, 1, "boot_count != 1");

	delete pBootCnt;
}

// test function get
ZTEST(tests_pm_boot_cnt, test_pm_boot_cnt_get)
{
	int32_t cnt = BootCnt::inst()->get();
	BootCnt::inst()->boot_count = 77;
	zassert_equal(BootCnt::inst()->boot_count, 77, "boot_count != 77");
}
```

## src/test_power_mgr.cpp
```c
#include <zephyr/ztest.h>
//#include <vector>
//#include <algorithm>

#define private public
#define protected public
#include "pm/power_mgr.h"
#include "conf/config.h"
#include "rtos/timer.h"

#include "stubs.h"

class PowerMgrTest : public PowerMgr {
 public:
    explicit PowerMgrTest(const char* name = "??");
    virtual ~PowerMgrTest();
	virtual void taskInit(void);
	virtual PoolElem* message_handler(PoolElem* pElem);

 private:
};

PowerMgrTest::PowerMgrTest(const char* name) : PowerMgr(name) { }
PowerMgrTest::~PowerMgrTest() { }
void PowerMgrTest::taskInit(void) { }

PoolElem* PowerMgrTest::message_handler(PoolElem* pElem) { 
	if (gbRetVal) {
		return pElem;
	}
	return NULL;
}

ZTEST_SUITE(tests_pm_power_mgr, NULL, NULL, NULL, NULL, NULL);

// test constructor and destructor
ZTEST(tests_pm_power_mgr, test_pm_power_mgr_constructor)
{
	PowerMgrTest* pPowerMgr = new PowerMgrTest("PowerMgr");
	zassert_not_null(pPowerMgr, "memory alloc failed");
	zassert_not_null(pPowerMgr->pInMbox, "pInMbox = NULL");
	zassert_not_null(pPowerMgr->MetricsTxTimer, "MetricsTxTimer = NULL");
    zassert_equal(pPowerMgr->pInMbox->count(), 0, "pInMbox->count() != 0");
    zassert_equal(pPowerMgr->pInMbox, Mbox::getMboxById(Mbox::ePowerManager),
                  "Error getting mailbox by id");

	delete pPowerMgr;
}

// MISSING for 100% branch coverage operator new does not deliver NULL
// here code lines 
// pInMbox = new Mbox(name); 
// MetricsTxTimer = new Timer(PowerMgr::MetricsTxTimer_cb, this, eMetricsTmo, eMetricsTmo);
// static PoolElem e1 = {eMetricsTxTimerExpired, Mbox::MboxId::ePowerManager, 'p', 'm'};
// are not covered completly.



// test function uart0_off
ZTEST(tests_pm_power_mgr, test_pm_power_mgr_uart0_off)
{
	PowerMgrTest* pPowerMgr = new PowerMgrTest("PowerMgr");
	zassert_not_null(pPowerMgr, "memory alloc failed");
	zassert_not_null(pPowerMgr->pInMbox, "pInMbox = NULL");
	zassert_not_null(pPowerMgr->MetricsTxTimer, "MetricsTxTimer = NULL");
    zassert_equal(pPowerMgr->pInMbox->count(), 0, "pInMbox->count() != 0");
    zassert_equal(pPowerMgr->pInMbox, Mbox::getMboxById(Mbox::ePowerManager),
                  "Error getting mailbox by id");

    pPowerMgr->uart0_off();				  

	delete pPowerMgr;
}

// test function uart0_set_enable
ZTEST(tests_pm_power_mgr, test_pm_power_mgr_uart0_set_enable)
{
	PowerMgrTest* pPowerMgr = new PowerMgrTest("PowerMgr");
	zassert_not_null(pPowerMgr, "memory alloc failed");
	zassert_not_null(pPowerMgr->pInMbox, "pInMbox = NULL");
	zassert_not_null(pPowerMgr->MetricsTxTimer, "MetricsTxTimer = NULL");
    zassert_equal(pPowerMgr->pInMbox->count(), 0, "pInMbox->count() != 0");
    zassert_equal(pPowerMgr->pInMbox, Mbox::getMboxById(Mbox::ePowerManager),
                  "Error getting mailbox by id");

    pPowerMgr->uart0_set_enable(true);				  
    pPowerMgr->uart0_set_enable(false);				  

	delete pPowerMgr;
}

// test function reqRmsReport
ZTEST(tests_pm_power_mgr, test_pm_power_mgr_reqRmsReport)
{
    PoolElem* pElem;

	Mbox* pRmsStoreMbox = new Mbox("RmsStoreMbox");
    Mbox::registerMbox(pRmsStoreMbox, Mbox::eRmsStore);
	zassert_not_null(pRmsStoreMbox, "pRmsStoreMbox = NULL");

	PowerMgrTest* pPowerMgr = new PowerMgrTest("PowerMgr");
	zassert_not_null(pPowerMgr, "memory alloc failed");
	zassert_not_null(pPowerMgr->pInMbox, "pInMbox = NULL");
	zassert_not_null(pPowerMgr->MetricsTxTimer, "MetricsTxTimer = NULL");
    zassert_equal(pPowerMgr->pInMbox->count(), 0, "pInMbox->count() != 0");
    zassert_equal(pPowerMgr->pInMbox, Mbox::getMboxById(Mbox::ePowerManager),
                  "Error getting mailbox by id");

    pPowerMgr->reqRmsReport();				  

    pElem = pRmsStoreMbox->read();
    zassert_equal(pElem->mtype, msgType::eRmsReport, "Rcvd mtype != msgType::eRmsReport");
    zassert_equal(pElem->from, Mbox::ePowerManager, "Rcvd sender != Mbox::ePowerManager");

	pElem->free();
	delete pRmsStoreMbox;
	delete pPowerMgr;
}


// test function reportResetCause
ZTEST(tests_pm_power_mgr, test_pm_power_mgr_reportResetCause)
{
    PoolElem* pElem;
	std::string s;

	Mbox* pDataMgrMbox = new Mbox("DataMgrMbox");
    Mbox::registerMbox(pDataMgrMbox, Mbox::eDataManager);
	zassert_not_null(pDataMgrMbox, "pDataMgrMbox = NULL");

	PowerMgrTest* pPowerMgr = new PowerMgrTest("PowerMgr");
	zassert_not_null(pPowerMgr, "memory alloc failed");
	zassert_not_null(pPowerMgr->pInMbox, "pInMbox = NULL");
	zassert_not_null(pPowerMgr->MetricsTxTimer, "MetricsTxTimer = NULL");
    zassert_equal(pPowerMgr->pInMbox->count(), 0, "pInMbox->count() != 0");
    zassert_equal(pPowerMgr->pInMbox, Mbox::getMboxById(Mbox::ePowerManager),
                  "Error getting mailbox by id");

	pPowerMgr->reason_str = "QWERTZ";
    pPowerMgr->reportResetCause();				  

    pElem = pDataMgrMbox->read();
	s = std::string(reinterpret_cast<char*>(pElem->getBuffer()));
    zassert_equal(pElem->mtype, msgType::eResetCause, "Rcvd mtype != msgType::eResetCause");
    zassert_equal(pElem->from, Mbox::ePowerManager, "Rcvd sender != Mbox::ePowerManager");
	zassert_equal(strcmp(s.c_str(), "QWERTZ"), 0, "Wrong rcvd string");

	pElem->free();
	delete pDataMgrMbox;
	delete pPowerMgr;
}

// test function reportBootCnt
ZTEST(tests_pm_power_mgr, test_pm_power_mgr_reportBootCnt)
{
    PoolElem* pElem;

	Mbox* pDataMgrMbox = new Mbox("DataMgrMbox");
    Mbox::registerMbox(pDataMgrMbox, Mbox::eDataManager);
	zassert_not_null(pDataMgrMbox, "pDataMgrMbox = NULL");

	PowerMgrTest* pPowerMgr = new PowerMgrTest("PowerMgr");
	zassert_not_null(pPowerMgr, "memory alloc failed");
	zassert_not_null(pPowerMgr->pInMbox, "pInMbox = NULL");
	zassert_not_null(pPowerMgr->MetricsTxTimer, "MetricsTxTimer = NULL");
    zassert_equal(pPowerMgr->pInMbox->count(), 0, "pInMbox->count() != 0");
    zassert_equal(pPowerMgr->pInMbox, Mbox::getMboxById(Mbox::ePowerManager),
                  "Error getting mailbox by id");

	pPowerMgr->boot_cnt = 17;
    pPowerMgr->reportBootCnt();				  

    pElem = pDataMgrMbox->read();
    int32_t cnt = *reinterpret_cast<int32_t*>(pElem->getBuffer());
    zassert_equal(pElem->mtype, msgType::eBootCnt, "Rcvd mtype != msgType::eBootCnt");
    zassert_equal(pElem->from, Mbox::ePowerManager, "Rcvd sender != Mbox::ePowerManager");
	zassert_equal(cnt, 17, "Wrong boot count");

	pElem->free();
	delete pDataMgrMbox;
	delete pPowerMgr;
}

// test function MetricsTxTimer_cb and MetricsTxTimer_expired
ZTEST(tests_pm_power_mgr, test_pm_power_mgr_timer_cb)
{
    PoolElem* pElem;

	PowerMgrTest* pPowerMgr = new PowerMgrTest("PowerMgr");
	zassert_not_null(pPowerMgr, "memory alloc failed");
	zassert_not_null(pPowerMgr->pInMbox, "pInMbox = NULL");
	zassert_not_null(pPowerMgr->MetricsTxTimer, "MetricsTxTimer = NULL");
    zassert_equal(pPowerMgr->pInMbox->count(), 0, "pInMbox->count() != 0");
    zassert_equal(pPowerMgr->pInMbox, Mbox::getMboxById(Mbox::ePowerManager),
                  "Error getting mailbox by id");

    pPowerMgr->MetricsTxTimer_cb(reinterpret_cast<k_timer*>(pPowerMgr));

    zassert_equal(pPowerMgr->pInMbox->count(), 1, "pInMbox->count() != 1");
    pElem = pPowerMgr->pInMbox->read();
    zassert_equal(pElem->mtype, msgType::eMetricsTxTimerExpired, "Rcvd mtype != msgType::eMetricsTxTimerExpired");

    delete pPowerMgr;
}    

// test function registerMetricProvider, metricProviderNotify and metricProviderNotifyAll
ZTEST(tests_pm_power_mgr, test_pm_power_mgr_metricProvider)
{
    PoolElem* pElem;

	Mbox* pDataMgrMbox = new Mbox("DataMgrMbox");
    Mbox::registerMbox(pDataMgrMbox, Mbox::eDataManager);
	zassert_not_null(pDataMgrMbox, "pDataMgrMbox = NULL");

	Mbox* pRmsStoreMbox = new Mbox("RmsStoreMbox");
    Mbox::registerMbox(pRmsStoreMbox, Mbox::eRmsStore);
	zassert_not_null(pRmsStoreMbox, "pRmsStoreMbox = NULL");

	PowerMgrTest* pPowerMgr = new PowerMgrTest("PowerMgr");
	zassert_not_null(pPowerMgr, "memory alloc failed");
	zassert_not_null(pPowerMgr->pInMbox, "pInMbox = NULL");
	zassert_not_null(pPowerMgr->MetricsTxTimer, "MetricsTxTimer = NULL");
    zassert_equal(pPowerMgr->pInMbox->count(), 0, "pInMbox->count() != 0");
    zassert_equal(pPowerMgr->pInMbox, Mbox::getMboxById(Mbox::ePowerManager),
                  "Error getting mailbox by id");

    pPowerMgr->registerMetricProvider(Mbox::eDataManager, msgType::eBattReport);				  
    pPowerMgr->registerMetricProvider(Mbox::eRmsStore, msgType::eBattReport);	

	pPowerMgr->metricProviderNotifyAll();			  

    pElem = pDataMgrMbox->read();
    zassert_equal(pElem->mtype, msgType::eBattReport, "Rcvd mtype != msgType::eBattReport");
    zassert_equal(pElem->from, Mbox::ePowerManager, "Rcvd sender != Mbox::ePowerManager");
	pElem->free();

    pElem = pRmsStoreMbox->read();
    zassert_equal(pElem->mtype, msgType::eBattReport, "Rcvd mtype != msgType::eBattReport");
    zassert_equal(pElem->from, Mbox::ePowerManager, "Rcvd sender != Mbox::ePowerManager");

	pElem->free();
	delete pDataMgrMbox;
	delete pPowerMgr;
}

// test function task
ZTEST(tests_pm_power_mgr, test_pm_power_mgr_task)
{
	PowerMgrTest* pPowerMgr = new PowerMgrTest("PowerMgr");
	zassert_not_null(pPowerMgr, "memory alloc failed");
	zassert_not_null(pPowerMgr->pInMbox, "pInMbox = NULL");
	zassert_not_null(pPowerMgr->MetricsTxTimer, "MetricsTxTimer = NULL");
    zassert_equal(pPowerMgr->pInMbox->count(), 0, "pInMbox->count() != 0");
    zassert_equal(pPowerMgr->pInMbox, Mbox::getMboxById(Mbox::ePowerManager),
                  "Error getting mailbox by id");

    //gbRetVal = false;
	pPowerMgr->pInMbox->write(NULL);
    pPowerMgr->task();

    delete pPowerMgr;
}    

// test function task
ZTEST(tests_pm_power_mgr, test_pm_power_mgr_task2)
{
    PoolElem* e1 = new PoolElem(eTimerExpired, Mbox::MboxId::eDemoTask);
    e1->buf = NULL;
    e1->bufLen = 0;

	PowerMgrTest* pPowerMgr = new PowerMgrTest("PowerMgr");
	zassert_not_null(pPowerMgr, "memory alloc failed");
	zassert_not_null(pPowerMgr->pInMbox, "pInMbox = NULL");
	zassert_not_null(pPowerMgr->MetricsTxTimer, "MetricsTxTimer = NULL");
    zassert_equal(pPowerMgr->pInMbox->count(), 0, "pInMbox->count() != 0");
    zassert_equal(pPowerMgr->pInMbox, Mbox::getMboxById(Mbox::ePowerManager),
                  "Error getting mailbox by id");

    gbRetVal = true;
	pPowerMgr->pInMbox->write(e1);
    zassert_equal(pPowerMgr->pInMbox->count(), 1, "pInMbox->count() != 1");

    pPowerMgr->task();
    zassert_equal(pPowerMgr->pInMbox->count(), 0, "pInMbox->count() != 0");

    delete pPowerMgr;
}    

// test function task
ZTEST(tests_pm_power_mgr, test_pm_power_mgr_task3)
{
    PoolElem* e1 = new PoolElem(eTimerExpired, Mbox::MboxId::eDemoTask);
    e1->buf = NULL;
    e1->bufLen = 0;

	PowerMgrTest* pPowerMgr = new PowerMgrTest("PowerMgr");
	zassert_not_null(pPowerMgr, "memory alloc failed");
	zassert_not_null(pPowerMgr->pInMbox, "pInMbox = NULL");
	zassert_not_null(pPowerMgr->MetricsTxTimer, "MetricsTxTimer = NULL");
    zassert_equal(pPowerMgr->pInMbox->count(), 0, "pInMbox->count() != 0");
    zassert_equal(pPowerMgr->pInMbox, Mbox::getMboxById(Mbox::ePowerManager),
                  "Error getting mailbox by id");

    gbRetVal = false;
	pPowerMgr->pInMbox->write(e1);
    zassert_equal(pPowerMgr->pInMbox->count(), 1, "pInMbox->count() != 1");

    pPowerMgr->task();
    zassert_equal(pPowerMgr->pInMbox->count(), 0, "pInMbox->count() != 0");

    delete pPowerMgr;
}    

// test function configure
ZTEST(tests_pm_power_mgr, test_pm_power_mgr_configure)
{
	PowerMgrTest* pPowerMgr = new PowerMgrTest("PowerMgr");
	zassert_not_null(pPowerMgr, "memory alloc failed");
	zassert_not_null(pPowerMgr->pInMbox, "pInMbox = NULL");
	zassert_not_null(pPowerMgr->MetricsTxTimer, "MetricsTxTimer = NULL");
    zassert_equal(pPowerMgr->pInMbox->count(), 0, "pInMbox->count() != 0");
    zassert_equal(pPowerMgr->pInMbox, Mbox::getMboxById(Mbox::ePowerManager),
                  "Error getting mailbox by id");

	Config::inst()->cfgMetrics.interval = "10";

    pPowerMgr->configure();
    zassert_equal(pPowerMgr->metricsTmo, 600, "metricsTmo != 600");
    zassert_equal(pPowerMgr->MetricsTxTimer->duration, 600, "duration != 600");
    zassert_equal(pPowerMgr->MetricsTxTimer->period, 600, "period != 600");

    delete pPowerMgr;
}    
```

## src/test_reset_ctrl.cpp
```c
#include <zephyr/ztest.h>
//#include <vector>
//#include <algorithm>

#define private public
#include "pm/reset_ctrl.h"

#include "stubs.h"

ZTEST_SUITE(tests_pm_reset_ctrl, NULL, NULL, NULL, NULL, NULL);

// test constructor and destructor
ZTEST(tests_pm_reset_ctrl, test_pm_reset_ctrl_constructor)
{
	ResetCtrl* pResetCtrl = new ResetCtrl("ResetCtrl");
	zassert_not_null(pResetCtrl, "memory alloc failed");
	zassert_not_null(pResetCtrl->pInMbox, "pInMbox = NULL");
	zassert_not_null(pResetCtrl->myTimer, "myTimer = NULL");
    zassert_equal(pResetCtrl->pInMbox->count(), 0, "pInMbox->count() != 0");
    zassert_equal(pResetCtrl->pInMbox, Mbox::getMboxById(Mbox::eResetCtrl),
                  "Error getting mailbox by id");

	delete pResetCtrl;
}

// MISSING for 100% branch coverage operator new does not deliver NULL
// here code lines 
// pInMbox = new Mbox(name); 
// myTimer = new Timer(ResetCtrl::timer_cb, this, 7 * 24 * 60 * 60, 7 * 24 * 60 * 60);
// static PoolElem e1 = {eTimerExpired, Mbox::MboxId::eResetCtrl, 'n', 't'};
// are not covered completly.



// test function timer_cb and timer1_expired
ZTEST(tests_pm_reset_ctrl, test_pm_reset_ctrl_timer_cb)
{
    PoolElem* pElem;

	ResetCtrl* pResetCtrl = new ResetCtrl("ResetCtrl");
	zassert_not_null(pResetCtrl, "memory alloc failed");
	zassert_not_null(pResetCtrl->pInMbox, "pInMbox = NULL");
	zassert_not_null(pResetCtrl->myTimer, "myTimer = NULL");
    zassert_equal(pResetCtrl->pInMbox->count(), 0, "pInMbox->count() != 0");
    zassert_equal(pResetCtrl->pInMbox, Mbox::getMboxById(Mbox::eResetCtrl),
                  "Error getting mailbox by id");

    pResetCtrl->timer_cb(reinterpret_cast<k_timer*>(pResetCtrl));

    zassert_equal(pResetCtrl->pInMbox->count(), 1, "pInMbox->count() != 1");
    pElem = pResetCtrl->pInMbox->read();
    zassert_equal(pElem->mtype, msgType::eTimerExpired, "Rcvd mtype != msgType::eTimerExpired");

    delete pResetCtrl;
}    

// test function trigger
ZTEST(tests_pm_reset_ctrl, test_pm_reset_ctrl_trigger)
{
	ResetCtrl* pResetCtrl = new ResetCtrl("ResetCtrl");
	zassert_not_null(pResetCtrl, "memory alloc failed");
	zassert_not_null(pResetCtrl->pInMbox, "pInMbox = NULL");
	zassert_not_null(pResetCtrl->myTimer, "myTimer = NULL");
    zassert_equal(pResetCtrl->pInMbox->count(), 0, "pInMbox->count() != 0");
    zassert_equal(pResetCtrl->pInMbox, Mbox::getMboxById(Mbox::eResetCtrl),
                  "Error getting mailbox by id");

    pResetCtrl->trigger();

	delete pResetCtrl;
}

// test function performSwReset
ZTEST(tests_pm_reset_ctrl, test_pm_reset_ctrl_performSwReset)
{
	ResetCtrl* pResetCtrl = new ResetCtrl("ResetCtrl");
	zassert_not_null(pResetCtrl, "memory alloc failed");
	zassert_not_null(pResetCtrl->pInMbox, "pInMbox = NULL");
	zassert_not_null(pResetCtrl->myTimer, "myTimer = NULL");
    zassert_equal(pResetCtrl->pInMbox->count(), 0, "pInMbox->count() != 0");
    zassert_equal(pResetCtrl->pInMbox, Mbox::getMboxById(Mbox::eResetCtrl),
                  "Error getting mailbox by id");

    gbRetVal = true;
    pResetCtrl->performSwReset();

	delete pResetCtrl;
}

// test function performSwReset
ZTEST(tests_pm_reset_ctrl, test_pm_reset_ctrl_performSwReset2)
{
	ResetCtrl* pResetCtrl = new ResetCtrl("ResetCtrl");
	zassert_not_null(pResetCtrl, "memory alloc failed");
	zassert_not_null(pResetCtrl->pInMbox, "pInMbox = NULL");
	zassert_not_null(pResetCtrl->myTimer, "myTimer = NULL");
    zassert_equal(pResetCtrl->pInMbox->count(), 0, "pInMbox->count() != 0");
    zassert_equal(pResetCtrl->pInMbox, Mbox::getMboxById(Mbox::eResetCtrl),
                  "Error getting mailbox by id");

    gbRetVal = false;
    pResetCtrl->performSwReset();

	delete pResetCtrl;
}

//Test receive msg eTimerExpired 
ZTEST(tests_pm_reset_ctrl, test_pm_reset_ctrl_rcv_msg_eTimerExpired)
{
	ResetCtrl* pResetCtrl = new ResetCtrl("ResetCtrl");
	zassert_not_null(pResetCtrl, "memory alloc failed");
	zassert_not_null(pResetCtrl->pInMbox, "pInMbox = NULL");
	zassert_not_null(pResetCtrl->myTimer, "myTimer = NULL");
    zassert_equal(pResetCtrl->pInMbox->count(), 0, "pInMbox->count() != 0");
    zassert_equal(pResetCtrl->pInMbox, Mbox::getMboxById(Mbox::eResetCtrl),
                  "Error getting mailbox by id");

    Mbox::sendMsg(msgType::eTimerExpired, Mbox::eResetCtrl, Mbox::eResetCtrl);

    zassert_equal(pResetCtrl->pInMbox->count(), 1, "pInMbox->count() != 1");

    pResetCtrl->task();  

    zassert_equal(pResetCtrl->pInMbox->count(), 0, "pInMbox->count() != 0");

	delete pResetCtrl; 
}

//Test receive msg eColdStartReq 
ZTEST(tests_pm_reset_ctrl, test_pm_reset_ctrl_rcv_msg_eColdStartReq)
{
	ResetCtrl* pResetCtrl = new ResetCtrl("ResetCtrl");
	zassert_not_null(pResetCtrl, "memory alloc failed");
	zassert_not_null(pResetCtrl->pInMbox, "pInMbox = NULL");
	zassert_not_null(pResetCtrl->myTimer, "myTimer = NULL");
    zassert_equal(pResetCtrl->pInMbox->count(), 0, "pInMbox->count() != 0");
    zassert_equal(pResetCtrl->pInMbox, Mbox::getMboxById(Mbox::eResetCtrl),
                  "Error getting mailbox by id");

    Mbox::sendMsg(msgType::eColdStartReq, Mbox::eResetCtrl, Mbox::eResetCtrl);

    zassert_equal(pResetCtrl->pInMbox->count(), 1, "pInMbox->count() != 1");

    pResetCtrl->task();  

    zassert_equal(pResetCtrl->pInMbox->count(), 0, "pInMbox->count() != 0");

	delete pResetCtrl; 
}

//Test receive unexpected msg 
ZTEST(tests_pm_reset_ctrl, test_pm_reset_ctrl_rcv_msg_unexpected)
{
	ResetCtrl* pResetCtrl = new ResetCtrl("ResetCtrl");
	zassert_not_null(pResetCtrl, "memory alloc failed");
	zassert_not_null(pResetCtrl->pInMbox, "pInMbox = NULL");
	zassert_not_null(pResetCtrl->myTimer, "myTimer = NULL");
    zassert_equal(pResetCtrl->pInMbox->count(), 0, "pInMbox->count() != 0");
    zassert_equal(pResetCtrl->pInMbox, Mbox::getMboxById(Mbox::eResetCtrl),
                  "Error getting mailbox by id");

    Mbox::sendMsg(msgType::eResetCause, Mbox::eResetCtrl, Mbox::eResetCtrl);

    zassert_equal(pResetCtrl->pInMbox->count(), 1, "pInMbox->count() != 1");

    pResetCtrl->task();  

    zassert_equal(pResetCtrl->pInMbox->count(), 0, "pInMbox->count() != 0");
	delete pResetCtrl; 
}

//Test receive no msg 
ZTEST(tests_pm_reset_ctrl, test_pm_reset_ctrl_rcv_msg_none)
{
	ResetCtrl* pResetCtrl = new ResetCtrl("ResetCtrl");
	zassert_not_null(pResetCtrl, "memory alloc failed");
	zassert_not_null(pResetCtrl->pInMbox, "pInMbox = NULL");
	zassert_not_null(pResetCtrl->myTimer, "myTimer = NULL");
    zassert_equal(pResetCtrl->pInMbox->count(), 0, "pInMbox->count() != 0");
    zassert_equal(pResetCtrl->pInMbox, Mbox::getMboxById(Mbox::eResetCtrl),
                  "Error getting mailbox by id");

    pResetCtrl->pInMbox->write(NULL);
    
    pResetCtrl->task();  

    zassert_equal(pResetCtrl->pInMbox->count(), 0, "pInMbox->count() != 0");
	delete pResetCtrl; 
}
```

## src/test_reset_reason.cpp
```c
#include <zephyr/ztest.h>
//#include <vector>
//#include <algorithm>

#define private public
#include "pm/reset_reason.h"

#include "stubs.h"

ZTEST_SUITE(tests_pm_reset_reason, NULL, NULL, NULL, NULL, NULL);

// test constructor and destructor
ZTEST(tests_pm_reset_reason, test_pm_reset_reason_constructor)
{
	ResetReason* pResetReason = new ResetReason();

	zassert_not_null(pResetReason, "memory alloc failed");

	delete pResetReason;
}

// MISSING for 100% branch coverage static instantiation does not deliver NULL
// here code line 
// static ResetReason myInstance;
// are not covered completly.



// test function get
ZTEST(tests_pm_reset_reason, test_pm_reset_reason_get)
{
	std::string r;
	unsigned int m;

	gu32Val = 0;
	gIntVal = 1;
	ResetReason::inst()->get(&m, &r);
	zassert(strcmp(r.c_str(), "POR")==0, "reset reason not POR");

	gu32Val = NRFX_RESET_REASON_RESETPIN_MASK;
	ResetReason::inst()->get(&m, &r);
	zassert(strcmp(r.c_str(), "PIN")==0, "reset reason not PIN");

	gu32Val = NRFX_RESET_REASON_DOG_MASK;
	ResetReason::inst()->get(&m, &r);
	zassert(strcmp(r.c_str(), "WDT")==0, "reset reason not WDT");

	gu32Val = NRFX_RESET_REASON_SREQ_MASK;
	ResetReason::inst()->get(&m, &r);
	zassert(strcmp(r.c_str(), "SWR")==0, "reset reason not SWR");

	gu32Val = NRFX_RESET_REASON_LOCKUP_MASK;
	ResetReason::inst()->get(&m, &r);
	zassert(strcmp(r.c_str(), "LCK")==0, "reset reason not LCK");

	gu32Val = NRFX_RESET_REASON_OFF_MASK;
	ResetReason::inst()->get(&m, &r);
	zassert(strcmp(r.c_str(), "OFF")==0, "reset reason not OFF");

	gu32Val = NRFX_RESET_REASON_DIF_MASK;
	ResetReason::inst()->get(&m, &r);
	zassert(strcmp(r.c_str(), "DBG")==0, "reset reason not DBG");

	gu32Val = 0x10000000;
	ResetReason::inst()->get(&m, &r);
	zassert(strcmp(r.c_str(), "???")==0, "reset reason not ???");

	gIntVal = 2;
	gu32Val = NRFX_RESET_REASON_RESETPIN_MASK | NRFX_RESET_REASON_DOG_MASK;
	ResetReason::inst()->get(&m, &r);
	zassert(strcmp(r.c_str(), "PINWDT")==0, "reset reason not PINWDT");
}
```
