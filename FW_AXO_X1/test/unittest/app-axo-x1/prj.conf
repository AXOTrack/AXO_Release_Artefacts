## CMakeLists.txt
```
cmake_minimum_required(VERSION 3.20.0)
find_package(Zephyr REQUIRED HINTS $ENV{ZEPHYR_BASE})
project(app-axo-x1)

FILE(GLOB app_sources src/test_version.cpp
                      src/test_main.cpp
                      src/stubs.cpp
)
target_sources(app PRIVATE ${app_sources}
	../../app-axo-x1/src/version.cpp
	../../app-axo-x1/src/main.cpp
)


zephyr_include_directories(../../include)
zephyr_include_directories(../../common/src)
zephyr_include_directories(../../app-axo-x1/src)

zephyr_compile_options(-Wno-pointer-arith -Wno-unused-variable -Wno-psabi)
```

## prj.conf
```kconfig
CONFIG_ZTEST=y
CONFIG_ZTEST_NEW_API=y

CONFIG_MAIN_STACK_SIZE=8192
#4096

CONFIG_ZTEST_STACK_SIZE=65536
#32768

CONFIG_LOG=y
CONFIG_PRINTK=y
CONFIG_CPLUSPLUS=y
CONFIG_LIB_CPLUSPLUS=y
CONFIG_EXCEPTIONS=n
CONFIG_STD_CPP17=y
CONFIG_NEWLIB_LIBC=y
CONFIG_NEWLIB_LIBC_MIN_REQUIRED_HEAP_SIZE=4096

# disable assert macros
CONFIG_ASSERT=n
CONFIG_ASSERT_TEST=n

# memory usage
CONFIG_MEM_SLAB_TRACE_MAX_UTILIZATION=y 
CONFIG_SYS_HEAP_RUNTIME_STATS=y

CONFIG_HEAP_MEM_POOL_SIZE=16384

CONFIG_CBPRINTF_FP_SUPPORT=y

# CJSON
CONFIG_NEWLIB_LIBC_FLOAT_PRINTF=y
CONFIG_CJSON_LIB=y

CONFIG_NUM_COOP_PRIORITIES=10
CONFIG_NUM_PREEMPT_PRIORITIES=10
CONFIG_SCHED_SCALABLE=y

# Enable thread awareness for debugging tools supporting it
CONFIG_INIT_STACKS=y
CONFIG_THREAD_NAME=y
CONFIG_THREAD_STACK_INFO=y
CONFIG_THREAD_RUNTIME_STATS=y
CONFIG_THREAD_MONITOR=y
CONFIG_DEBUG_THREAD_INFO=y

#CONFIG_UNIT_TEST=y
CONFIG_UNIT_TEST_APP_AXO_X1=y
CONFIG_COVERAGE=y
CONFIG_COVERAGE_DUMP=y
```

## src/stubs.cpp
```c
#define private public

#include "stubs.h"

Config* Config::inst() {
    static Config myInstance;
    return &myInstance;
}

Config::Config() { }
Config::~Config() { }
void Config::init() { }

KeyGen* KeyGen::inst() {
    static KeyGen myInstance;
    return &myInstance;
}

KeyGen::KeyGen() { }
KeyGen::~KeyGen() { }
void KeyGen::init() { }

WakeupCnt* WakeupCnt::inst() {
    static WakeupCnt myInstance;
    return &myInstance;
}

WakeupCnt::WakeupCnt() { }
WakeupCnt::~WakeupCnt() { }
void WakeupCnt::init() { }
uint32_t WakeupCnt::getSleepExitCount() {
    return 0;
}

uint32_t WakeupCnt::getPublishMeasCount() {
    return 0;
}

void LteConnector::registerListener(Mbox* listener) { }
void ADConverter::registerListener(uint8_t chmask, Mbox* listener) { }

FlashFS::FlashFS(const char* name) { }

FlashFS& FlashFS::inst() {
    static FlashFS myInstance("fs");
    return myInstance;
}

FlashFS::~FlashFS() { }

bool FlashFS::file_exists(const char* path) {
    return false;
}

void FlashFS::CheckAvailableSpace() { }
```

## src/stubs.h
```c
#ifndef __STUBS_H__
#define __STUBS_H__

#include "rtos/mbox.h"
#include "rtos/task.h"

//! Definition of FRAM raw data storage time
//! when diplacement calculation is enabled
#define FRAM_5_SEC_RAW_DATA_SPACE     5

#define k_sleep(x) 

typedef uint8_t gpio_pin_t;
typedef uint16_t gpio_dt_flags_t;

struct gpio_dt_spec {
        //const struct device *port;
        gpio_pin_t pin;
        gpio_dt_flags_t dt_flags;
};


class PowerMgrX1 {
 public:
    Mbox* pInMbox;
    PowerMgrX1(const char* name = "??") {};
    void create(k_thread_stack_t*, size_t, int) {};
    void configure() {};
    void start() {};
};

class BoostConverter {
 public:
    BoostConverter(const char* name = "??") {};
    void create(k_thread_stack_t*, size_t, int) {};
    void configure() {};
    void start() {};
};

class LteConnector {
 public:
    LteConnector(const char* name = "??") {};
    void create(k_thread_stack_t*, size_t, int) {};
    void configure() {};
    void start() {};
    void registerListener(Mbox* listener);
};

class LteMonitor {
 public:
    LteMonitor(const char* name = "??") {};
    void create(k_thread_stack_t*, size_t, int) {};
    void configure() {};
    void start() {};
    void register_link_quality_notifications() {};
    void resume_link_quality_notifications() {};
    void register_network_notifications() {};
    void resume_network_notifications() {};
};

class Shtcx {
 public:
    Shtcx(const char* name = "??") {};
    void create(k_thread_stack_t*, size_t, int) {};
    void configure() {};
    void start() {};
};

class MqttConnector {
 public:
    Mbox* pInMbox;
    MqttConnector(const char* name = "??") {};
    void create(k_thread_stack_t*, size_t, int) {};
    void configure() {};
    void start() {};
};

class HttpConnector {
 public:
    Mbox* pInMbox;
    HttpConnector(const char* name = "??") {};
    void create(k_thread_stack_t*, size_t, int) {};
    void configure() {};
    void start() {};
};

class DataManager {
 public:
    DataManager(const char* name = "??") {};
    void create(k_thread_stack_t*, size_t, int) {};
    void configure() {};
    void start() {};
};

class ADConverter {
 public:
    ADConverter(const char* name = "??") {};
    void create(k_thread_stack_t*, size_t, int) {};
    void configure() {};
    void start() {};
    void registerListener(uint8_t chmask, Mbox* listener);
};

class BatteryMgr {
 public:
    Mbox* pInMbox;
    BatteryMgr(const char* name = "??") {};
    void create(k_thread_stack_t*, size_t, int) {};
    void configure() {};
    void start() {};
    uint8_t getAdcChannels() { return 1; }
};

class HwMetrics {
 public:
    HwMetrics(const char* name = "??") {};
    void create(k_thread_stack_t*, size_t, int) {};
    void configure() {};
    void start() {};
};

class Adxl37x {
 public:
    Adxl37x(const char* name = "??") {};
    enum { odr = 4400 };         //!< Output data rate max with external sync
    void create(k_thread_stack_t*, size_t, int) {};
    void configure() {};
    void start() {};
};

class AdxlDataStore {
 public:
    AdxlDataStore(const char* name, uint8_t num_seconds,
                   uint16_t samples_per_sec, bool have_http_connector=false) {};
    void create(k_thread_stack_t*, size_t, int) {};
    void configure() {};
    void start() {};
};

class RmsStore {
 public:
    RmsStore(const char* name, uint8_t num_seconds) {};
    void create(k_thread_stack_t*, size_t, int) {};
    void configure() {};
    void start() {};
};

class RmsTask {
 public:
    RmsTask(const char* name, uint8_t num_seconds,
                 uint16_t samples_per_sec) {};
    void create(k_thread_stack_t*, size_t, int) {};
    void configure() {};
    void start() {};
};

class DispTask {
 public:
    DispTask(const char* name = "??") {};
    void create(k_thread_stack_t*, size_t, int) {};
    void configure() {};
    void start() {};
};

class FwUpd {
 public:
    FwUpd(const char* name = "??") {};
    void create(k_thread_stack_t*, size_t, int) {};
    void configure() {};
    void start() {};
};

class FwUpdCtrl {
 public:
    FwUpdCtrl(const char* name = "??") {};
    void create(k_thread_stack_t*, size_t, int) {};
    void configure() {};
    void start() {};
};

class ResetCtrl {
 public:
    ResetCtrl(const char* name = "??") {};
    void create(k_thread_stack_t*, size_t, int) {};
    void configure() {};
    void start() {};
};

class Config {
 public:
    static Config* inst();
    void init();
    virtual ~Config();
 private:
    Config();
};

class KeyGen {
 public:
    static KeyGen* inst();
    void init();
    virtual ~KeyGen();
 private:
    KeyGen();
};

class WakeupCnt {
 public:
    static WakeupCnt* inst();
    void init();
    virtual ~WakeupCnt();
    uint32_t getSleepExitCount();
    uint32_t getPublishMeasCount();
 private:
    WakeupCnt();
};

class FlashFS {
 public:
    explicit FlashFS(const char* name = "??");

    static FlashFS& inst();
    FlashFS() = delete;
    virtual ~FlashFS();
    bool file_exists(const char* path);
    void CheckAvailableSpace();
};

#endif // __STUBS_H__
```

## src/test_main.cpp
```c
#include <zephyr/ztest.h>

#define private public
#include "../../../app-axo-x1/src/version.h"

#include "stubs.h"

extern int maintest();

ZTEST_SUITE(tests_app_axo_x1_main, NULL, NULL, NULL, NULL, NULL);

// test constructor and destructor
ZTEST(tests_app_axo_x1_main, test_app_axo_x1_main)
{
	maintest();
}
```

## src/test_version.cpp
```c
#include <zephyr/ztest.h>

//#define private public
#include "../../../app-axo-x1/src/version.h"

//#include "stubs.h"

ZTEST_SUITE(tests_app_axo_x1_version, NULL, NULL, NULL, NULL, NULL);

// test function getFwVersion
ZTEST(tests_app_axo_x1_version, test_app_axo_x1_version_getFwVersion)
{
	const char* pVer = getFwVersion();

	zassert(strcmp(pVer, "2.35")==0, 
                   "version %s not correct", pVer);
}

// test function displayFwVersion
ZTEST(tests_app_axo_x1_version, test_app_axo_x1_version_displayFwVersion)
{
	displayFwVersion();
}
```
