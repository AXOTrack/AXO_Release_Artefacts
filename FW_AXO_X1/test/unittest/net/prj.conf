## CMakeLists.txt
```
cmake_minimum_required(VERSION 3.20.0)
find_package(Zephyr REQUIRED HINTS $ENV{ZEPHYR_BASE})
project(net)


# NOTE: stubs.cpp must be first module, for linker links stub functions 
# before lib functions
FILE(GLOB app_sources src/stubs.cpp    
                      src/test_http_connector.cpp
                      src/test_lte_connector.cpp
                      src/test_mqtt_connector.cpp
                      
)
target_sources(app PRIVATE ${app_sources}
	../../common/src/net/http_connector.cpp
	../../common/src/net/lte_connector.cpp
	../../common/src/net/mqtt_connector.cpp
    ../../common/src/rtos/mutex.cpp
    ../../common/src/rtos/mbox.cpp
    ../../common/src/rtos/mpool.cpp
    ../../common/src/rtos/task.cpp
    ../../common/src/rtos/timer.cpp
)


zephyr_include_directories(../../include)
zephyr_include_directories(../../common/src)
zephyr_include_directories(../../app-axo-x1/src)

zephyr_compile_options(-Wno-pointer-arith -Wno-unused-variable -Wno-psabi)
```

## prj.conf
```kconfig
CONFIG_ZTEST=y
CONFIG_ZTEST_NEW_API=y

CONFIG_MAIN_STACK_SIZE=8192
#4096

CONFIG_ZTEST_STACK_SIZE=65536
#32768

CONFIG_LOG=y
CONFIG_PRINTK=y
CONFIG_CPLUSPLUS=y
CONFIG_LIB_CPLUSPLUS=y
CONFIG_EXCEPTIONS=n
CONFIG_STD_CPP17=y
CONFIG_NEWLIB_LIBC=y
CONFIG_NEWLIB_LIBC_MIN_REQUIRED_HEAP_SIZE=4096

# disable assert macros
CONFIG_ASSERT=n
CONFIG_ASSERT_TEST=n

# memory usage
CONFIG_MEM_SLAB_TRACE_MAX_UTILIZATION=y 
CONFIG_SYS_HEAP_RUNTIME_STATS=y

CONFIG_HEAP_MEM_POOL_SIZE=16384

CONFIG_CBPRINTF_FP_SUPPORT=y

# CJSON
CONFIG_NEWLIB_LIBC_FLOAT_PRINTF=y
CONFIG_CJSON_LIB=y

CONFIG_NUM_COOP_PRIORITIES=10
CONFIG_NUM_PREEMPT_PRIORITIES=10
CONFIG_SCHED_SCALABLE=y

# Enable thread awareness for debugging tools supporting it
CONFIG_INIT_STACKS=y
CONFIG_THREAD_NAME=y
CONFIG_THREAD_STACK_INFO=y
CONFIG_THREAD_RUNTIME_STATS=y
CONFIG_THREAD_MONITOR=y
CONFIG_DEBUG_THREAD_INFO=y

CONFIG_UNIT_TEST=y
CONFIG_UNIT_TEST_NET=y
CONFIG_COVERAGE=y
CONFIG_COVERAGE_DUMP=y
```

## src/stubs.cpp
```c
#include <modem/lte_lc.h>
#include <modem/pdn.h>

#include <zephyr/net/socket.h>

#define private public
#include "rtos/mbox.h"
#include "rtos/mpelem.h"
#include "rtos/mpool.h"
#include "rtos/mqueue.h"
#include "rtos/task.h"


#include "util/keygen.h"
#include "conf/config.h"
/*#include "drv/spi/fram.h"
#include "drv/spi/adxl37x.h"
#include "./version.h"*/


#include "stubs.h"


// -------------------------------------------------------------------------

bool gbRetVal;
int gIntVal;

// -------------------------------------------------------------------------
std::allocator<uint8_t> allocBytes;


void Mbox::sendMsg(enum msgType mType, MboxId senderId, MboxId receiverId) {
    PoolElem* e1 = new PoolElem(mType, senderId);
    e1->buf = NULL;
    e1->bufLen = 0;
    Mbox::send(e1, receiverId);
}

void Mbox::sendMsg(enum msgType mType, MboxId senderId, MboxId receiverId,
                   uint8_t u8DataByte) {
    PoolElem* e1 = new PoolElem(mType, senderId);
    e1->p1 = u8DataByte;
    e1->buf = NULL;
    e1->bufLen = 0;
    Mbox::send(e1, receiverId);
}

void Mbox::sendMsg(enum msgType mType, MboxId senderId, MboxId receiverId,
                   int8_t s8DataByte) {
    PoolElem* e1 = new PoolElem(mType, senderId);
    e1->p2 = s8DataByte;
    e1->buf = NULL;
    e1->bufLen = 0;
    Mbox::send(e1, receiverId);
}

void Mbox::sendMsg(enum msgType mType, MboxId senderId, MboxId receiverId,
                        uint8_t* pData, uint16_t dataLen) {
    PoolElem* e1 = new PoolElem(mType, senderId);
        
    uint8_t* b = allocBytes.allocate(2048);
    memcpy(b, pData, dataLen);
    e1->buf = reinterpret_cast<uint8_t (*)[2048]>(b);
    //printk("sendMsg():  e1->buf = 0x%X\n\n", (unsigned int)e1->buf);
    e1->bufLen = dataLen;
    e1->mtype = mType;
    e1->from = senderId;
    Mbox::send(e1, receiverId);
}

void Mbox::sendMsg(enum msgType mType, MboxId senderId, MboxId receiverId,
                   const std::string& str) {
    PoolElem* e1 = new PoolElem(mType, senderId);
    size_t dataLen = str.size() + 1;
    uint8_t* b = allocBytes.allocate(2048);
    auto rc = snprintf(reinterpret_cast<char*>(b), dataLen, "%s", str.c_str());
    int strLen = strlen(reinterpret_cast<const char*>(b));
    dataLen = strLen ? strLen + 1 : 0;
    e1->buf = (uint8_t (*)[2048])(b);
    e1->bufLen = dataLen;
    e1->mtype = mType;
    e1->from = senderId;
    Mbox::send(e1, receiverId);
}

// -------------------------------------------------------------------------

uint8_t* PoolElem::getBuffer(void) { return *buf; }

void PoolElem::putString(const char* s) {
    std::string str = s;
    size_t dataLen = str.size() + 1;
    uint8_t* b = allocBytes.allocate(2048);
    auto rc = snprintf(reinterpret_cast<char*>(b), dataLen, "%s", str.c_str());
    int strLen = strlen(reinterpret_cast<const char*>(b));
    dataLen = strLen ? strLen + 1 : 0;
    this->buf = (uint8_t (*)[2048])(b);
    this->bufLen = dataLen;
}

void PoolElem::putData(const void* pdata, size_t len) {
    uint8_t* b = allocBytes.allocate(2048);
    memcpy(b, pdata, len);
    this->buf = reinterpret_cast<uint8_t (*)[2048]>(b);
    this->bufLen = len;
}

void PoolElem::Dump() { }

void PoolElem::free() {
    uint8_t* b = reinterpret_cast<uint8_t*>(this->buf);
    //printk("free():  this->buf = 0x%X\n\n", (unsigned int)this->buf);
    //printk("free():  0x%.2X%.2X%.2X%.2X\n\n", (*(uint8_t*)this->buf[0]), 
    //                                  (*(uint8_t*)this->buf[1]),
    //                                  (*(uint8_t*)this->buf[2]), 
    //                                  (*(uint8_t*)this->buf[3]));
    if (this->buf != NULL) {
        allocBytes.deallocate(reinterpret_cast<uint8_t*>(this->buf), 2048);
        this->buf = NULL;
        this->bufLen = 0;
    }
    delete this;
}

// -------------------------------------------------------------------------

void* k_timer_user_data_get(k_timer* timer) {
    return reinterpret_cast<void*>(timer);
}

// -------------------------------------------------------------------------


Hash::Hash() { }
Hash::~Hash() { }

Hash* Hash::inst() { 
    static Hash myInstance;
    return &myInstance;
}

void Hash::init() { }
void Hash::update(uint8_t* pBuf, size_t len) { }
void Hash::finalize() { }
void Hash::print() { }
uint8_t* Hash::getHash() {
    static uint8_t buf[10] = {'1','2','1','2','1','2','1','2','1','2'};
    return buf;
}
uint16_t Hash::getHashLen() {
    return 10;
}

// -------------------------------------------------------------------------

ECDSASigner::ECDSASigner() { }
ECDSASigner::~ECDSASigner() { }

ECDSASigner* ECDSASigner::inst() { 
    static ECDSASigner myInstance;
    return &myInstance;
}
    
void ECDSASigner::setPrivateKey(const std::string& pemKey) { }

std::string ECDSASigner::signHash(const unsigned char* hash, size_t hashLen) { 
    std:: string s = "1234567890";
    return s;
}

void ECDSASigner::printSignature(const std::string& signature) { }

// -------------------------------------------------------------------------

KeyGen::KeyGen() { }
KeyGen::~KeyGen() { }

KeyGen* KeyGen::inst() { 
    static KeyGen myInstance;
    return &myInstance;
}

std::string KeyGen::getPrivateKey() {
    std:: string s;
    if (gbRetVal) {
        s = "0987654321";;
    } else {
        s = "-----INVALID KEY-----";
    }
    return s;
}

bool KeyGen::bIsKeyTransfered() {
    return gbRetVal;
}

void KeyGen::setKeyTransfered() { }

uint16_t KeyGen::getPublicKey(unsigned char* pBuf, size_t len) {
    return 0;
}
 
void KeyGen::deleteKeyFiles() { }

// -------------------------------------------------------------------------

Config* Config::inst() {
    static Config myInstance;
    return &myInstance;
}

Config::Config() { }

Config::~Config() { }

stCfgGeneral* Config::getCfgGeneral() { 
    // 	std::string name;    //!< Name of the device class
	// std::string type;    //!< Type of the device
	// std::string version; //!< Version of the configuration 
    static stCfgGeneral ret = {"a","a","a"};
    return &ret;
}

stCfgMetrics* Config::getCfgMetrics() { 
    // std::string interval;
    static stCfgMetrics ret = {"2"};
    return &ret;
}

stCfgDatalog* Config::getCfgDatalog() {
    // std::string dispmodeoff; 
    // std::string rawtransferon; 
    // std::string disptransferon;  
    // std::string rms_thres;   
    // std::string max_raw_per_day;
    static stCfgDatalog ret_true = {"true","true","true","25","5"};
    static stCfgDatalog ret_false = {"false","false","false","27","7"};
    if (gbRetVal) {
        return &ret_true;
    } else {
        return &ret_false;
    }
}

stCfgDisplacement* Config::getCfgDisplacement() { 
    // std::string b1;
    static stCfgDisplacement ret = {"0.0"};
    return &ret;
}

stCfgSensor*  Config::getCfgSensor(enCfgSensorId id) { 
    // std::string name;       //!< Name of the sensor
	// std::string type;       //!< Type of the sensor
	// std::string actthres;   //!< Activation threshold
	// std::string deactthres; //!< Deactivation threshold
    static stCfgSensor ret = {"a","a","a","a"};
    return &ret;
}

unsigned char* Config::getConfigJson() { 
    static char out[32] = "qwertz";
    return (unsigned char*)out;
}

int Config::saveToFile(std::string config) {
    return 0;
}
int Config::saveToFile() {
    return 0;
}
bool Config::isValid(const char* buf) {
    return gbRetVal;
}
void Config::Autocorrection() { }
void Config::deleteConfigFile() { }




// -------------------------------------------------------------------------

const char* getFwVersion() { return "9.77"; }

// -------------------------------------------------------------------------


char gBuf[1024];

static struct fs_file_t stFile;

FlashFS::FlashFS(const char* name) { }

FlashFS& FlashFS::inst() {
    static FlashFS myInstance("fs");
    return myInstance;
}

FlashFS::~FlashFS() { }


bool FlashFS::file_exists(const char* path) {
    return gbRetVal;
}

int FlashFS::file_sync(fs_file_t* file) {
    return 0;
}

off_t FlashFS::file_seek(fs_file_t* file, off_t offset, int whence) {
    return 0;
}

fs_file_t* FlashFS::file_open(const char* path, int flags) {
    return reinterpret_cast<fs_file_t*>(this);
}

int FlashFS::file_close(fs_file_t* file) {
    return 0;
}

ssize_t FlashFS::file_read(fs_file_t* file, void* buffer, size_t len) {
    strncpy((char*)buffer, gBuf, 1024);
    return len;
}

ssize_t FlashFS::file_write(fs_file_t* file, const void* buffer, size_t len) {
    strncpy(gBuf, (char*)buffer, 1024);
    return len;
}

int FlashFS::remove(const char* filename) {
    return 0; 
}

unsigned char* FlashFS::GetFsStat(const char *path) {
    static unsigned char buf[3] = {'1', '2', '3'};
    return buf;
}

int FlashFS::unmount() {
    return 0; 
}

void FlashFS::eraseFs() { }


// -------------------------------------------------------------------------


int connect(int socket, const struct sockaddr *address, socklen_t address_len) {
    switch (gIntVal) {
        case 1:   errno = 0;  return 0;    break;
        case 2:   errno = 0;  return -17;  break;
        case 3:   errno = 11; return -17;  break;
        default:  return 0;
    }
    return 0;
}

ssize_t send(int socket, const void *buffer, size_t length, int flags) {
    switch (gIntVal) {
        case 1:   errno = 0;  return 0;    break;
        case 2:   errno = 0;  return -17;  break;
        case 3:   errno = 11; return -17;  break;
        default:  return 0;
    }
    return 0;
}

ssize_t recv(int socket, void *buffer, size_t length, int flags) {
    switch (gIntVal) {
        case 1:   errno = 0;  return 0;    break;
        case 2:   errno = 0;  return -17;  break;
        case 3:   errno = 11; return -17;  break;
        default:  return 0;
    }
    return 0;
}

//#define socklen_t uit16_t
#define 	TLS_SEC_TAG_LIST   1
#define 	TLS_HOSTNAME   2
#define 	TLS_PEER_VERIFY   5

int setsockopt(int socket, int level, int option_name, const void *option_value, socklen_t option_len) {
    if ((option_name == TLS_PEER_VERIFY) && (gIntVal == 1)) { 
        return -17; 
    }
    if ((option_name == TLS_SEC_TAG_LIST) && (gIntVal == 2)) { 
        return -17; 
    }
    if ((option_name == TLS_HOSTNAME) && (gIntVal == 3)) { 
        return -17; 
    }
    return 0;
}

int getaddrinfo(const char * nodename, const char * servname,
       const struct addrinfo * hints, struct addrinfo ** res) {
    // Speicher für addrinfo und sockaddr_in allokieren
    struct addrinfo *ai = (struct addrinfo*)malloc(sizeof(struct addrinfo));
    if (!ai) return -1;

    struct sockaddr_in *addr = (struct sockaddr_in*)malloc(sizeof(struct sockaddr_in));
    if (!addr) {
        free(ai);
        return -1;
    }

    // sockaddr_in füllen
    addr->sin_family = AF_INET;
    addr->sin_port = 0x5000; //htons(80); // z. B. Port 80
    addr->sin_addr.s_addr = 0x5db8d822;
    //inet_pton(AF_INET, "127.0.0.1", &(addr->sin_addr));

    // addrinfo füllen
    memset(ai, 0, sizeof(struct addrinfo));
    ai->ai_family = AF_INET;
    ai->ai_socktype = SOCK_STREAM;
    if (gIntVal == 0) {
        ai->ai_protocol = IPPROTO_TCP;
    } else {
        ai->ai_protocol = IPPROTO_TLS_1_2;
    }
    //ai->ai_addrlen = sizeof(struct sockaddr_in);
    ai->ai_addr = (struct sockaddr *)addr;
    //ai->ai_next = NULL;

    *res = ai;

    return gIntVal; 
}

int socket(int domain, int type, int protocol) {
    return 0;
}

int close(int fildes) {
    return 0;
}

uint16_t htons(uint16_t hostshort) {
    return 0x8000; //hostshort;
}


// -------------------------------------------------------------------------

void ResetCtrl::performSwReset() { }

// -------------------------------------------------------------------------

int mqtt_helper_publish(const struct mqtt_publish_param *param) {
    if (!gbRetVal) {
        return 17;
    }
    return 0;
}

int mqtt_helper_subscribe(struct mqtt_subscription_list *sub_list) {
    return 0;
}

int mqtt_helper_connect(struct mqtt_helper_conn_params *conn_params) {
    if (!gbRetVal) {
        return 17;
    }
    return 0;
}

int mqtt_helper_disconnect(void) {
    return 0;
}

int mqtt_helper_abort(void) {
    return 0;
}

int hw_id_get(char* buf, size_t buf_len) {
    strncpy(buf, "123456789012345", buf_len);
    return 0;
}

int mqtt_helper_init(struct mqtt_helper_cfg *cfg) {
    return 0;
}

// -------------------------------------------------------------------------

int pdn_default_ctx_cb_reg (pdn_event_handler_t cb) {
    return 0;
}
void lte_lc_register_handler(lte_lc_evt_handler_t handler) { }

int lte_lc_modem_events_enable(void) {
    return 0;
}
int lte_lc_init(void) {
    return 0;
}
int lte_lc_connect_async(lte_lc_evt_handler_t handler) {
    return 0;
}
int lte_lc_deinit(void) {
    return 0;
}
int lte_lc_offline(void) {
    return 0;
}
int lte_lc_normal(void) {
    return 0;
}
int lte_lc_psm_req(bool enable) {
    return 0;
}
int lte_lc_power_off(void) {
    return 0;
}
int lte_lc_func_mode_set(enum lte_lc_func_mode mode) {
    return 0;
}

// ----------------------------------------------------------
```

## src/stubs.h
```c
#ifndef __STUBS_H__
#define __STUBS_H__

#include <stdio.h>
#include <stdlib.h>

#include <string>

extern bool gbRetVal;
extern int gIntVal;
//extern char gBuf[1024];

void* k_timer_user_data_get(k_timer* timer);

// ------------------------------------------------------------------------------

#define SHA_HASH_SIZE 32
#define TLS_SEC_TAG 956
#define MAX_SIGNATURE_LEN 72

/*typedef struct
{
    uint32_t state; //[8];               
    //uint32_t total[2];          
    //unsigned char buffer[64];   
} mbedtls_sha256_context;*/


class Hash {
 public:
    ~Hash();

    static Hash* inst();

    void init();
    void update(uint8_t* pBuf, size_t len);
    void finalize();
    void print();

    uint8_t* getHash();
    uint16_t getHashLen();

 private:
    Hash();
    
    //mbedtls_sha256_context sha_ctx; //!< Context for SHA256 calculation  

    uint8_t hash[SHA_HASH_SIZE];  //!< The calculated SHA1 or SHA256 checksum
};

class ECDSASigner {
 public:
    ~ECDSASigner();

    static ECDSASigner* inst();
    
    void setPrivateKey(const std::string& pemKey);

    std::string signHash(const unsigned char* hash, size_t hashLen);

    void printSignature(const std::string& signature);

 private:
    ECDSASigner();
    
    //mbedtls_pk_context pk; //!< Context varaible
    //mbedtls_ctr_drbg_context ctr_drbg; //!< Context varaible
    std::string privateKeyPEM; //!< The private key in PEM format

    std::string string_to_hex(const std::string& input);
};

// ------------------------------------------------------------------------------

#define socklen_t uint32_t

typedef short unsigned int sa_family_t;

//#include <zephyr/net/net_ip.h>

/*struct sockaddr {
    int sin_family;
    int sin_port;
    uint32_t sin_addr;
};*/

struct addrinfo {
    int              ai_flags;
    int              ai_family;
    int              ai_socktype;
    int              ai_protocol;
    //socklen_t        ai_addrlen;
    struct sockaddr *ai_addr;
    //char            *ai_canonname;
    //struct addrinfo *ai_next;
};

int connect(int socket, const struct sockaddr *address, socklen_t address_len);
ssize_t send(int socket, const void *buffer, size_t length, int flags);
ssize_t recv(int socket, void *buffer, size_t length, int flags);
int setsockopt(int socket, int level, int option_name, const void *option_value, socklen_t option_len);
int getaddrinfo(const char * nodename, const char * servname,
       const struct addrinfo * hints, struct addrinfo ** res);
int socket(int domain, int type, int protocol);
int close(int fildes);

#ifdef htons
  #undef htons
#endif
uint16_t htons(uint16_t hostshort);


// ------------------------------------------------------------------------------

struct fs_file_t {
   FILE* pF;
};

#define FS_O_READ       0x01
#define FS_O_WRITE      0x02
#define FS_O_RDWR       (FS_O_READ | FS_O_WRITE)
#define FS_O_MODE_MASK  0x03
 
#define FS_O_CREATE     0x10
#define FS_O_APPEND     0x20
#define FS_O_TRUNC      0x40
#define FS_O_FLAGS_MASK 0x70
 
#define FS_SEEK_SET  0
#define FS_SEEK_CUR  1
#define FS_SEEK_END  2
 
#define MAX_FILE_NAME 128

//int file_remove(const char* path);

enum fs_dir_entry_type {
        FS_DIR_ENTRY_FILE = 0,
        FS_DIR_ENTRY_DIR
};
 struct fs_dirent {
        enum fs_dir_entry_type type;
        char name[MAX_FILE_NAME + 1];
        size_t size;
};
 
struct fs_statvfs {
        unsigned long f_bsize;
        unsigned long f_frsize;
        unsigned long f_blocks;
        unsigned long f_bfree;
};

class FlashFS {
 public:
    explicit FlashFS(const char* name = "??");

    static FlashFS& inst();
    FlashFS() = delete;
    virtual ~FlashFS();
    bool file_exists(const char* path);
    int file_sync(fs_file_t* file);
    off_t file_seek(fs_file_t* file, off_t offset, int whence);    
    fs_file_t* file_open(const char* path, int flags);
    int file_close(fs_file_t* file);
    ssize_t file_read(fs_file_t* file, void* buffer, size_t size);
    ssize_t file_write(fs_file_t* file, const void* buffer, size_t size);
    int remove(const char* path);
    static void eraseFs();
    int file_tree(const char *path);
    int statvfs(const char* path, struct fs_statvfs* buf);
    int unmount();
    int stat(const char* path, struct fs_dirent* st);
    unsigned char* GetFsStat(const char *path);
};

class ResetCtrl /*: public Task*/ {
 public:
   /* explicit ResetCtrl(const char* name = "??");
    ResetCtrl() = delete;
    virtual ~ResetCtrl();
    virtual void task(void);
    static void timer_cb(k_timer* timer);
    void timer1_expired();
    void initDevice();
    void trigger();
    Mbox* pInMbox;   //!< Mailbox of the reset control task
    Timer* myTimer;  //!< Timer to control cold start cycle period*/

    static void performSwReset();

 /*private:
    struct gpio_dt_spec trigger_gpio;  //!< Container for GPIO pin information*/
};


enum mqtt_conn_return_code {
	MQTT_CONNECTION_ACCEPTED                = 0x00,
	MQTT_UNACCEPTABLE_PROTOCOL_VERSION      = 0x01,
	MQTT_IDENTIFIER_REJECTED                = 0x02,
	MQTT_SERVER_UNAVAILABLE                 = 0x03,
	MQTT_BAD_USER_NAME_OR_PASSWORD          = 0x04,
	MQTT_NOT_AUTHORIZED                     = 0x05
};

enum mqtt_qos {
   MQTT_QOS_0_AT_MOST_ONCE = 0x00 , 
   MQTT_QOS_1_AT_LEAST_ONCE = 0x01 , 
   MQTT_QOS_2_EXACTLY_ONCE = 0x02 
};
enum mqtt_helper_error {
	/** The received payload is larger than the payload buffer. */
	MQTT_HELPER_ERROR_MSG_SIZE,
};
struct mqtt_helper_buf {
	char *ptr;
	size_t size;
};

struct mqtt_utf8 {
	const uint8_t *utf8;       /**< Pointer to UTF-8 string. */
	uint32_t size;             /**< Size of UTF string, in bytes. */
};
struct mqtt_binstr {
	uint8_t *data;             /**< Pointer to binary stream. */
	uint32_t len;              /**< Length of binary stream. */
};
struct mqtt_topic {
	struct mqtt_utf8 topic;
	uint8_t qos;
};
struct mqtt_publish_message {
	struct mqtt_topic topic;     /**< Topic on which data was published. */
	struct mqtt_binstr payload; /**< Payload on the topic published. */
};
struct mqtt_publish_param {
	struct mqtt_publish_message message;
	uint16_t message_id;
	uint8_t dup_flag : 1;
	uint8_t retain_flag : 1;
};
struct mqtt_subscription_list {
        struct mqtt_topic *list; 
        uint16_t list_count; 
        uint16_t message_id;
};
struct mqtt_helper_conn_params {
	/* The hostname must be null-terminated. */
	struct mqtt_helper_buf hostname;
	struct mqtt_helper_buf device_id;
	struct mqtt_helper_buf user_name;
	struct mqtt_helper_buf password;
};
typedef void (*mqtt_helper_handler_t)(struct mqtt_evt *evt);
typedef void (*mqtt_helper_on_connack_t)(enum mqtt_conn_return_code return_code);
typedef void (*mqtt_helper_on_disconnect_t)(int result);
typedef void (*mqtt_helper_on_publish_t)(struct mqtt_helper_buf topic_buf,
					 struct mqtt_helper_buf payload_buf);
typedef void (*mqtt_helper_on_puback_t)(uint16_t message_id, int result);
typedef void (*mqtt_helper_on_suback_t)(uint16_t message_id, int result);
typedef void (*mqtt_helper_on_pingresp_t)(void);
typedef void (*mqtt_helper_on_error_t)(enum mqtt_helper_error error);

struct mqtt_helper_cfg {
	struct {
		mqtt_helper_on_connack_t on_connack;
		mqtt_helper_on_disconnect_t on_disconnect;
		mqtt_helper_on_publish_t on_publish;
		mqtt_helper_on_puback_t on_puback;
		mqtt_helper_on_suback_t on_suback;
		mqtt_helper_on_pingresp_t on_pingresp;
		mqtt_helper_on_error_t on_error;
	} cb;
};

int mqtt_helper_publish(const struct mqtt_publish_param *param);
int mqtt_helper_subscribe(struct mqtt_subscription_list *sub_list);
int mqtt_helper_connect(struct mqtt_helper_conn_params *conn_params);
int mqtt_helper_disconnect(void);
int mqtt_helper_abort(void) ;
int hw_id_get(char* buf, size_t buf_len);
int mqtt_helper_init(struct mqtt_helper_cfg *cfg);


/*
enum pdn_event {
   PDN_EVENT_CNEC_ESM,
   PDN_EVENT_ACTIVATED,
   PDN_EVENT_DEACTIVATED,
   PDN_EVENT_IPV6_UP,
   PDN_EVENT_IPV6_DOWN,
   PDN_EVENT_NETWORK_DETACH,
   PDN_EVENT_APN_RATE_CONTROL_ON,
   PDN_EVENT_APN_RATE_CONTROL_OFF,
   PDN_EVENT_CTX_DESTROYED,
};

typedef void (*pdn_event_handler_t)(uint8_t cid, enum pdn_event event, int reason);
typedef void (*lte_lc_evt_handler_t)(const struct lte_lc_evt *const evt);

int pdn_default_ctx_cb_reg (pdn_event_handler_t cb);
void lte_lc_register_handler(lte_lc_evt_handler_t handler);
int lte_lc_modem_events_enable(void);
int lte_lc_init(void);
int lte_lc_connect_async(lte_lc_evt_handler_t handler);
int lte_lc_deinit(void);
int lte_lc_offline(void);
int lte_lc_normal(void);
int lte_lc_psm_req(bool enable);
int lte_lc_power_off(void);
*/
#endif // __STUBS_H__
```
