## CMakeLists.txt
```
cmake_minimum_required(VERSION 3.20.0)
find_package(Zephyr REQUIRED HINTS $ENV{ZEPHYR_BASE})
project(data)

FILE(GLOB app_sources #src/test_fsm.cpp
                      src/test_fwinfo.cpp
                      src/test_update.cpp
                      src/test_update_ctrl.cpp
                      src/stubs.cpp
)
target_sources(app PRIVATE ${app_sources}
	#../../common/src/update/fsm.cpp
	../../common/src/update/fwinfo.cpp
	../../common/src/update/update.cpp
	../../common/src/update/update_ctrl.cpp
    ../../common/src/rtos/mbox.cpp
    ../../common/src/rtos/task.cpp
    ../../common/src/rtos/timer.cpp
)


zephyr_include_directories(../../include)
zephyr_include_directories(../../common/src)
zephyr_include_directories(../../app-axo-x1/src)

zephyr_compile_options(-Wno-pointer-arith -Wno-unused-variable -Wno-psabi)
```

## prj.conf
```kconfig
CONFIG_ZTEST=y
CONFIG_ZTEST_NEW_API=y

CONFIG_MAIN_STACK_SIZE=8192
#4096

CONFIG_ZTEST_STACK_SIZE=65536
#32768

CONFIG_LOG=y
CONFIG_PRINTK=y
CONFIG_CPLUSPLUS=y
CONFIG_LIB_CPLUSPLUS=y
CONFIG_EXCEPTIONS=n
CONFIG_STD_CPP17=y
CONFIG_NEWLIB_LIBC=y
CONFIG_NEWLIB_LIBC_MIN_REQUIRED_HEAP_SIZE=4096

# disable assert macros
CONFIG_ASSERT=n
CONFIG_ASSERT_TEST=n

# memory usage
CONFIG_MEM_SLAB_TRACE_MAX_UTILIZATION=y 
CONFIG_SYS_HEAP_RUNTIME_STATS=y

CONFIG_HEAP_MEM_POOL_SIZE=16384

CONFIG_CBPRINTF_FP_SUPPORT=y

# CJSON
CONFIG_NEWLIB_LIBC_FLOAT_PRINTF=y
CONFIG_CJSON_LIB=y

CONFIG_NUM_COOP_PRIORITIES=10
CONFIG_NUM_PREEMPT_PRIORITIES=10
CONFIG_SCHED_SCALABLE=y

# Enable thread awareness for debugging tools supporting it
CONFIG_INIT_STACKS=y
CONFIG_THREAD_NAME=y
CONFIG_THREAD_STACK_INFO=y
CONFIG_THREAD_RUNTIME_STATS=y
CONFIG_THREAD_MONITOR=y
CONFIG_DEBUG_THREAD_INFO=y

CONFIG_UNIT_TEST=y
CONFIG_UNIT_TEST_UPDATE2=y
CONFIG_COVERAGE=y
CONFIG_COVERAGE_DUMP=y
```

## src/stubs.cpp
```c
#define private public
#include "rtos/mbox.h"
#include "rtos/mpelem.h"
#include "rtos/mpool.h"
#include "rtos/mqueue.h"
#include "rtos/task.h"
#include "rtos/task.h"
#include "update/fsm.h"
#include "update/update_ctrl.h"

#include "bus/spi/spibus.h"
#include "drv/spi/fram.h"
#include "drv/spi/adxl37x.h"
#include "conf/config.h"
#include "./version.h"


#include "stubs.h"


// -------------------------------------------------------------------------

bool gbRetVal;
int gIntVal;

// -------------------------------------------------------------------------
std::allocator<uint8_t> allocBytes;


void Mbox::sendMsg(enum msgType mType, MboxId senderId, MboxId receiverId) {
    PoolElem* e1 = new PoolElem(mType, senderId);
    e1->buf = NULL;
    e1->bufLen = 0;
    Mbox::send(e1, receiverId);
}

void Mbox::sendMsg(enum msgType mType, MboxId senderId, MboxId receiverId,
                   uint8_t u8DataByte) {
    PoolElem* e1 = new PoolElem(mType, senderId);
    e1->p1 = u8DataByte;
    e1->buf = NULL;
    e1->bufLen = 0;
    Mbox::send(e1, receiverId);
}

void Mbox::sendMsg(enum msgType mType, MboxId senderId, MboxId receiverId,
                   int8_t s8DataByte) {
    PoolElem* e1 = new PoolElem(mType, senderId);
    e1->p2 = s8DataByte;
    e1->buf = NULL;
    e1->bufLen = 0;
    Mbox::send(e1, receiverId);
}

void Mbox::sendMsg(enum msgType mType, MboxId senderId, MboxId receiverId,
                        uint8_t* pData, uint16_t dataLen) {
    PoolElem* e1 = new PoolElem(mType, senderId);
        
    uint8_t* b = allocBytes.allocate(2048);
    memcpy(b, pData, dataLen);
    e1->buf = reinterpret_cast<uint8_t (*)[2048]>(b);
    //printk("sendMsg():  e1->buf = 0x%X\n\n", (unsigned int)e1->buf);
    e1->bufLen = dataLen;
    e1->mtype = mType;
    e1->from = senderId;
    Mbox::send(e1, receiverId);
}

void Mbox::sendMsg(enum msgType mType, MboxId senderId, MboxId receiverId,
                   const std::string& str) {
    PoolElem* e1 = new PoolElem(mType, senderId);
    size_t dataLen = str.size() + 1;
    uint8_t* b = allocBytes.allocate(2048);
    auto rc = snprintf(reinterpret_cast<char*>(b), dataLen, "%s", str.c_str());
    int strLen = strlen(reinterpret_cast<const char*>(b));
    dataLen = strLen ? strLen + 1 : 0;
    e1->buf = (uint8_t (*)[2048])(b);
    e1->bufLen = dataLen;
    e1->mtype = mType;
    e1->from = senderId;
    Mbox::send(e1, receiverId);
}

// -------------------------------------------------------------------------

uint8_t* PoolElem::getBuffer(void) { return *buf; }

void PoolElem::putString(const char* s) {
    std::string str = s;
    size_t dataLen = str.size() + 1;
    uint8_t* b = allocBytes.allocate(2048);
    auto rc = snprintf(reinterpret_cast<char*>(b), dataLen, "%s", str.c_str());
    int strLen = strlen(reinterpret_cast<const char*>(b));
    dataLen = strLen ? strLen + 1 : 0;
    this->buf = (uint8_t (*)[2048])(b);
    this->bufLen = dataLen;
}

void PoolElem::putData(const void* pdata, size_t len) {
    uint8_t* b = allocBytes.allocate(2048);
    memcpy(b, pdata, len);
    this->buf = reinterpret_cast<uint8_t (*)[2048]>(b);
    this->bufLen = len;
}

void PoolElem::Dump() { }

void PoolElem::free() {
    uint8_t* b = reinterpret_cast<uint8_t*>(this->buf);
    //printk("free():  this->buf = 0x%X\n\n", (unsigned int)this->buf);
    //printk("free():  0x%.2X%.2X%.2X%.2X\n\n", (*(uint8_t*)this->buf[0]), 
    //                                  (*(uint8_t*)this->buf[1]),
    //                                  (*(uint8_t*)this->buf[2]), 
    //                                  (*(uint8_t*)this->buf[3]));
    if (this->buf != NULL) {
        allocBytes.deallocate(reinterpret_cast<uint8_t*>(this->buf), 2048);
        this->buf = NULL;
        this->bufLen = 0;
    }
    delete this;
}

// -------------------------------------------------------------------------

void* my_k_timer_user_data_get(k_timer* timer) {
    return reinterpret_cast<void*>(timer);
}

void sys_reboot (int type) { }

int64_t my_k_uptime_get (void) {
    if (gbRetVal) {
        return 7000000;
    }
    return 0;
}

// -------------------------------------------------------------------------

int fota_download_init(fota_download_callback_t client_callback) {
    return 0;
}

int fota_download_start(const char *host, const char *file, int sec_tag,
            uint8_t pdn_id, size_t fragment_size) {
    return gIntVal;
}

void fota_download_set_expected(int32_t size, uint8_t *sha1) { }

int boot_write_img_confirmed (void) {
    return 0;
}

// -------------------------------------------------------------------------


FwState* FwStateList::createIdle(void* pd) { return new FwIdle(pd); }

FwState* FwStateList::createTriggered(void* pd) { return new FwTriggered(pd); }

FwState* FwStateList::createDownload(void* pd) { return new FwDownload(pd); }

FwState* FwStateList::createReady(void* pd) { return new FwReady(pd); }

FwFsm::FwFsm(void* context, FwFsm::StateId initialState) : pd(context) {
    myStateId = initialState;
    stateTbl[eIdle] = FwStateList::createIdle;
    stateTbl[eTriggered] = FwStateList::createTriggered;
    stateTbl[eDownload] = FwStateList::createDownload;
    stateTbl[eReady] = FwStateList::createReady;
    myState = stateTbl[initialState](pd);
}

FwFsm::~FwFsm() {
    delete myState;
}

void FwFsm::setState(FwFsm::StateId newStateId) {
    if (newStateId != eNoChange) {
        delete myState;
        myState = stateTbl[myStateId = newStateId](pd);
        __ASSERT_NO_MSG(myState);
        if (newStateId != eIdle) {
            ReportOtaUpdateActive();
        }
    }
}

int FwFsm::getStateId(void) { return myStateId; }

void FwFsm::ReportOtaUpdateActive(void) {
    Mbox::sendMsg(msgType::eFwUpdateActive, 
                  Mbox::MboxId::eFwUpdCtrl,
                  Mbox::MboxId::eAdxl37xTask);
}

void FwFsm::handle_OtaStart() {
    setState(myState->handle_OtaStart());
}

void FwFsm::handle_FwInfo(PoolElem** pElem) {
    setState(myState->handle_FwInfo(pElem));
}

void FwFsm::handle_DlComplete(PoolElem** pElem) {
    setState(myState->handle_DlComplete(pElem));
}

void FwFsm::handle_Restart() {
    setState(myState->handle_OtaStart());
}

void FwFsm::handle_DlFailed(PoolElem** pElem) {
    setState(myState->handle_DlFailed(pElem));
}

void FwFsm::handle_timer_exp() {
    setState(myState->handle_timer_exp());
}

// ################# state base class #####################

FwState::FwState(void* pData) : pd(pData) {
}

FwState::~FwState(void) {  }

FwFsm::StateId FwState::handle_OtaStart() {
    // notify platform on cmd rejected
    reinterpret_cast<FwUpdCtrl*>(pd)->otaStartReject();
    return FwFsm::eNoChange;
}

FwFsm::StateId FwState::handle_FwInfo(PoolElem** pElem) {
    // notify platform on firmware rejected
    reinterpret_cast<FwUpdCtrl*>(pd)->otaFwReject();
    return FwFsm::eNoChange;
}

FwFsm::StateId FwState::handle_DlComplete(PoolElem** pElem) {
     return FwFsm::eNoChange;
}

FwFsm::StateId FwState::handle_DlFailed(PoolElem** pElem) {
   return FwFsm::eNoChange;
}

FwFsm::StateId FwState::handle_timer_exp() {
    return FwFsm::eNoChange;
}

// ################# idle state class #####################

FwIdle::FwIdle(void* pData) : FwState(pData) {
}

FwIdle::~FwIdle() {  }

FwFsm::StateId FwIdle::handle_OtaStart() {
    // notify platform on cmd accepted
    reinterpret_cast<FwUpdCtrl*>(pd)->otaStartConfirm();
    // Initiating the OTA start timer and logging the event
    // Start the trigger timeout upon receiving OTA start
    reinterpret_cast<FwUpdCtrl*>(pd)->startTimeout(FwFsm::getTriggerTimeout());
    reinterpret_cast<FwUpdCtrl*>(pd)->startTimeout(FwFsm::getDownloadTimeout());
    return FwFsm::eTriggered;
}

// ################# triggered state class #####################

FwTriggered::FwTriggered(void* pData) : FwState(pData) {
}

FwTriggered::~FwTriggered() {
}

FwFsm::StateId FwTriggered::handle_timer_exp() {
    Mbox::sendMsg(msgType::eAdxlResumeMeas,
                  Mbox::MboxId::eFwUpdCtrl, Mbox::MboxId::eAdxl37xTask);
    return FwFsm::eIdle;
}

FwFsm::StateId FwTriggered::handle_FwInfo(PoolElem** pElem) {
    // todo: check firmware info

    // for now: always accept and notify platform
    reinterpret_cast<FwUpdCtrl*>(pd)->otaFwConfirm();

    // change message sender
    (*pElem)->from = Mbox::MboxId::eFwUpdCtrl;

    // forward message to update task
    Mbox::send(*pElem, Mbox::eFwUpd);

    // prevent pElem->free() on return
    *pElem = 0;

    // Transition to the Download state and start the download timeout timer.
    // The firmware information has been accepted, and the system is now ready
    // to download the firmware. The download timeout timer is started to
    // monitor the duration of the firmware download process.
    reinterpret_cast<FwUpdCtrl*>(pd)->startTimeout(FwFsm::getDownloadTimeout());
    startDownloadTimestamp = (uint32_t)(k_uptime_get() / 1000);
    return FwFsm::eDownload;
}

// ################# firmware download state class #####################

FwDownload::FwDownload(void* pData) : FwState(pData) {
}

FwDownload::~FwDownload() { }

FwFsm::StateId FwDownload::handle_DlComplete(PoolElem** pElem) {
    // change message sender
    (*pElem)->from = Mbox::MboxId::eFwUpdCtrl;
    
    // forward message to mqtt task
    Mbox::send(*pElem, Mbox::eMqttConnector);

    // prevent pElem->free() on return
    *pElem = 0;
    return FwFsm::eReady;
}

FwFsm::StateId FwDownload::handle_DlFailed(PoolElem** pElem) {
    // Check for maximum retries(2) and transition back to idle if needed
    if (reinterpret_cast<FwUpdCtrl*>(pd)->retryCnt >=
        reinterpret_cast<FwUpdCtrl*>(pd)->maxRetries) {
       reinterpret_cast<FwUpdCtrl*>(pd)->retryCnt = 0;  // Reset retry count
        // __ASSERT(false, "Exceeded maximum download retries");

        // notify platform via device event
        // change message sender
        (*pElem)->from = Mbox::MboxId::eFwUpdCtrl;

        // forward message to mqtt task
        Mbox::send(*pElem, Mbox::eMqttConnector);

        // prevent pElem->free() on return
        *pElem = 0;

        k_sleep(K_SECONDS(2));
        sys_reboot(SYS_REBOOT_COLD);

        return FwFsm::eIdle; // never reached
    }

    // Increment the retry count(Not needed here because its incrmented in
    // startRetryTimer (But Don't remove later will be used for testing))
    // ++reinterpret_cast<FwUpdCtrl*>(pd)->retryCnt;

    // start a one-shot timer to schedule a dl retry
    reinterpret_cast<FwUpdCtrl*>(pd)->startRetryTimer();

    // stay in dl
    return FwFsm::eNoChange;
}

FwFsm::StateId FwDownload::handle_timer_exp() {
    // calculate time since download has started
    uint32_t now = (uint32_t)(k_uptime_get() / 1000);
    uint32_t diff = now - startDownloadTimestamp;

    if ((diff > maxDownloadDelay) || 
        (reinterpret_cast<FwUpdCtrl*>(pd)->retryCnt >=
        reinterpret_cast<FwUpdCtrl*>(pd)->maxRetries)) {
        //LOG_ERR("handle_timer_exp: %s", "Download failed, perform Reset!");
        std::string msg("{\"event\":\"CODE3\"}");
        Mbox::sendMsg(msgType::eFwDlFailed, Mbox::MboxId::eFwUpdCtrl,
                      Mbox::MboxId::eMqttConnector, msg);
        k_sleep(K_SECONDS(2));
        sys_reboot(SYS_REBOOT_COLD);
    } else {
        // request dl again
        reinterpret_cast<FwUpdCtrl*>(pd)->requestDownload();
        // start a one-shot timer to schedule a dl retry
        reinterpret_cast<FwUpdCtrl*>(pd)->startRetryTimer();
        return FwFsm::eNoChange;
    }
    return FwFsm::eNoChange; // to avoid warning -Wreturn-type
}

// ################# ready state class #####################

FwReady::FwReady(void* pData) : FwState(pData) {
    // start a one-shot timer, we reboot when the timer expires
    reinterpret_cast<FwUpdCtrl*>(pd)->startRebootTimer();
}

FwReady::~FwReady() {  }

FwFsm::StateId FwReady::handle_timer_exp() {
    k_sleep(K_SECONDS(3));  // otherwise we won't see the final trace messages
    sys_reboot(SYS_REBOOT_WARM);
    return FwFsm::eIdle;
}
```

## src/stubs.h
```c
#ifndef __STUBS_H__
#define __STUBS_H__

#include <stdio.h>
#include <stdlib.h>
    #include <fcntl.h>
    #include <unistd.h>

extern bool gbRetVal;
extern int gIntVal;


#define k_timer_user_data_get(x) my_k_timer_user_data_get(x)
#define k_sleep(x)  
#define k_uptime_get() my_k_uptime_get()

#define SYS_REBOOT_COLD 1
#define SYS_REBOOT_WARM 2

void* my_k_timer_user_data_get(k_timer* timer);
void sys_reboot (int type);
int64_t my_k_uptime_get (void);


// ---------------------------------------------------------------------------------

enum fota_download_evt_id {
    FOTA_DOWNLOAD_EVT_PROGRESS,
    FOTA_DOWNLOAD_EVT_FINISHED,
    FOTA_DOWNLOAD_EVT_ERASE_PENDING,
    FOTA_DOWNLOAD_EVT_ERASE_DONE,
    FOTA_DOWNLOAD_EVT_ERROR,
    FOTA_DOWNLOAD_EVT_CANCELLED
};

enum fota_download_error_cause {
    FOTA_DOWNLOAD_ERROR_CAUSE_NO_ERROR,
    FOTA_DOWNLOAD_ERROR_CAUSE_DOWNLOAD_FAILED,
    FOTA_DOWNLOAD_ERROR_CAUSE_INVALID_UPDATE,
    FOTA_DOWNLOAD_ERROR_CAUSE_TYPE_MISMATCH,
    FOTA_DOWNLOAD_ERROR_CAUSE_INTERNAL,
};

struct fota_download_evt {
    enum fota_download_evt_id id;

    union {
        enum fota_download_error_cause cause;
        int progress;
    };
};

typedef void (*fota_download_callback_t)(const struct fota_download_evt *evt);

int fota_download_init(fota_download_callback_t client_callback);
int fota_download_start(const char *host, const char *file, int sec_tag,
            uint8_t pdn_id, size_t fragment_size);
void fota_download_set_expected(int32_t size, uint8_t *sha1);

int boot_write_img_confirmed (void);

// ---------------------------------------------------------------------------------

//class FwFsm {
// public:
    /*/! Enumeration defining the state ID's
    enum StateId {
        eNoChange = -1,  //!< Indicating that state has not been changed
        eIdle = 0,       //!< ID of Idle state
        eTriggered,      //!< OTA cmd received, awaiting firmware info
        eDownload,       //!< Download started
        eReady,       //!< Download complete, ready to apply update on restart
        kNumFwStates  //!< Last entry indicationg the number of states
    };
    FwFsm(void* context, FwFsm::StateId initialState);
    FwFsm() = delete;
    virtual ~FwFsm();

    void setState(FwFsm::StateId newStateId);
    int getStateId(void);
    void handle_OtaStart();
    void handle_FwInfo(PoolElem** pElem);
    void handle_DlComplete(PoolElem** pElem);
    void handle_Restart();
    */
    //void handle_DlFailed(PoolElem** pElem);
    //void handle_timer_exp();

    //static uint16_t getTriggerTimeout() { return triggerTimeout; }
    //static uint16_t getDownloadTimeout() { return downloadTimeout; }

 //protected:
    /*/! Pointer to the class instance of the current state
    class FwState* myState;    
    int myStateId;  //!< ID of the current state
    fwStateCreator stateTbl[kNumFwStates];  //!< Array of state creator
                                            //!< functions, ordered by state ID
    void* pd;  //!< Pointer to data object, normally the this pointer of the
               //!< owner class instance

 private:
    // Those files are defined here because its in testing phase Later
    // if needed can be shifted in constructor
    static const uint16_t triggerTimeout =
        300;  //!< The trigger timeout value in s
    static const uint16_t downloadTimeout =
        300;  //!< The download timeout value in s

    void ReportOtaUpdateActive(void);*/
//};

// ---------------------------------------------------------------------------------



// ---------------------------------------------------------------------------------



#endif // __STUBS_H__
```

## src/test_fwinfo.cpp
```c
#include <zephyr/ztest.h>

#define private public
#define protected public
#include "update/fwinfo.h"

#include "stubs.h"

ZTEST_SUITE(tests_update_FwInfo, NULL, NULL, NULL, NULL, NULL);

// test constructor and destructor
ZTEST(tests_update_FwInfo, test_update_FwInfo_constructor)
{
	char str[] = "Teststring";

	FwInfo* pFwInfo = new FwInfo(str);
	zassert_not_null(pFwInfo, "memory alloc failed");
	zassert(strcmp(pFwInfo->input.c_str(), "Teststring")==0, "input wrong");

	delete pFwInfo;
}

// MISSING for 100% branch coverage operator new does not deliver NULL
// test constructor and destructor
// here code lines 
// are not covered completly.


// test constructor and destructor
ZTEST(tests_update_FwInfo, test_update_FwInfo_constructor2)
{
	std::string str = "Teststring";
	PoolElem* pElem = new PoolElem();
	pElem->putString(str.c_str());

	FwInfo* pFwInfo = new FwInfo(pElem);
	zassert_not_null(pFwInfo, "memory alloc failed");
	zassert(strcmp(pFwInfo->input.c_str(), "Teststring")==0, "input wrong");

	delete pFwInfo;
}

// test function validate
ZTEST(tests_update_FwInfo, test_update_FwInfo_validate_nok)
{
	char json[] = "test";
	int rc;

	FwInfo* fwinfo = new FwInfo(json);

	fwinfo->url = "";
	fwinfo->sha1 = "12345";
	fwinfo->fw_version = "12345";
	fwinfo->filesize = 110000;

	rc = fwinfo->validate();
	zassert_equal(rc, -22, "Failed to validate the message");

	fwinfo->url = "12345";
	fwinfo->sha1 = "";
	fwinfo->fw_version = "12345";
	fwinfo->filesize = 1110000;

	rc = fwinfo->validate();
	zassert_equal(rc, -22, "Failed to validate the message");

	fwinfo->url = "12345";
	fwinfo->sha1 = "12345";
	fwinfo->fw_version = "";
	fwinfo->filesize = 110000;

	rc = fwinfo->validate();
	zassert_equal(rc, -22, "Failed to validate the message");

	fwinfo->url = "12345";
	fwinfo->sha1 = "12345";
	fwinfo->fw_version = "12345";
	fwinfo->filesize = 1;

	rc = fwinfo->validate();
	zassert_equal(rc, -22, "Failed to validate the message");

	delete fwinfo;
}

// test function validate
ZTEST(tests_update_FwInfo, test_update_FwInfo_validate_ok)
{
	char json[] = { "{\"url\":\"https://gomera3.ddns.net/stg/" 
			"app_update.bin\",\"fw_version\":\"0.1\",\"size\":\"247996\",\"sha1\":"
			"\"3db38b191b\"}"
			};

	FwInfo* fwinfo = new FwInfo(json);

	auto rc = fwinfo->parse();
	zassert_equal(rc, 0, "Failed to parse the JSON");

	fwinfo->splitUrl();

	rc = fwinfo->validate();
	zassert_equal(rc, 0, "Failed to validate the message");

	zassert_equal(fwinfo->getProto(), "https://", "Proto mismatch");
	zassert_equal(fwinfo->getFwVersion(), "0.1", "Failed to get Fw Version");
	zassert_equal(fwinfo->getFileSize(), 247996, "Failed to get Filesize");
	zassert_equal(fwinfo->getHost(), "gomera3.ddns.net", "Incorrect Host");
	zassert_equal(fwinfo->getFileName(), "stg/app_update.bin", "Incorrect Filename");
	zassert_equal(fwinfo->getUrl(), "https://gomera3.ddns.net/stg/app_update.bin",
			"Incorrect Url");
	zassert_equal(fwinfo->getSha1(), "3db38b191b", "Incorrect sha");

	delete fwinfo;
}

// test function validate
ZTEST(tests_update_FwInfo, test_update_FwInfo_validate_size_type)
{
	char json[] = { "{\"url\":\"https://gomera3.ddns.net/stg/" 
			"app_update.bin\",\"fw_version\":\"0.1\",\"size\":null,\"sha1\":"
			"\"3db38b191b\"}"
			};

	FwInfo* fwinfo = new FwInfo(json);

	auto rc = fwinfo->parse();
	zassert_equal(rc, 0, "Failed to parse the JSON");

	fwinfo->splitUrl();

	rc = fwinfo->validate();
	zassert_equal(rc, 0, "Failed to validate the message");

	zassert_equal(fwinfo->getProto(), "https://", "Proto mismatch");
	zassert_equal(fwinfo->getFwVersion(), "0.1", "Failed to get Fw Version");
	zassert_equal(fwinfo->getHost(), "gomera3.ddns.net", "Incorrect Host");
	zassert_equal(fwinfo->getFileName(), "stg/app_update.bin", "Incorrect Filename");
	zassert_equal(fwinfo->getUrl(), "https://gomera3.ddns.net/stg/app_update.bin",
			"Incorrect Url");
	zassert_equal(fwinfo->getSha1(), "3db38b191b", "Incorrect sha");

	delete fwinfo;
}

// test function validate
ZTEST(tests_update_FwInfo, test_update_FwInfo_validate_sha1_invalid)
{
	char json[] = { "{\"url\":\"https://gomera3.ddns.net/stg/app_update.bin\",\"fw_version\":\"0.1\",\"size\":247996}" };

	FwInfo* fwinfo = new FwInfo(json);

	auto rc = fwinfo->parse();
	zassert_equal(rc, 0, "Failed to parse the JSON");

	fwinfo->splitUrl();

	rc = fwinfo->validate();
	zassert_equal(rc, 0, "Failed to validate the message");

	zassert_equal(fwinfo->getHost(), "gomera3.ddns.net", "Incorrect Host");
	zassert_equal(fwinfo->getUrl(), "https://gomera3.ddns.net/stg/app_update.bin",
			"Incorrect Url");
	zassert_equal(fwinfo->getFwVersion(), "0.1", "Failed to get Fw Version");
	zassert_equal(fwinfo->getFileSize(), 247996, "Failed to get Filesize");

	delete fwinfo;
}

// test function validate
ZTEST(tests_update_FwInfo, test_update_FwInfo_size_invalid)
{
	char json[] = { "{\"url\":\"https://gomera3.ddns.net/stg/" 
			"app_update.bin\",\"fw_version\":\"0.1\",\"size\":\"7996\",\"sha1\":"
			"\"3db38b191b\"}"
			};

	FwInfo* fwinfo = new FwInfo(json);

	auto rc = fwinfo->parse();
	zassert_equal(rc, 0, "Failed to parse the JSON");

	fwinfo->splitUrl();

	rc = fwinfo->validate();
	zassert_equal(rc, -22, "Failed to validate the message");

	zassert_equal(fwinfo->getProto(), "https://", "Proto mismatch");
	zassert_equal(fwinfo->getFwVersion(), "0.1", "Failed to get Fw Version");
	zassert_equal(fwinfo->getFileSize(), 7996, "Failed to get Filesize");
	zassert_equal(fwinfo->getHost(), "gomera3.ddns.net", "Incorrect Host");
	zassert_equal(fwinfo->getFileName(), "stg/app_update.bin", "Incorrect Filename");
	zassert_equal(fwinfo->getUrl(), "https://gomera3.ddns.net/stg/app_update.bin",
			"Incorrect Url");
	zassert_equal(fwinfo->getSha1(), "3db38b191b", "Incorrect sha");

	delete fwinfo;
}

// test function validate
ZTEST(tests_update_FwInfo, test_update_FwInfo_validate_fwversion_invalid)
{
	char json[] = { "{\"url\":\"https://gomera3.ddns.net/stg/" 
			"app_update.bin\",\"size\":247996,\"sha1\":"
			"\"3db38b191b\"}"
			};

	FwInfo* fwinfo = new FwInfo(json);

	auto rc = fwinfo->parse();
	zassert_equal(rc, 0, "Failed to parse the JSON");

	fwinfo->splitUrl();
	
	zassert_equal(fwinfo->filename, "stg/app_update.bin", "Filename mismatch");
	zassert_equal(fwinfo->host, "gomera3.ddns.net", "host name mismatch");
	zassert_equal(fwinfo->proto, "https://", "Filename mismatch");

	rc = fwinfo->validate();
	zassert_equal(rc, 0, "Failed to validate the message");

	zassert_equal(fwinfo->getSha1(), "3db38b191b", "Incorrect sha");

	delete fwinfo;
}

ZTEST(tests_update_FwInfo, test_update_FwInfo_validate_size_invalid)
{
	char json[] = { "{\"url\":\"https://gomera3.ddns.net/stg/" 
			"app_update.bin\",\"fw_version\": \"1.2\",\"sha1\":"
			"\"3db38b191b\"}"
			};

	FwInfo* fwinfo = new FwInfo(json);

	auto rc = fwinfo->parse();
	zassert_equal(rc, 0, "Failed to parse the JSON");

	fwinfo->splitUrl();

	rc = fwinfo->validate();
	zassert_equal(rc, 0, "Failed to validate the message");

	zassert_equal(fwinfo->getFwVersion(), "1.2", "Failed to get Fw Version");
	zassert_equal(fwinfo->getHost(), "gomera3.ddns.net", "Incorrect Host");
	zassert_equal(fwinfo->getFileName(), "stg/app_update.bin", "Incorrect Filename");
	zassert_equal(fwinfo->getUrl(), "https://gomera3.ddns.net/stg/app_update.bin", "Incorrect Url");
	zassert_equal(fwinfo->getSha1(), "3db38b191b", "Incorrect sha");

	delete fwinfo;
}

ZTEST(tests_update_FwInfo, test_update_FwInfo_validate_url)
{
	char json[] = { "{\"url\":\"http://www.example.com/path/to/resource/" 
			"file%20with%20spaces.bin\",\"fw_version\":\"0.1\",\"size\":247996,\"sha1\":"
			"\"3db38b191b\"}"
			};

	FwInfo* fwinfo = new FwInfo(json);

	auto rc = fwinfo->parse();
	zassert_equal(rc, 0, "Failed to parse the JSON");

	fwinfo->splitUrl();

	rc = fwinfo->validate();
	zassert_equal(rc, 0, "Failed to validate the message");

	zassert_equal(fwinfo->getProto(), "http://", "Proto mismatch");
	zassert_equal(fwinfo->getFwVersion(), "0.1", "Failed to get Fw Version");
	zassert_equal(fwinfo->getFileSize(), 247996, "Failed to get Filesize");
	zassert_equal(fwinfo->getHost(), "www.example.com", "Incorrect Host");
	zassert_equal(fwinfo->getFileName(), "path/to/resource/file%20with%20spaces.bin", "Incorrect Filename");
	zassert_equal(fwinfo->getUrl(), "http://www.example.com/path/to/resource/file%20with%20spaces.bin",
			"Incorrect Url");
	zassert_equal(fwinfo->getSha1(), "3db38b191b", "Incorrect sha");

	delete fwinfo;
}

ZTEST(tests_update_FwInfo, test_update_FwInfo_validate_url_invalid)
{
	char json[] = { "{\"url\":\"coap://www.example.com/path/to/resource/" 
			"file%20with%20spaces.bin\",\"fw_version\":\"0.1\",\"size\":247996,\"sha1\":"
			"\"3db38b191b\"}"
			};

	FwInfo* fwinfo = new FwInfo(json);

	auto rc = fwinfo->parse();
	zassert_equal(rc, 0, "Failed to parse the JSON");

	fwinfo->splitUrl();

	rc = fwinfo->validate();
	zassert_equal(rc, 0, "Failed to validate the message");

	zassert_equal(fwinfo->getFwVersion(), "0.1", "Failed to get Fw Version");
	zassert_equal(fwinfo->getFileSize(), 247996, "Failed to get Filesize");
	zassert_equal(fwinfo->getSha1(), "3db38b191b", "Incorrect sha");

	delete fwinfo;
}

ZTEST(tests_update_FwInfo, test_update_FwInfo_invalid_json)
{
	char json[] = { "{\"url\":\"coap://www.example.com/path/to/resource/" 
			"file%20with%20spaces.bin\",\"f0.1\",\"size\":247996,\"sha1\":"
			"\"3db38b19b\"}"
			};

	FwInfo* fwinfo = new FwInfo(json);

	auto rc = fwinfo->parse();
	zassert_equal(rc, -1, "Failed to parse the JSON");

	delete fwinfo;
}
```

## src/test_update.cpp
```c
#include <zephyr/ztest.h>

#define private public
#include "update/update.h"

#include "stubs.h"

ZTEST_SUITE(tests_update_FwUpd, NULL, NULL, NULL, NULL, NULL);

// test constructor and destructor
ZTEST(tests_update_FwUpd, test_update_FwUpd_constructor)
{
	FwUpd* pFwUpd = new FwUpd("fwupd");
	zassert_not_null(pFwUpd, "memory alloc failed");
	zassert_not_null(pFwUpd->pInMbox, "pInMbox = NULL");
    zassert_equal(pFwUpd->pInMbox->count(), 0, "pInMbox->count() != 0");
    zassert_equal(pFwUpd->pInMbox, Mbox::getMboxById(Mbox::eFwUpd),
                  "Error getting mailbox by id");

	pFwUpd->setHostname("Test-Hostname");				  
	pFwUpd->setFilename("Test-Filename");
	zassert(strcmp(pFwUpd->hostname, "Test-Hostname")==0, "hostname not correct");
	zassert(strcmp(pFwUpd->filename, "Test-Filename")==0, "filename not correct");

	delete pFwUpd;
}

// MISSING for 100% branch coverage operator new does not deliver NULL
// test constructor and destructor
// here code lines 
// pInMbox = new Mbox(name);
// are not covered completly.


// test function fota_dl_handler
ZTEST(tests_update_FwUpd, test_update_FwUpd_fota_dl_handler)
{
    PoolElem* pElem;

	Mbox* pUpdCtrlMbox = new Mbox("UpdCtrlMbox");
    Mbox::registerMbox(pUpdCtrlMbox, Mbox::eFwUpdCtrl);
	zassert_not_null(pUpdCtrlMbox, "pUpdCtrlMbox = NULL");

	FwUpd* pFwUpd = new FwUpd("fwupd");
	zassert_not_null(pFwUpd, "memory alloc failed");
	zassert_not_null(pFwUpd->pInMbox, "pInMbox = NULL");
    zassert_equal(pFwUpd->pInMbox->count(), 0, "pInMbox->count() != 0");
    zassert_equal(pFwUpd->pInMbox, Mbox::getMboxById(Mbox::eFwUpd),
                  "Error getting mailbox by id");

	struct fota_download_evt ev;

	ev.id = FOTA_DOWNLOAD_EVT_ERROR;
	pFwUpd->fota_dl_handler(&ev);	

	pElem = pUpdCtrlMbox->read();
    zassert_equal(pElem->mtype, msgType::eFwDlFailed, "Rcvd mtype != msgType::eFwDlFailed");
    zassert_equal(pElem->from, Mbox::eFwUpd, "Rcvd sender != Mbox::eFwUpd");
	std::string s = std::string(reinterpret_cast<char*>(pElem->getBuffer()));
	printk("s = %s\n\n", s.c_str());
	zassert(strcmp(s.c_str(), "{\"event\":\"CODE3\"}")==0, "payload not correct");
	pElem->free();

	delete pUpdCtrlMbox;
	delete pFwUpd;
}

// test function fota_dl_handler
ZTEST(tests_update_FwUpd, test_update_FwUpd_fota_dl_handler2)
{
    PoolElem* pElem;

	Mbox* pUpdCtrlMbox = new Mbox("UpdCtrlMbox");
    Mbox::registerMbox(pUpdCtrlMbox, Mbox::eFwUpdCtrl);
	zassert_not_null(pUpdCtrlMbox, "pUpdCtrlMbox = NULL");

	FwUpd* pFwUpd = new FwUpd("fwupd");
	zassert_not_null(pFwUpd, "memory alloc failed");
	zassert_not_null(pFwUpd->pInMbox, "pInMbox = NULL");
    zassert_equal(pFwUpd->pInMbox->count(), 0, "pInMbox->count() != 0");
    zassert_equal(pFwUpd->pInMbox, Mbox::getMboxById(Mbox::eFwUpd),
                  "Error getting mailbox by id");

	struct fota_download_evt ev;

	ev.id = FOTA_DOWNLOAD_EVT_FINISHED;
	pFwUpd->fota_dl_handler(&ev);	

	pElem = pUpdCtrlMbox->read();
    zassert_equal(pElem->mtype, msgType::eFwDlSuccess, "Rcvd mtype != msgType::eFwDlSuccess");
    zassert_equal(pElem->from, Mbox::eFwUpd, "Rcvd sender != Mbox::eFwUpd");
	std::string s = std::string(reinterpret_cast<char*>(pElem->getBuffer()));
	printk("s = %s\n\n", s.c_str());
	zassert(strcmp(s.c_str(), "{\"event\":\"CODE2\"}")==0, "payload not correct");
	pElem->free();

	delete pUpdCtrlMbox;
	delete pFwUpd;
}

// test function fota_dl_handler
ZTEST(tests_update_FwUpd, test_update_FwUpd_fota_dl_handler3)
{
    PoolElem* pElem;

	Mbox* pUpdCtrlMbox = new Mbox("UpdCtrlMbox");
    Mbox::registerMbox(pUpdCtrlMbox, Mbox::eFwUpdCtrl);
	zassert_not_null(pUpdCtrlMbox, "pUpdCtrlMbox = NULL");

	FwUpd* pFwUpd = new FwUpd("fwupd");
	zassert_not_null(pFwUpd, "memory alloc failed");
	zassert_not_null(pFwUpd->pInMbox, "pInMbox = NULL");
    zassert_equal(pFwUpd->pInMbox->count(), 0, "pInMbox->count() != 0");
    zassert_equal(pFwUpd->pInMbox, Mbox::getMboxById(Mbox::eFwUpd),
                  "Error getting mailbox by id");

	struct fota_download_evt ev;

	ev.id = FOTA_DOWNLOAD_EVT_CANCELLED;
	pFwUpd->fota_dl_handler(&ev);	

	pElem = pUpdCtrlMbox->read();
    zassert_equal(pElem->mtype, msgType::eFwDlFailed, "Rcvd mtype != msgType::eFwDlFailed");
    zassert_equal(pElem->from, Mbox::eFwUpd, "Rcvd sender != Mbox::eFwUpd");
	std::string s = std::string(reinterpret_cast<char*>(pElem->getBuffer()));
	printk("s = %s\n\n", s.c_str());
	zassert(strcmp(s.c_str(), "{\"event\":\"CODE4\"}")==0, "payload not correct");
	pElem->free();

	delete pUpdCtrlMbox;
	delete pFwUpd;
}

// test function fota_dl_handler
ZTEST(tests_update_FwUpd, test_update_FwUpd_fota_dl_handler4)
{
	FwUpd* pFwUpd = new FwUpd("fwupd");
	zassert_not_null(pFwUpd, "memory alloc failed");
	zassert_not_null(pFwUpd->pInMbox, "pInMbox = NULL");
    zassert_equal(pFwUpd->pInMbox->count(), 0, "pInMbox->count() != 0");
    zassert_equal(pFwUpd->pInMbox, Mbox::getMboxById(Mbox::eFwUpd),
                  "Error getting mailbox by id");

	struct fota_download_evt ev;

	ev.id = FOTA_DOWNLOAD_EVT_ERASE_PENDING;
	pFwUpd->fota_dl_handler(&ev);	

	delete pFwUpd;
}

// test function download_start
ZTEST(tests_update_FwUpd, test_update_FwUpd_download_start)
{
    PoolElem* pElem;

	Mbox* pUpdCtrlMbox = new Mbox("UpdCtrlMbox");
    Mbox::registerMbox(pUpdCtrlMbox, Mbox::eFwUpdCtrl);
	zassert_not_null(pUpdCtrlMbox, "pUpdCtrlMbox = NULL");

	FwUpd* pFwUpd = new FwUpd("fwupd");
	zassert_not_null(pFwUpd, "memory alloc failed");
	zassert_not_null(pFwUpd->pInMbox, "pInMbox = NULL");
    zassert_equal(pFwUpd->pInMbox->count(), 0, "pInMbox->count() != 0");
    zassert_equal(pFwUpd->pInMbox, Mbox::getMboxById(Mbox::eFwUpd),
                  "Error getting mailbox by id");

	gIntVal = 0;
	pFwUpd->download_start();	

	gIntVal = 17;
	pFwUpd->download_start();	

	pElem = pUpdCtrlMbox->read();
    zassert_equal(pElem->mtype, msgType::eFwDlFailed, "Rcvd mtype != msgType::eFwDlFailed");
    zassert_equal(pElem->from, Mbox::eFwUpd, "Rcvd sender != Mbox::eFwUpd");
	std::string s = std::string(reinterpret_cast<char*>(pElem->getBuffer()));
	printk("s = %s\n\n", s.c_str());
	zassert(strcmp(s.c_str(), "{\"event\":\"CODE3\"}")==0, "payload not correct");
	pElem->free();

	delete pUpdCtrlMbox;
	delete pFwUpd;
}

//Test receive msg eFwInfo
ZTEST(tests_update_FwUpd, test_update_rcv_msg_eFwInfo)
{
	FwUpd* pFwUpd = new FwUpd("fwupd");
	zassert_not_null(pFwUpd, "memory alloc failed");
	zassert_not_null(pFwUpd->pInMbox, "pInMbox = NULL");
    zassert_equal(pFwUpd->pInMbox->count(), 0, "pInMbox->count() != 0");
    zassert_equal(pFwUpd->pInMbox, Mbox::getMboxById(Mbox::eFwUpd),
                  "Error getting mailbox by id");

	std::string str = "{\"url\":\"https://gomera3.ddns.net/stg/" 
			"app_update.bin\",\"fw_version\":\"0.1\",\"size\":\"247996\",\"sha1\":"
			"\"3db38b191b\"}";
    Mbox::sendMsg(msgType::eFwInfo, Mbox::eFwUpd, Mbox::eFwUpd, str);

    zassert_equal(pFwUpd->pInMbox->count(), 1, "pInMbox->count() != 1");

    pFwUpd->task(); 
    zassert_equal(pFwUpd->pInMbox->count(), 0, "pInMbox->count() != 0");
    zassert_equal(pFwUpd->size_expected, 247996, "size_expected != 247996");
	zassert(strcmp((char*)pFwUpd->sha1_expected, "3db38b191b")==0, "sha1_expected not correct");
	zassert(strcmp(pFwUpd->hostname, "https://gomera3.ddns.net")==0, "hostname not correct");
	zassert(strcmp(pFwUpd->filename, "stg/app_update.bin")==0, "filename not correct");

	delete pFwUpd; 
}

//Test receive msg eFwDownload
ZTEST(tests_update_FwUpd, test_update_rcv_msg_eFwDownload)
{
	FwUpd* pFwUpd = new FwUpd("fwupd");
	zassert_not_null(pFwUpd, "memory alloc failed");
	zassert_not_null(pFwUpd->pInMbox, "pInMbox = NULL");
    zassert_equal(pFwUpd->pInMbox->count(), 0, "pInMbox->count() != 0");
    zassert_equal(pFwUpd->pInMbox, Mbox::getMboxById(Mbox::eFwUpd),
                  "Error getting mailbox by id");

    Mbox::sendMsg(msgType::eFwDownload, Mbox::eFwUpd, Mbox::eFwUpd);

    zassert_equal(pFwUpd->pInMbox->count(), 1, "pInMbox->count() != 1");

    pFwUpd->task(); 
    zassert_equal(pFwUpd->pInMbox->count(), 0, "pInMbox->count() != 0");

	delete pFwUpd; 
}

//Test receive unexpected msg 
ZTEST(tests_update_FwUpd, test_update_rcv_msg_unexpected)
{
	FwUpd* pFwUpd = new FwUpd("fwupd");
	zassert_not_null(pFwUpd, "memory alloc failed");
	zassert_not_null(pFwUpd->pInMbox, "pInMbox = NULL");
    zassert_equal(pFwUpd->pInMbox->count(), 0, "pInMbox->count() != 0");
    zassert_equal(pFwUpd->pInMbox, Mbox::getMboxById(Mbox::eFwUpd),
                  "Error getting mailbox by id");

    Mbox::sendMsg(msgType::eResetCause, Mbox::eFwUpd, Mbox::eFwUpd);

    zassert_equal(pFwUpd->pInMbox->count(), 1, "pInMbox->count() != 1");

    pFwUpd->task();  

    zassert_equal(pFwUpd->pInMbox->count(), 0, "pInMbox->count() != 0");
	delete pFwUpd; 
}

//Test receive no msg 
ZTEST(tests_update_FwUpd, test_update_rcv_no_msg)
{
	FwUpd* pFwUpd = new FwUpd("fwupd");
	zassert_not_null(pFwUpd, "memory alloc failed");
	zassert_not_null(pFwUpd->pInMbox, "pInMbox = NULL");
    zassert_equal(pFwUpd->pInMbox->count(), 0, "pInMbox->count() != 0");
    zassert_equal(pFwUpd->pInMbox, Mbox::getMboxById(Mbox::eFwUpd),
                  "Error getting mailbox by id");

    pFwUpd->pInMbox->write(NULL);
    
    pFwUpd->task();  

    zassert_equal(pFwUpd->pInMbox->count(), 0, "pInMbox->count() != 0");
	delete pFwUpd; 
}
```
