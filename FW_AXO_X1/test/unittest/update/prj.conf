## CMakeLists.txt
```
cmake_minimum_required(VERSION 3.20.0)
find_package(Zephyr REQUIRED HINTS $ENV{ZEPHYR_BASE})
project(data)

FILE(GLOB app_sources src/test_fsm.cpp
                      #src/test_fwinfo.cpp
                      #src/test_update.cpp
                      #src/test_update_ctrl.cpp
                      src/stubs.cpp
)
target_sources(app PRIVATE ${app_sources}
	../../common/src/update/fsm.cpp
	#../../common/src/update/fwinfo.cpp
	#../../common/src/update/update.cpp
	#../../common/src/update/update_ctrl.cpp
    ../../common/src/rtos/mbox.cpp
    ../../common/src/rtos/task.cpp
    ../../common/src/rtos/timer.cpp
)


zephyr_include_directories(../../include)
zephyr_include_directories(../../common/src)
zephyr_include_directories(../../app-axo-x1/src)

zephyr_compile_options(-Wno-pointer-arith -Wno-unused-variable -Wno-psabi)
```

## prj.conf
```kconfig
CONFIG_ZTEST=y
CONFIG_ZTEST_NEW_API=y

CONFIG_MAIN_STACK_SIZE=8192
#4096

CONFIG_ZTEST_STACK_SIZE=65536
#32768

CONFIG_LOG=y
CONFIG_PRINTK=y
CONFIG_CPLUSPLUS=y
CONFIG_LIB_CPLUSPLUS=y
CONFIG_EXCEPTIONS=n
CONFIG_STD_CPP17=y
CONFIG_NEWLIB_LIBC=y
CONFIG_NEWLIB_LIBC_MIN_REQUIRED_HEAP_SIZE=4096

# disable assert macros
CONFIG_ASSERT=n
CONFIG_ASSERT_TEST=n

# memory usage
CONFIG_MEM_SLAB_TRACE_MAX_UTILIZATION=y 
CONFIG_SYS_HEAP_RUNTIME_STATS=y

CONFIG_HEAP_MEM_POOL_SIZE=16384

CONFIG_CBPRINTF_FP_SUPPORT=y

# CJSON
CONFIG_NEWLIB_LIBC_FLOAT_PRINTF=y
CONFIG_CJSON_LIB=y

CONFIG_NUM_COOP_PRIORITIES=10
CONFIG_NUM_PREEMPT_PRIORITIES=10
CONFIG_SCHED_SCALABLE=y

# Enable thread awareness for debugging tools supporting it
CONFIG_INIT_STACKS=y
CONFIG_THREAD_NAME=y
CONFIG_THREAD_STACK_INFO=y
CONFIG_THREAD_RUNTIME_STATS=y
CONFIG_THREAD_MONITOR=y
CONFIG_DEBUG_THREAD_INFO=y

CONFIG_UNIT_TEST=y
CONFIG_UNIT_TEST_UPDATE=y
CONFIG_COVERAGE=y
CONFIG_COVERAGE_DUMP=y
```

## src/stubs.cpp
```c
#define private public
#include "rtos/mbox.h"
#include "rtos/mpelem.h"
#include "rtos/mpool.h"
#include "rtos/mqueue.h"
#include "rtos/task.h"
#include "rtos/task.h"

#include "bus/spi/spibus.h"
#include "drv/spi/fram.h"
#include "drv/spi/adxl37x.h"
#include "conf/config.h"
#include "./version.h"


#include "stubs.h"


// -------------------------------------------------------------------------

bool gbRetVal;
int gIntVal;

// -------------------------------------------------------------------------
std::allocator<uint8_t> allocBytes;


void Mbox::sendMsg(enum msgType mType, MboxId senderId, MboxId receiverId) {
    PoolElem* e1 = new PoolElem(mType, senderId);
    e1->buf = NULL;
    e1->bufLen = 0;
    Mbox::send(e1, receiverId);
}

void Mbox::sendMsg(enum msgType mType, MboxId senderId, MboxId receiverId,
                   uint8_t u8DataByte) {
    PoolElem* e1 = new PoolElem(mType, senderId);
    e1->p1 = u8DataByte;
    e1->buf = NULL;
    e1->bufLen = 0;
    Mbox::send(e1, receiverId);
}

void Mbox::sendMsg(enum msgType mType, MboxId senderId, MboxId receiverId,
                   int8_t s8DataByte) {
    PoolElem* e1 = new PoolElem(mType, senderId);
    e1->p2 = s8DataByte;
    e1->buf = NULL;
    e1->bufLen = 0;
    Mbox::send(e1, receiverId);
}

void Mbox::sendMsg(enum msgType mType, MboxId senderId, MboxId receiverId,
                        uint8_t* pData, uint16_t dataLen) {
    PoolElem* e1 = new PoolElem(mType, senderId);
        
    uint8_t* b = allocBytes.allocate(2048);
    memcpy(b, pData, dataLen);
    e1->buf = reinterpret_cast<uint8_t (*)[2048]>(b);
    //printk("sendMsg():  e1->buf = 0x%X\n\n", (unsigned int)e1->buf);
    e1->bufLen = dataLen;
    e1->mtype = mType;
    e1->from = senderId;
    Mbox::send(e1, receiverId);
}

void Mbox::sendMsg(enum msgType mType, MboxId senderId, MboxId receiverId,
                   const std::string& str) {
    PoolElem* e1 = new PoolElem(mType, senderId);
    size_t dataLen = str.size() + 1;
    uint8_t* b = allocBytes.allocate(2048);
    auto rc = snprintf(reinterpret_cast<char*>(b), dataLen, "%s", str.c_str());
    int strLen = strlen(reinterpret_cast<const char*>(b));
    dataLen = strLen ? strLen + 1 : 0;
    e1->buf = (uint8_t (*)[2048])(b);
    e1->bufLen = dataLen;
    e1->mtype = mType;
    e1->from = senderId;
    Mbox::send(e1, receiverId);
}

// -------------------------------------------------------------------------

uint8_t* PoolElem::getBuffer(void) { return *buf; }

void PoolElem::putString(const char* s) {
    std::string str = s;
    size_t dataLen = str.size() + 1;
    uint8_t* b = allocBytes.allocate(2048);
    auto rc = snprintf(reinterpret_cast<char*>(b), dataLen, "%s", str.c_str());
    int strLen = strlen(reinterpret_cast<const char*>(b));
    dataLen = strLen ? strLen + 1 : 0;
    this->buf = (uint8_t (*)[2048])(b);
    this->bufLen = dataLen;
}

void PoolElem::putData(const void* pdata, size_t len) {
    uint8_t* b = allocBytes.allocate(2048);
    memcpy(b, pdata, len);
    this->buf = reinterpret_cast<uint8_t (*)[2048]>(b);
    this->bufLen = len;
}

void PoolElem::Dump() { }

void PoolElem::free() {
    uint8_t* b = reinterpret_cast<uint8_t*>(this->buf);
    //printk("free():  this->buf = 0x%X\n\n", (unsigned int)this->buf);
    //printk("free():  0x%.2X%.2X%.2X%.2X\n\n", (*(uint8_t*)this->buf[0]), 
    //                                  (*(uint8_t*)this->buf[1]),
    //                                  (*(uint8_t*)this->buf[2]), 
    //                                  (*(uint8_t*)this->buf[3]));
    if (this->buf != NULL) {
        allocBytes.deallocate(reinterpret_cast<uint8_t*>(this->buf), 2048);
        this->buf = NULL;
        this->bufLen = 0;
    }
    delete this;
}

// -------------------------------------------------------------------------

void* my_k_timer_user_data_get(k_timer* timer) {
    return reinterpret_cast<void*>(timer);
}

void sys_reboot (int type) { }

int64_t my_k_uptime_get (void) {
    if (gbRetVal) {
        return 7000000;
    }
    return 0;
}

// -------------------------------------------------------------------------

int fota_download_init(fota_download_callback_t client_callback) {
    return 0;
}

int fota_download_start(const char *host, const char *file, int sec_tag,
            uint8_t pdn_id, size_t fragment_size) {
    return gIntVal;
}

void fota_download_set_expected(int32_t size, uint8_t *sha1) { }

int boot_write_img_confirmed (void) {
    return 0;
}

// -------------------------------------------------------------------------


FwUpdCtrl::FwUpdCtrl()                 { }
FwUpdCtrl::~FwUpdCtrl()                { }
void FwUpdCtrl::otaStartConfirm()      { }
void FwUpdCtrl::otaStartReject()       { }
void FwUpdCtrl::otaFwConfirm()         { }
void FwUpdCtrl::otaFwReject()          { }
void FwUpdCtrl::startRebootTimer()     { }
void FwUpdCtrl::startRetryTimer()      { }
void FwUpdCtrl::requestDownload()      { }
void FwUpdCtrl::startTimeout(uint16_t) { }
```

## src/stubs.h
```c
#ifndef __STUBS_H__
#define __STUBS_H__

#include <stdio.h>
#include <stdlib.h>
    #include <fcntl.h>
    #include <unistd.h>

extern bool gbRetVal;
extern int gIntVal;


#define k_timer_user_data_get(x) my_k_timer_user_data_get(x)
#define k_sleep(x)  
#define k_uptime_get() my_k_uptime_get()

#define SYS_REBOOT_COLD 1
#define SYS_REBOOT_WARM 2

void* my_k_timer_user_data_get(k_timer* timer);
void sys_reboot (int type);
int64_t my_k_uptime_get (void);


// ---------------------------------------------------------------------------------

enum fota_download_evt_id {
    FOTA_DOWNLOAD_EVT_PROGRESS,
    FOTA_DOWNLOAD_EVT_FINISHED,
    FOTA_DOWNLOAD_EVT_ERASE_PENDING,
    FOTA_DOWNLOAD_EVT_ERASE_DONE,
    FOTA_DOWNLOAD_EVT_ERROR,
    FOTA_DOWNLOAD_EVT_CANCELLED
};

enum fota_download_error_cause {
    FOTA_DOWNLOAD_ERROR_CAUSE_NO_ERROR,
    FOTA_DOWNLOAD_ERROR_CAUSE_DOWNLOAD_FAILED,
    FOTA_DOWNLOAD_ERROR_CAUSE_INVALID_UPDATE,
    FOTA_DOWNLOAD_ERROR_CAUSE_TYPE_MISMATCH,
    FOTA_DOWNLOAD_ERROR_CAUSE_INTERNAL,
};

struct fota_download_evt {
    enum fota_download_evt_id id;

    union {
        enum fota_download_error_cause cause;
        int progress;
    };
};

typedef void (*fota_download_callback_t)(const struct fota_download_evt *evt);

int fota_download_init(fota_download_callback_t client_callback);
int fota_download_start(const char *host, const char *file, int sec_tag,
            uint8_t pdn_id, size_t fragment_size);
void fota_download_set_expected(int32_t size, uint8_t *sha1);

int boot_write_img_confirmed (void);

// ---------------------------------------------------------------------------------

class FwUpdCtrl {
 public:
    explicit FwUpdCtrl();
    virtual ~FwUpdCtrl();
	void otaStartConfirm();  // publish to /device/{device_id}/command/accepted
	void otaStartReject();   // publish to /device/{device_id}/command/rejected
	void otaFwConfirm();  // publish to /device/{device_id}/ota/update/accepted
	void otaFwReject();   // publish to /device/{device_id}/ota/update/rejected
	void startRebootTimer();  // delay reboot a few seconds on dl ready
	void startRetryTimer();   // generate timeout to next dl trial
	void requestDownload();   // request download on previous failure
	void startTimeout(uint16_t);

	uint16_t retryCnt;   //!< Retry counter: Retry attempt on donwload failure
	uint8_t maxRetries;  //!< Maximum number of retries
};



// ---------------------------------------------------------------------------------



// ---------------------------------------------------------------------------------



#endif // __STUBS_H__
```
