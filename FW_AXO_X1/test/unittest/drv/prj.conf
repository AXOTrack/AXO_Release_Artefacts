## CMakeLists.txt
```
cmake_minimum_required(VERSION 3.20.0)
find_package(Zephyr REQUIRED HINTS $ENV{ZEPHYR_BASE})
project(bus)

FILE(GLOB app_sources src/stubs.cpp
                      src/test_adc_adconverter.cpp
                      src/test_adc_batt_mgr.cpp
                      src/test_i2c_shtcx.cpp
                      src/test_pm_boost.cpp
                      src/test_pwm_pwm.cpp
                      src/test_spi_adxl37x.cpp
                      src/test_spi_fram.cpp                      
)
target_sources(app PRIVATE ${app_sources}
	../../common/src/drv/adc/adconverter.cpp
	../../common/src/drv/adc/batt_mgr.cpp
	../../common/src/drv/i2c/shtcx.cpp
    ../../common/src/drv/pm/boost.cpp
	../../common/src/drv/pwm/pwm.cpp
	../../common/src/drv/spi/adxl37x.cpp
	../../common/src/drv/spi/fram.cpp
    ../../common/src/rtos/mutex.cpp
    ../../common/src/rtos/mbox.cpp
    ../../common/src/rtos/mpool.cpp
    ../../common/src/rtos/task.cpp
    ../../common/src/rtos/timer.cpp)


zephyr_include_directories(../../include)
zephyr_include_directories(../../common/src)
#zephyr_include_directories(../../app-axo-x1/src)

zephyr_compile_options(-Wno-pointer-arith -Wno-unused-variable -Wno-psabi)
```

## prj.conf
```kconfig
CONFIG_ZTEST=y
CONFIG_ZTEST_NEW_API=y

CONFIG_MAIN_STACK_SIZE=8192
#4096

CONFIG_ZTEST_STACK_SIZE=65536
#32768

CONFIG_LOG=y
CONFIG_PRINTK=y
CONFIG_CPLUSPLUS=y
CONFIG_LIB_CPLUSPLUS=y
CONFIG_EXCEPTIONS=n
CONFIG_STD_CPP17=y
CONFIG_NEWLIB_LIBC=y
CONFIG_NEWLIB_LIBC_MIN_REQUIRED_HEAP_SIZE=4096

# disable assert macros
CONFIG_ASSERT=n
CONFIG_ASSERT_TEST=n

# memory usage
CONFIG_MEM_SLAB_TRACE_MAX_UTILIZATION=y 
CONFIG_SYS_HEAP_RUNTIME_STATS=y

CONFIG_HEAP_MEM_POOL_SIZE=16384

CONFIG_CBPRINTF_FP_SUPPORT=y

# CJSON
CONFIG_NEWLIB_LIBC_FLOAT_PRINTF=y
CONFIG_CJSON_LIB=y

CONFIG_NUM_COOP_PRIORITIES=10
CONFIG_NUM_PREEMPT_PRIORITIES=10
CONFIG_SCHED_SCALABLE=y

# Enable thread awareness for debugging tools supporting it
CONFIG_INIT_STACKS=y
CONFIG_THREAD_NAME=y
CONFIG_THREAD_STACK_INFO=y
CONFIG_THREAD_RUNTIME_STATS=y
CONFIG_THREAD_MONITOR=y
CONFIG_DEBUG_THREAD_INFO=y

CONFIG_UNIT_TEST=y
CONFIG_UNIT_TEST_DRV=y
CONFIG_UNIT_TEST_BUS=y
CONFIG_COVERAGE=y
CONFIG_COVERAGE_DUMP=y
```

## src/stubs.cpp
```c
#include "string.h"

#define private public
#include "rtos/mbox.h"
#include "rtos/mpelem.h"
#include "rtos/mpool.h"
#include "rtos/mqueue.h"
#include "rtos/task.h"
#include "rtos/timer.h"

#include "bus/i2c/i2cbus.h"
#include "bus/spi/spibus.h"
#include "drv/spi/adxl37x.h"
#include "conf/config.h"
/*#include "drv/spi/fram.h"
#include "drv/spi/adxl37x.h"
#include "./version.h"
*/

#include "stubs.h"

// -------------------------------------------------------------------------

bool gbRetVal;
bool gbReady;
int gIntVal;

// -------------------------------------------------------------------------
std::allocator<uint8_t> allocBytes;


void Mbox::sendMsg(enum msgType mType, MboxId senderId, MboxId receiverId) {
    PoolElem* e1 = new PoolElem(mType, senderId);
    e1->buf = NULL;
    e1->bufLen = 0;
    Mbox::send(e1, receiverId);
}

void Mbox::sendMsg(enum msgType mType, MboxId senderId, MboxId receiverId,
                   uint8_t u8DataByte) {
    PoolElem* e1 = new PoolElem(mType, senderId);
    e1->p1 = u8DataByte;
    e1->buf = NULL;
    e1->bufLen = 0;
    Mbox::send(e1, receiverId);
}

void Mbox::sendMsg(enum msgType mType, MboxId senderId, MboxId receiverId,
                   int8_t s8DataByte) {
    PoolElem* e1 = new PoolElem(mType, senderId);
    e1->p2 = s8DataByte;
    e1->buf = NULL;
    e1->bufLen = 0;
    Mbox::send(e1, receiverId);
}

void Mbox::sendMsg(enum msgType mType, MboxId senderId, MboxId receiverId,
                        uint8_t* pData, uint16_t dataLen) {
    PoolElem* e1 = new PoolElem(mType, senderId);
        
    uint8_t* b = allocBytes.allocate(2048);
    memcpy(b, pData, dataLen);
    e1->buf = reinterpret_cast<uint8_t (*)[2048]>(b);
    //printk("sendMsg():  e1->buf = 0x%X\n\n", (unsigned int)e1->buf);
    e1->bufLen = dataLen;
    e1->mtype = mType;
    e1->from = senderId;
    Mbox::send(e1, receiverId);
}

void Mbox::sendMsg(enum msgType mType, MboxId senderId, MboxId receiverId,
                   const std::string& str) {
    PoolElem* e1 = new PoolElem(mType, senderId);
    size_t dataLen = str.size() + 1;
    uint8_t* b = allocBytes.allocate(2048);
    auto rc = snprintf(reinterpret_cast<char*>(b), dataLen, "%s", str.c_str());
    int strLen = strlen(reinterpret_cast<const char*>(b));
    dataLen = strLen ? strLen + 1 : 0;
    e1->buf = (uint8_t (*)[2048])(b);
    e1->bufLen = dataLen;
    e1->mtype = mType;
    e1->from = senderId;
    Mbox::send(e1, receiverId);
}

// -------------------------------------------------------------------------

uint8_t* PoolElem::getBuffer(void) { return *buf; }

void PoolElem::putString(const char* s) {
    std::string str = s;
    size_t dataLen = str.size() + 1;
    uint8_t* b = allocBytes.allocate(2048);
    auto rc = snprintf(reinterpret_cast<char*>(b), dataLen, "%s", str.c_str());
    int strLen = strlen(reinterpret_cast<const char*>(b));
    dataLen = strLen ? strLen + 1 : 0;
    this->buf = (uint8_t (*)[2048])(b);
    this->bufLen = dataLen;
}

void PoolElem::putData(const void* pdata, size_t len) {
    uint8_t* b = allocBytes.allocate(2048);
    memcpy(b, pdata, len);
    this->buf = reinterpret_cast<uint8_t (*)[2048]>(b);
    this->bufLen = len;
}

void PoolElem::Dump() { }

void PoolElem::free() {
    uint8_t* b = reinterpret_cast<uint8_t*>(this->buf);
    //printk("free():  this->buf = 0x%X\n\n", (unsigned int)this->buf);
    //printk("free():  0x%.2X%.2X%.2X%.2X\n\n", (*(uint8_t*)this->buf[0]), 
    //                                  (*(uint8_t*)this->buf[1]),
    //                                  (*(uint8_t*)this->buf[2]), 
    //                                  (*(uint8_t*)this->buf[3]));
    if (this->buf != NULL) {
        allocBytes.deallocate(reinterpret_cast<uint8_t*>(this->buf), 2048);
        this->buf = NULL;
        this->bufLen = 0;
    }
    delete this;
}

// -------------------------------------------------------------------------

/*void* k_timer_user_data_get(k_timer* timer) {
    return reinterpret_cast<void*>(timer);
}*/

void* my_k_timer_user_data_get(k_timer* timer) {
    return reinterpret_cast<void*>(timer);
}

// -------------------------------------------------------------------------


struct gpio_dt_spec gGpioDtSpec;

int i2c_configure(const struct device *dev, uint32_t dev_config) {
    if (gbRetVal) {
        return 0;
    }
    return 1;
}

bool my_device_is_ready(const struct device *dev) {
    if (gbReady) {
        return true;
    }
    return false;
}

const struct device* device_get_binding(const char *name) {
    static struct device d;
    d.name = name;
    return (const struct device*)&d;
}

int pwm_set(const struct device *dev, uint32_t channel, uint32_t period, uint32_t pulse, pwm_flags_t flags) {
    return gbRetVal;
}

int sensor_sample_fetch(const struct device *dev) {
    if (gbReady) {
        return 1;
    }
    return 0;
}

int sensor_channel_get(const struct device *dev, enum sensor_channel chan, struct sensor_value *val){
    return 0;
}

int sensor_value_from_double(struct sensor_value *val, double inp)
{
        if (inp < INT32_MIN || inp > INT32_MAX) {
                return -ERANGE;
        }
 
        double val2 = (inp - (int32_t)inp) * 1000000.0;
 
        if (val2 < INT32_MIN || val2 > INT32_MAX) {
                return -ERANGE;
        }
 
        val->val1 = (int32_t)inp;
        val->val2 = (int32_t)val2;
 
        return 0;
}

double sensor_value_to_double(const struct sensor_value *val)
{
        return (double)val->val1 + (double)val->val2 / 1000000;
}

int sensor_trigger_set(const struct device *dev,
                        const struct sensor_trigger *trig,
                        sensor_trigger_handler_t handler) {
    return gbRetVal;
}

int sensor_attr_set(const struct device *dev,
                    enum sensor_channel chan,
                    enum sensor_attribute attr,
                    const struct sensor_value *val) {
    return 0;
}

// --------------------------------------------------------------------

I2cBus::I2cBus() { }

I2cBus::~I2cBus() { }

I2cBus* I2cBus::inst() {
    static I2cBus myInstance;
    return &myInstance;
}

void I2cBus::init() {
    init_done = true;
}

// --------------------------------------------------------------------

spibus::spibus() { }

spibus::~spibus() { }

spibus* spibus::inst() {
    static spibus myInstance;
    return &myInstance;
}

void spibus::init() {
    init_done = true;
}

// -------------------------------------------------------------------------

Config* Config::inst() {
    static Config myInstance;
    return &myInstance;
}

Config::Config() { }

Config::~Config() { }

stCfgGeneral* Config::getCfgGeneral() { 
    // 	std::string name;    //!< Name of the device class
	// std::string type;    //!< Type of the device
	// std::string version; //!< Version of the configuration 
    static stCfgGeneral ret = {"a","a","a"};
    return &ret;
}

stCfgMetrics* Config::getCfgMetrics() { 
    // std::string interval;
    static stCfgMetrics ret = {"2"};
    return &ret;
}

stCfgDatalog* Config::getCfgDatalog() {
    // std::string dispmodeoff; 
    // std::string rawtransferon; 
    // std::string disptransferon;  
    // std::string rms_thres;   
    // std::string max_raw_per_day;
    static stCfgDatalog ret_true = {"true","true","true","25","5"};
    static stCfgDatalog ret_false = {"false","false","false","27","7"};
    if (gbRetVal) {
        return &ret_true;
    } else {
        return &ret_false;
    }
}

stCfgDisplacement* Config::getCfgDisplacement() { 
    // std::string b1;
    static stCfgDisplacement ret = {"0.0"};
    return &ret;
}

stCfgSensor*  Config::getCfgSensor(enCfgSensorId id) { 
    // std::string name;       //!< Name of the sensor
	// std::string type;       //!< Type of the sensor
	// std::string actthres;   //!< Activation threshold
	// std::string deactthres; //!< Deactivation threshold
    static stCfgSensor ret = {"aa","bb","200","20"};
    return &ret;
}

unsigned char* Config::getConfigJson() { 
    static char out[32] = "qwertz";
    return (unsigned char*)out;
}

int Config::saveToFile(std::string config) {
    return 0;
}
int Config::saveToFile() {
    return 0;
}
bool Config::isValid(const char* buf) {
    return gbRetVal;
}
void Config::Autocorrection() { }
void Config::deleteConfigFile() { }

// ----------------------------------------------------------------------------------

int adxl372_set_op_mode(const struct device *dev, enum adxl372_op_mode op_mode) {
    gIntVal = (int)op_mode;
    return gbRetVal;
}

int adxl372_get_fifo_xyz_data(const struct device* dev,
                              struct adxl372_xyz_accel_data* samples,
                              uint16_t* cnt) {
    *cnt = 6;
    return gbRetVal;
}

int adxl372_configure_fifo(const struct device* dev,
                           enum adxl372_fifo_mode mode,
                           enum adxl372_fifo_format format,
                           uint16_t fifo_samples) {
    return gbRetVal;
} 

int32_t adxl372_get_status(struct adxl372_dev *dev,
               uint8_t *status1,
               uint8_t *status2,
               uint16_t *fifo_entries) {
    return gIntVal;
}

int adxl372_set_ext_sync(const struct device* dev, int state) {
    return gbRetVal;
}

int adxl372_get_status(const struct device* dev, uint8_t* status1,
                       uint8_t* status2, uint16_t* fifo_entries) {
    return gbRetVal;
}

bool getSelftestSuccess(void) {
    return gbRetVal;
}

// ----------------------------------------------------------------------------------

int spi_transceive(const struct device *dev,
                const struct spi_config *config,
                const struct spi_buf_set *tx_bufs,
                const struct spi_buf_set *rx_bufs) {
    return gIntVal;
}

int spi_write(const struct device *dev,
                const struct spi_config *config,
                const struct spi_buf_set *tx_bufs) {
    int cmd = *((int*)(tx_bufs->buffers->buf));
    if (gIntVal == 27) {
        switch (cmd) {
            case 6:   return 0;    break;    // MB85RS4MTY_WRITE_ENABLE_CMD  6
            case 2:   return 27;   break;    // MB85RS4MTY_WRITE_CMD   2
            default:               break;
        }
    }
    //printk("tx_bufs %i, %i\n", tx_bufs->count, tx_bufs->buffers->len);
    //printk("tx_bufs %i\n\n", *((int*)(tx_bufs->buffers->buf)));
    //printk("cmd %i\n\n", cmd);
    return gIntVal;  
} 

int gpio_pin_set (const struct device *port, gpio_pin_t pin, int value) {
    if (gIntVal == 27) {
        switch (value) {
            case 0:   return 0;    break;    
            case 1:   return 27;   break;    
            default:               break;
        }
    }    
    return gIntVal;
}

int gpio_pin_configure_dt (const struct gpio_dt_spec *spec, gpio_flags_t extra_flags) {
    return gbRetVal;
}

// ----------------------------------------------------------------------------------

int adc_channel_setup_dt(const struct adc_dt_spec *spec) {
    return 0;
}

int adc_raw_to_millivolts_dt(const struct adc_dt_spec *spec, int32_t *valp) {
    return 0;
}

int adc_read(const struct device *dev, const struct adc_sequence *sequence) {
    return 0;
}

int adc_sequence_init_dt(const struct adc_dt_spec *spec, struct adc_sequence *seq) {
    return 0;
}

// ----------------------------------------------------------------------------------

char gBuf[1024];

static struct fs_file_t stFile;

FlashFS::FlashFS(const char* name) { }

FlashFS& FlashFS::inst() {
    static FlashFS myInstance("fs");
    return myInstance;
}

FlashFS::~FlashFS() { }


bool FlashFS::file_exists(const char* path) {
    return gbRetVal;
}

int FlashFS::file_sync(fs_file_t* file) {
    return 0;
}

off_t FlashFS::file_seek(fs_file_t* file, off_t offset, int whence) {
    return 0;
}

fs_file_t* FlashFS::file_open(const char* path, int flags) {
    return reinterpret_cast<fs_file_t*>(this);
}

int FlashFS::file_close(fs_file_t* file) {
    return 0;
}

ssize_t FlashFS::file_read(fs_file_t* file, void* buffer, size_t len) {
    strncpy((char*)buffer, gBuf, 1024);
    return len;
}

ssize_t FlashFS::file_write(fs_file_t* file, const void* buffer, size_t len) {
    strncpy(gBuf, (char*)buffer, 1024);
    return len;
}

int FlashFS::remove(const char* filename) {
    return 0; 
}
```

## src/stubs.h
```c
#ifndef __STUBS_H__
#define __STUBS_H__

#include <stdio.h>
#include <stdlib.h>
#include <cstdint>

extern bool gbReady;
extern bool gbRetVal;
extern int gIntVal;


#define 	ERANGE   34
#define 	SENSOR_G   9806650LL

typedef uint8_t gpio_pin_t;
typedef uint16_t gpio_dt_flags_t;
typedef uint16_t spi_operation_t;
typedef uint16_t pwm_flags_t;

struct device {
        const char *name;
        const void *config;
        const void *api;
        //struct device_state *state;
        void *data;
        //struct device_ops ops;
        //device_flags_t flags;
};
struct gpio_dt_spec {
        const struct device *port;
        gpio_pin_t pin;
        gpio_dt_flags_t dt_flags;
};
 
struct spi_cs_control {
        struct gpio_dt_spec gpio;
        uint32_t delay;
};
struct spi_config {
        uint32_t frequency;
        spi_operation_t operation;
        uint16_t slave;
        struct spi_cs_control* cs;
};
struct spi_buf {
        void *buf;
        size_t len;
};
struct spi_buf_set {
        const struct spi_buf *buffers;
        size_t count;
};

extern struct gpio_dt_spec gGpioDtSpec;

#define I2C_SPEED_SET(x) x
    
#define I2C_SPEED_STANDARD 0
#define I2C_MODE_CONTROLLER 0

#ifdef DEVICE_DT_GET
    #undef DEVICE_DT_GET
#endif
#define DEVICE_DT_GET(x) x
#define I2C_DEV_NODE NULL

#ifdef DT_NODELABEL
    #undef DT_NODELABEL
#endif    
#define DT_NODELABEL(x) x

#ifdef GPIO_DT_SPEC_GET
    #undef GPIO_DT_SPEC_GET
#endif    
#define GPIO_DT_SPEC_GET(x,y) gGpioDtSpec

#ifdef SPI_WORD_SET
    #undef SPI_WORD_SET
#endif    
#define SPI_WORD_SET(x) x

typedef uint32_t gpio_flags_t;

#define GPIO_OUTPUT_INACTIVE 0
#define GPIO_OUTPUT_ACTIVE 1



#define device_is_ready(dev) my_device_is_ready(dev)
#define k_timer_user_data_get(x) my_k_timer_user_data_get(x)
#define k_sleep(x)

int i2c_configure(const struct device *dev, uint32_t dev_config);
bool my_device_is_ready(const struct device *dev);
const struct device* device_get_binding(const char *name);

void* my_k_timer_user_data_get(k_timer* timer);

int pwm_set(const struct device *dev, uint32_t channel, uint32_t period, uint32_t pulse, pwm_flags_t flags);

int spi_transceive(const struct device *dev,
                const struct spi_config *config,
                const struct spi_buf_set *tx_bufs,
                const struct spi_buf_set *rx_bufs);

int spi_write(const struct device *dev,
                const struct spi_config *config,
                const struct spi_buf_set *tx_bufs);                                        

int gpio_pin_set (const struct device *port, gpio_pin_t pin, int value);

int gpio_pin_configure_dt (const struct gpio_dt_spec *spec, gpio_flags_t extra_flags);

// ------------------------------------------------------------------------------------

struct sensor_value {
        int32_t val1;
        int32_t val2;
};

enum sensor_channel {
        SENSOR_CHAN_ACCEL_X,
        SENSOR_CHAN_ACCEL_Y,
        SENSOR_CHAN_ACCEL_Z,
        SENSOR_CHAN_ACCEL_XYZ,
        SENSOR_CHAN_GYRO_X,
        SENSOR_CHAN_GYRO_Y,
        SENSOR_CHAN_GYRO_Z,
        SENSOR_CHAN_GYRO_XYZ,
        SENSOR_CHAN_MAGN_X,
        SENSOR_CHAN_MAGN_Y,
        SENSOR_CHAN_MAGN_Z,
        SENSOR_CHAN_MAGN_XYZ,
        SENSOR_CHAN_DIE_TEMP,
        SENSOR_CHAN_AMBIENT_TEMP,
        SENSOR_CHAN_PRESS,
        SENSOR_CHAN_PROX,
        SENSOR_CHAN_HUMIDITY,
        SENSOR_CHAN_LIGHT,
        SENSOR_CHAN_IR,
        SENSOR_CHAN_RED,
        SENSOR_CHAN_GREEN,
        SENSOR_CHAN_BLUE,
        SENSOR_CHAN_ALTITUDE,
 
        SENSOR_CHAN_PM_1_0,
        SENSOR_CHAN_PM_2_5,
        SENSOR_CHAN_PM_10,
        SENSOR_CHAN_DISTANCE,
 
        SENSOR_CHAN_CO2,
        SENSOR_CHAN_O2,
        SENSOR_CHAN_VOC,
        SENSOR_CHAN_GAS_RES,
 
        SENSOR_CHAN_VOLTAGE,
 
        SENSOR_CHAN_VSHUNT,
 
        SENSOR_CHAN_CURRENT,
        SENSOR_CHAN_POWER,
 
        SENSOR_CHAN_RESISTANCE,
 
        SENSOR_CHAN_ROTATION,
 
        SENSOR_CHAN_POS_DX,
        SENSOR_CHAN_POS_DY,
        SENSOR_CHAN_POS_DZ,
        SENSOR_CHAN_POS_DXYZ,
 
        SENSOR_CHAN_RPM,
 
        SENSOR_CHAN_FREQUENCY,
 
        SENSOR_CHAN_GAUGE_VOLTAGE,
        SENSOR_CHAN_GAUGE_AVG_CURRENT,
        SENSOR_CHAN_GAUGE_STDBY_CURRENT,
        SENSOR_CHAN_GAUGE_MAX_LOAD_CURRENT,
        SENSOR_CHAN_GAUGE_TEMP,
        SENSOR_CHAN_GAUGE_STATE_OF_CHARGE,
        SENSOR_CHAN_GAUGE_FULL_CHARGE_CAPACITY,
        SENSOR_CHAN_GAUGE_REMAINING_CHARGE_CAPACITY,
        SENSOR_CHAN_GAUGE_NOM_AVAIL_CAPACITY,
        SENSOR_CHAN_GAUGE_FULL_AVAIL_CAPACITY,
        SENSOR_CHAN_GAUGE_AVG_POWER,
        SENSOR_CHAN_GAUGE_STATE_OF_HEALTH,
        SENSOR_CHAN_GAUGE_TIME_TO_EMPTY,
        SENSOR_CHAN_GAUGE_TIME_TO_FULL,
        SENSOR_CHAN_GAUGE_CYCLE_COUNT,
        SENSOR_CHAN_GAUGE_DESIGN_VOLTAGE,
        SENSOR_CHAN_GAUGE_DESIRED_VOLTAGE,
        SENSOR_CHAN_GAUGE_DESIRED_CHARGING_CURRENT,
        SENSOR_CHAN_GAME_ROTATION_VECTOR,
        SENSOR_CHAN_GRAVITY_VECTOR,
        SENSOR_CHAN_GBIAS_XYZ,
 
        SENSOR_CHAN_ALL,
 
        SENSOR_CHAN_COMMON_COUNT,
 
        SENSOR_CHAN_PRIV_START = SENSOR_CHAN_COMMON_COUNT,
 
        SENSOR_CHAN_MAX = INT16_MAX,
};
 
enum sensor_trigger_type {
        SENSOR_TRIG_TIMER,
        SENSOR_TRIG_DATA_READY,
        SENSOR_TRIG_DELTA,
        SENSOR_TRIG_NEAR_FAR,
        SENSOR_TRIG_THRESHOLD,
 
        SENSOR_TRIG_TAP,
 
        SENSOR_TRIG_DOUBLE_TAP,
 
        SENSOR_TRIG_FREEFALL,
 
        SENSOR_TRIG_MOTION,
 
        SENSOR_TRIG_STATIONARY,
 
        SENSOR_TRIG_FIFO_WATERMARK,
 
        SENSOR_TRIG_FIFO_FULL,
 
        SENSOR_TRIG_TILT,
 
        SENSOR_TRIG_COMMON_COUNT,

        SENSOR_TRIG_FIFO,
 
        SENSOR_TRIG_PRIV_START = SENSOR_TRIG_COMMON_COUNT,
 
        SENSOR_TRIG_MAX = INT16_MAX,
};

struct sensor_trigger {
        enum sensor_trigger_type type;
        enum sensor_channel chan;
};

 
enum sensor_attribute {
        SENSOR_ATTR_SAMPLING_FREQUENCY,
        SENSOR_ATTR_LOWER_THRESH,
        SENSOR_ATTR_UPPER_THRESH,
        SENSOR_ATTR_SLOPE_TH,
        SENSOR_ATTR_SLOPE_DUR,
        /* Hysteresis for trigger thresholds. */
        SENSOR_ATTR_HYSTERESIS,
        SENSOR_ATTR_OVERSAMPLING,
        SENSOR_ATTR_FULL_SCALE,
        SENSOR_ATTR_OFFSET,
        SENSOR_ATTR_CALIB_TARGET,
        SENSOR_ATTR_CONFIGURATION,
        SENSOR_ATTR_CALIBRATION,
        SENSOR_ATTR_FEATURE_MASK,
        SENSOR_ATTR_ALERT,
        SENSOR_ATTR_FF_DUR,
 
        SENSOR_ATTR_BATCH_DURATION,
        /* Configure the gain of a sensor. */
        SENSOR_ATTR_GAIN,
        /* Configure the resolution of a sensor. */
        SENSOR_ATTR_RESOLUTION,
        SENSOR_ATTR_COMMON_COUNT,
 
        SENSOR_ATTR_PRIV_START = SENSOR_ATTR_COMMON_COUNT,
 
        SENSOR_ATTR_MAX = INT16_MAX,
};

typedef void (*sensor_trigger_handler_t)(const struct device *dev,
                                         const struct sensor_trigger *trigger);
 

int sensor_sample_fetch(const struct device *dev);

int sensor_channel_get(const struct device *dev, enum sensor_channel chan, struct sensor_value *val);

int sensor_value_from_double(struct sensor_value *val, double inp);

double sensor_value_to_double(const struct sensor_value *val);

int sensor_trigger_set(const struct device *dev,
                        const struct sensor_trigger *trig,
                        sensor_trigger_handler_t handler);

int sensor_attr_set(const struct device *dev,
                    enum sensor_channel chan,
                    enum sensor_attribute attr,
                    const struct sensor_value *val);

// ------------------------------------------------------------------------

enum adc_gain {
        ADC_GAIN_1_6, 
        ADC_GAIN_1_5, 
        ADC_GAIN_1_4, 
        ADC_GAIN_2_7, 
        ADC_GAIN_1_3, 
        ADC_GAIN_2_5, 
        ADC_GAIN_1_2, 
        ADC_GAIN_2_3, 
        ADC_GAIN_4_5, 
        ADC_GAIN_1,   
        ADC_GAIN_2,   
        ADC_GAIN_3,   
        ADC_GAIN_4,   
        ADC_GAIN_6,   
        ADC_GAIN_8,   
        ADC_GAIN_12,  
        ADC_GAIN_16,  
        ADC_GAIN_24,  
        ADC_GAIN_32,  
        ADC_GAIN_64,  
        ADC_GAIN_128, 
};

enum adc_reference {
        ADC_REF_VDD_1,     
        ADC_REF_VDD_1_2,   
        ADC_REF_VDD_1_3,   
        ADC_REF_VDD_1_4,   
        ADC_REF_INTERNAL,  
        ADC_REF_EXTERNAL0, 
        ADC_REF_EXTERNAL1, 
};

struct adc_channel_cfg {
        enum adc_gain gain;
        enum adc_reference reference;
        uint16_t acquisition_time;
        uint8_t channel_id   : 5;
        uint8_t differential : 1;
/*#ifdef CONFIG_ADC_CONFIGURABLE_INPUTS
        uint8_t input_positive;
 
        uint8_t input_negative;
#endif 
 
#ifdef CONFIG_ADC_CONFIGURABLE_EXCITATION_CURRENT_SOURCE_PIN
        uint8_t current_source_pin_set : 1;
        uint8_t current_source_pin[2];
#endif 
 
#ifdef CONFIG_ADC_CONFIGURABLE_VBIAS_PIN
        uint32_t vbias_pins;
#endif */
};

enum adc_action {
        ADC_ACTION_CONTINUE = 0,
 
        ADC_ACTION_REPEAT,
 
        ADC_ACTION_FINISH,
};
 
typedef enum adc_action (*adc_sequence_callback)(const struct device *dev,
                                                 const struct adc_sequence *sequence,
                                                 uint16_t sampling_index);
 
struct adc_sequence_options {
        uint32_t interval_us;
 
        adc_sequence_callback callback;
 
        void *user_data;
 
        uint16_t extra_samplings;
};

struct adc_sequence {
        const struct adc_sequence_options *options;
        uint32_t channels;
        void *buffer;
        size_t buffer_size;
        uint8_t resolution;
        uint8_t oversampling; 
        bool calibrate;
};
 
struct adc_dt_spec {
        const struct device *dev;
        uint8_t channel_id;
        bool channel_cfg_dt_node_exists;
        struct adc_channel_cfg channel_cfg;
        uint16_t vref_mv;
        uint8_t resolution;
        uint8_t oversampling;
};

int adc_channel_setup_dt(const struct adc_dt_spec *spec);
int adc_raw_to_millivolts_dt(const struct adc_dt_spec *spec, int32_t *valp);
int adc_read(const struct device *dev, const struct adc_sequence *sequence);
int adc_sequence_init_dt(const struct adc_dt_spec *spec, struct adc_sequence *seq);

// ------------------------------------------------------------------------

struct fs_file_t {
   FILE* pF;
};
//#define FS_O_CREATE | FS_O_RDWR "w"
#define FS_O_CREATE 0x01
#define FS_O_RDWR 0x02
#define FS_O_READ 0x04
#define FS_SEEK_SET 0

class FlashFS {
 public:
    explicit FlashFS(const char* name = "??");

    static FlashFS& inst();
    FlashFS() = delete;
    virtual ~FlashFS();
    bool file_exists(const char* path);
    int file_sync(fs_file_t* file);
    off_t file_seek(fs_file_t* file, off_t offset, int whence);    
    fs_file_t* file_open(const char* path, int flags);
    int file_close(fs_file_t* file);
    ssize_t file_read(fs_file_t* file, void* buffer, size_t size);
    ssize_t file_write(fs_file_t* file, const void* buffer, size_t size);
    int remove(const char* path);
};


#endif // __STUBS_H__
```

## src/test_adc_adconverter.cpp
```c
#include <zephyr/ztest.h>

#define private public
#include "stubs.h"
#include "drv/adc/adconverter.h"


ZTEST_SUITE(tests_drv_ADConverter, NULL, NULL, NULL, NULL, NULL);

// test constructor and destructor
ZTEST(tests_drv_ADConverter, test_drv_ADConverter_constructor)
{
	ADConverter* pAdc = new ADConverter("adc");
	zassert_not_null(pAdc, "memory alloc failed");
	zassert_not_null(pAdc->pInMbox, "pInMbox = NULL");
    zassert_equal(pAdc->pInMbox->count(), 0, "pInMbox->count() != 0");
    zassert_equal(pAdc->pInMbox, Mbox::getMboxById(Mbox::eADConverter),
                  "Error getting mailbox by id");

	delete pAdc;
}

// MISSING for 100% branch coverage static instantiation does not deliver NULL
// here code lines
// pInMbox = new Mbox("Adc");
// static PoolElem e1 = {eTimerExpired, Mbox::MboxId::eADConverter, 'a', 'd'};
// are not covered completly.

// test function initDevice
ZTEST(tests_drv_ADConverter, test_drv_ADConverter_initDevice)
{
	ADConverter* pAdc = new ADConverter("adc");
	zassert_not_null(pAdc, "memory alloc failed");
	zassert_not_null(pAdc->pInMbox, "pInMbox = NULL");
    zassert_equal(pAdc->pInMbox->count(), 0, "pInMbox->count() != 0");
    zassert_equal(pAdc->pInMbox, Mbox::getMboxById(Mbox::eADConverter),
                  "Error getting mailbox by id");

	pAdc->initDevice();

	delete pAdc;
}

//!< Structure for an user-specific timer data
struct AdcTimerInfo {
    ADConverter* self;  //!< Pointer to AD converter instance
    uint8_t ch_mask;    //!< The AD channel bitmask
};

// test function timer_cb and timer1_expired
ZTEST(tests_drv_ADConverter, test_drv_ADConverter_timer_cb)
{
    PoolElem* pElem;

	ADConverter* pAdc = new ADConverter("adc");
	zassert_not_null(pAdc, "memory alloc failed");
	zassert_not_null(pAdc->pInMbox, "pInMbox = NULL");
    zassert_equal(pAdc->pInMbox->count(), 0, "pInMbox->count() != 0");
    zassert_equal(pAdc->pInMbox, Mbox::getMboxById(Mbox::eADConverter),
                  "Error getting mailbox by id");

    //ADConverter* self;  //!< Pointer to AD converter instance
    //uint8_t ch_mask;    //!< The AD channel bitmask
	struct AdcTimerInfo adcinfo = {pAdc, 27};

    pAdc->timer_cb(reinterpret_cast<k_timer*>(&adcinfo));

    zassert_equal(pAdc->pInMbox->count(), 1, "pInMbox->count() != 1");
    pElem = pAdc->pInMbox->read();
    zassert_equal(pElem->mtype, msgType::eTimerExpired, "Rcvd mtype != msgType::eTimerExpired");

    delete pAdc;
}    

// test function notifyListener
ZTEST(tests_drv_ADConverter, test_drv_ADConverter_notifyListener)
{
    PoolElem* pElem;

	Mbox* pHttpConnectorMbox = new Mbox("HttpConnectorMbox");
    Mbox::registerMbox(pHttpConnectorMbox, Mbox::eHttpConnector);
	zassert_not_null(pHttpConnectorMbox, "pHttpConnectorMbox = NULL");

	ADConverter* pAdc = new ADConverter("adc");
	zassert_not_null(pAdc, "memory alloc failed");
	zassert_not_null(pAdc->pInMbox, "pInMbox = NULL");
    zassert_equal(pAdc->pInMbox->count(), 0, "pInMbox->count() != 0");
    zassert_equal(pAdc->pInMbox, Mbox::getMboxById(Mbox::eADConverter),
                  "Error getting mailbox by id");

    pAdc->adc_listeners[0] = pHttpConnectorMbox;
	pAdc->notifyListener(0, 17, 27);

    pElem = pHttpConnectorMbox->read();
    zassert_equal(pElem->mtype, msgType::eAdcData, "Rcvd mtype != msgType::eAdcData");
    zassert_equal(pElem->from, Mbox::eADConverter, "Rcvd sender != Mbox::eADConverter");

	struct ADInput ad_in = *reinterpret_cast<struct ADInput*>(pElem->getBuffer());
    zassert_equal(ad_in.channel, 0, "wrong channel");
    zassert_equal(ad_in.raw, 17, "wrong raw");
    zassert_equal(ad_in.mv, 27, "wrong mv");
	
    pElem->free();
    delete pHttpConnectorMbox;
    delete pAdc;
}    

// test function sample
ZTEST(tests_drv_ADConverter, test_drv_ADConverter_sample)
{
	ADConverter* pAdc = new ADConverter("adc");
	zassert_not_null(pAdc, "memory alloc failed");
	zassert_not_null(pAdc->pInMbox, "pInMbox = NULL");
    zassert_equal(pAdc->pInMbox->count(), 0, "pInMbox->count() != 0");
    zassert_equal(pAdc->pInMbox, Mbox::getMboxById(Mbox::eADConverter),
                  "Error getting mailbox by id");

	pAdc->sample(0xFF);
	pAdc->sample(0x00);

    delete pAdc;
}    

//Test receive msg eTimerExpired
ZTEST(tests_drv_ADConverter, test_drv_ADConverter_rcv_msg_eTimerExpired)
{
	uint8_t p1 = 0xFF;

	ADConverter* pAdc = new ADConverter("adc");
	zassert_not_null(pAdc, "memory alloc failed");
	zassert_not_null(pAdc->pInMbox, "pInMbox = NULL");
    zassert_equal(pAdc->pInMbox->count(), 0, "pInMbox->count() != 0");
    zassert_equal(pAdc->pInMbox, Mbox::getMboxById(Mbox::eADConverter),
                  "Error getting mailbox by id");

    Mbox::sendMsg(msgType::eTimerExpired, Mbox::eADConverter, Mbox::eADConverter, p1);

    zassert_equal(pAdc->pInMbox->count(), 1, "pInMbox->count() != 1");

    pAdc->task();  

    zassert_equal(pAdc->pInMbox->count(), 0, "pInMbox->count() != 0");

	delete pAdc; 
}

//Test receive msg eAdcReport
ZTEST(tests_drv_ADConverter, test_drv_ADConverter_rcv_msg_eAdcReport)
{
	uint8_t p1 = 0xFF;

	ADConverter* pAdc = new ADConverter("adc");
	zassert_not_null(pAdc, "memory alloc failed");
	zassert_not_null(pAdc->pInMbox, "pInMbox = NULL");
    zassert_equal(pAdc->pInMbox->count(), 0, "pInMbox->count() != 0");
    zassert_equal(pAdc->pInMbox, Mbox::getMboxById(Mbox::eADConverter),
                  "Error getting mailbox by id");

    Mbox::sendMsg(msgType::eAdcReport, Mbox::eADConverter, Mbox::eADConverter, p1);

    zassert_equal(pAdc->pInMbox->count(), 1, "pInMbox->count() != 1");

    pAdc->task();  

    zassert_equal(pAdc->pInMbox->count(), 0, "pInMbox->count() != 0");

	delete pAdc; 
}

//Test receive unexpected msg 
ZTEST(tests_drv_ADConverter, test_drv_ADConverter_rcv_msg_unexpected)
{
	ADConverter* pAdc = new ADConverter("adc");
	zassert_not_null(pAdc, "memory alloc failed");
	zassert_not_null(pAdc->pInMbox, "pInMbox = NULL");
    zassert_equal(pAdc->pInMbox->count(), 0, "pInMbox->count() != 0");
    zassert_equal(pAdc->pInMbox, Mbox::getMboxById(Mbox::eADConverter),
                  "Error getting mailbox by id");

    Mbox::sendMsg(msgType::eResetCause, Mbox::eADConverter, Mbox::eADConverter);

    zassert_equal(pAdc->pInMbox->count(), 1, "pInMbox->count() != 1");

    pAdc->task();  

    zassert_equal(pAdc->pInMbox->count(), 0, "pInMbox->count() != 0");
	delete pAdc; 
}

//Test receive no msg 
ZTEST(tests_drv_ADConverter, test_drv_ADConverter_rcv_msg_none)
{
	ADConverter* pAdc = new ADConverter("adc");
	zassert_not_null(pAdc, "memory alloc failed");
	zassert_not_null(pAdc->pInMbox, "pInMbox = NULL");
    zassert_equal(pAdc->pInMbox->count(), 0, "pInMbox->count() != 0");
    zassert_equal(pAdc->pInMbox, Mbox::getMboxById(Mbox::eADConverter),
                  "Error getting mailbox by id");

    pAdc->pInMbox->write(NULL);
    
    pAdc->task();  

    zassert_equal(pAdc->pInMbox->count(), 0, "pInMbox->count() != 0");
	delete pAdc; 
}
```

## src/test_adc_batt_mgr.cpp
```c
#include <zephyr/ztest.h>

#define private public
#include "drv/adc/batt_mgr.h"
#include "drv/adc/adconverter.h"

#include "stubs.h"

ZTEST_SUITE(tests_drv_BatteryMgr, NULL, NULL, NULL, NULL, NULL);

// test constructor and destructor
ZTEST(tests_drv_BatteryMgr, test_drv_BatteryMgr_constructor)
{
	BatteryMgr* pBattMgr = new BatteryMgr("battmgr");
	zassert_not_null(pBattMgr, "memory alloc failed");
	zassert_not_null(pBattMgr->pInMbox, "pInMbox = NULL");
    zassert_equal(pBattMgr->pInMbox->count(), 0, "pInMbox->count() != 0");
    zassert_equal(pBattMgr->pInMbox, Mbox::getMboxById(Mbox::eBattMgr),
                  "Error getting mailbox by id");

	//printk("%x\n", pBattMgr->adcChannels);
	zassert_equal(pBattMgr->adcChannels, 0x8E, "pBattMgr->adcChannels != 0x47");
 
	delete pBattMgr;
}

// MISSING for 100% branch coverage static instantiation does not deliver NULL
// here code line 
// pInMbox = new Mbox(name);
// are not covered completly.

// test function reqAdcReport
ZTEST(tests_drv_BatteryMgr, test_drv_BatteryMgr_reqAdcReport)
{
    PoolElem* pElem;

	Mbox* pAdcMbox = new Mbox("AdcMbox");
    Mbox::registerMbox(pAdcMbox, Mbox::eADConverter);
	zassert_not_null(pAdcMbox, "pAdcMbox = NULL");

	BatteryMgr* pBattMgr = new BatteryMgr("battmgr");
	zassert_not_null(pBattMgr, "memory alloc failed");
	zassert_not_null(pBattMgr->pInMbox, "pInMbox = NULL");
    zassert_equal(pBattMgr->pInMbox->count(), 0, "pInMbox->count() != 0");
    zassert_equal(pBattMgr->pInMbox, Mbox::getMboxById(Mbox::eBattMgr),
                  "Error getting mailbox by id");

	pBattMgr->reqAdcReport(0xFF);
 
    pElem = pAdcMbox->read();
    zassert_equal(pElem->mtype, msgType::eAdcReport, "Rcvd mtype != msgType::eAdcReport");
    zassert_equal(pElem->from, Mbox::eBattMgr, "Rcvd sender != Mbox::eBattMgr");

    pElem->free();
    delete pAdcMbox;
	delete pBattMgr;
}

//Test receive msg eTimerExpired
ZTEST(tests_drv_BatteryMgr, test_drv_BatteryMgr_rcv_msg_eTimerExpired)
{
	BatteryMgr* pBattMgr = new BatteryMgr("battmgr");
	zassert_not_null(pBattMgr, "memory alloc failed");
	zassert_not_null(pBattMgr->pInMbox, "pInMbox = NULL");
    zassert_equal(pBattMgr->pInMbox->count(), 0, "pInMbox->count() != 0");
    zassert_equal(pBattMgr->pInMbox, Mbox::getMboxById(Mbox::eBattMgr),
                  "Error getting mailbox by id");

    Mbox::sendMsg(msgType::eTimerExpired, Mbox::eBattMgr, Mbox::eBattMgr);

    zassert_equal(pBattMgr->pInMbox->count(), 1, "pInMbox->count() != 1");

    pBattMgr->task();  

    zassert_equal(pBattMgr->pInMbox->count(), 0, "pInMbox->count() != 0");

	delete pBattMgr; 
}

//Test receive msg eAdcData
ZTEST(tests_drv_BatteryMgr, test_drv_BatteryMgr_rcv_msg_eAdcData)
{
    PoolElem* pElem;

	Mbox* pDataMgrMbox = new Mbox("DataMgrMbox");
    Mbox::registerMbox(pDataMgrMbox, Mbox::eDataManager);
	zassert_not_null(pDataMgrMbox, "pDataMgrMbox = NULL");

	BatteryMgr* pBattMgr = new BatteryMgr("battmgr");
	zassert_not_null(pBattMgr, "memory alloc failed");
	zassert_not_null(pBattMgr->pInMbox, "pInMbox = NULL");
    zassert_equal(pBattMgr->pInMbox->count(), 0, "pInMbox->count() != 0");
    zassert_equal(pBattMgr->pInMbox, Mbox::getMboxById(Mbox::eBattMgr),
                  "Error getting mailbox by id");

    struct ADInput ad_in = {7, 17, 27};
	Mbox::sendMsg(msgType::eAdcData, Mbox::eBattMgr, Mbox::eBattMgr, (uint8_t*)&ad_in, sizeof(ad_in));

    zassert_equal(pBattMgr->pInMbox->count(), 1, "pInMbox->count() != 1");

    pBattMgr->task();  

    zassert_equal(pBattMgr->pInMbox->count(), 0, "pInMbox->count() != 0");

	pElem = pDataMgrMbox->read(); 
    zassert_equal(pElem->mtype, msgType::eAdcData, "Rcvd mtype != msgType::eAdcData");
    zassert_equal(pElem->from, Mbox::eBattMgr, "Rcvd sender != Mbox::eBattMgr");

	struct ADInput ad_in2 =  *reinterpret_cast<struct ADInput*>(pElem->getBuffer());
    zassert_equal(ad_in2.channel, 7, "channel != 7");
    zassert_equal(ad_in2.raw, 17, "raw != 17");
    zassert_equal(ad_in2.mv, 27, "mv != 27");

	pElem->free();
	delete pDataMgrMbox;
	delete pBattMgr; 
}

//Test receive msg eBattReport
ZTEST(tests_drv_BatteryMgr, test_drv_BatteryMgr_rcv_msg_eBattReport)
{
    PoolElem* pElem;

	Mbox* pAdcMbox = new Mbox("AdcMbox");
    Mbox::registerMbox(pAdcMbox, Mbox::eADConverter);
	zassert_not_null(pAdcMbox, "pAdcMbox = NULL");

	BatteryMgr* pBattMgr = new BatteryMgr("battmgr");
	zassert_not_null(pBattMgr, "memory alloc failed");
	zassert_not_null(pBattMgr->pInMbox, "pInMbox = NULL");
    zassert_equal(pBattMgr->pInMbox->count(), 0, "pInMbox->count() != 0");
    zassert_equal(pBattMgr->pInMbox, Mbox::getMboxById(Mbox::eBattMgr),
                  "Error getting mailbox by id");

	pBattMgr->adcChannels = 0xFF;
	Mbox::sendMsg(msgType::eBattReport, Mbox::eBattMgr, Mbox::eBattMgr);

    zassert_equal(pBattMgr->pInMbox->count(), 1, "pInMbox->count() != 1");

    pBattMgr->task();  

    zassert_equal(pBattMgr->pInMbox->count(), 0, "pInMbox->count() != 0");

	pElem = pAdcMbox->read(); 
    zassert_equal(pElem->mtype, msgType::eAdcReport, "Rcvd mtype != msgType::eAdcReport");
    zassert_equal(pElem->from, Mbox::eBattMgr, "Rcvd sender != Mbox::eBattMgr");

    pElem->free();
    delete pAdcMbox;
	delete pBattMgr;
}



//Test receive unexpected msg 
ZTEST(tests_drv_BatteryMgr, test_drv_BatteryMgr_rcv_msg_unexpected)
{
	BatteryMgr* pBattMgr = new BatteryMgr("battmgr");
	zassert_not_null(pBattMgr, "memory alloc failed");
	zassert_not_null(pBattMgr->pInMbox, "pInMbox = NULL");
    zassert_equal(pBattMgr->pInMbox->count(), 0, "pInMbox->count() != 0");
    zassert_equal(pBattMgr->pInMbox, Mbox::getMboxById(Mbox::eBattMgr),
                  "Error getting mailbox by id");

    Mbox::sendMsg(msgType::eResetCause, Mbox::eBattMgr, Mbox::eBattMgr);

    zassert_equal(pBattMgr->pInMbox->count(), 1, "pInMbox->count() != 1");

    pBattMgr->task();  

    zassert_equal(pBattMgr->pInMbox->count(), 0, "pInMbox->count() != 0");
	delete pBattMgr; 
}

//Test receive no msg 
ZTEST(tests_drv_BatteryMgr, test_drv_BatteryMgr_rcv_msg_none)
{
	BatteryMgr* pBattMgr = new BatteryMgr("battmgr");
	zassert_not_null(pBattMgr, "memory alloc failed");
	zassert_not_null(pBattMgr->pInMbox, "pInMbox = NULL");
    zassert_equal(pBattMgr->pInMbox->count(), 0, "pInMbox->count() != 0");
    zassert_equal(pBattMgr->pInMbox, Mbox::getMboxById(Mbox::eBattMgr),
                  "Error getting mailbox by id");

    pBattMgr->pInMbox->write(NULL);
    
    pBattMgr->task();  

    zassert_equal(pBattMgr->pInMbox->count(), 0, "pInMbox->count() != 0");
	delete pBattMgr; 
}
```

## src/test_i2c_shtcx.cpp
```c
#include <zephyr/ztest.h>

#define private public
#include "rtos/mbox.h"
#include "rtos/mpelem.h"
#include "rtos/mpool.h"
#include "rtos/mqueue.h"
#include "rtos/task.h"
#include "rtos/timer.h"

#include "drv/i2c/shtcx.h"

#include "stubs.h"

ZTEST_SUITE(tests_drv_Shtcx, NULL, NULL, NULL, NULL, NULL);

// test constructor and destructor
ZTEST(tests_drv_Shtcx, test_drv_Shtcx_constructor)
{
	Shtcx* pShtcx = new Shtcx("shctx");
	zassert_not_null(pShtcx, "memory alloc failed");
	zassert_not_null(pShtcx->pInMbox, "pInMbox = NULL");
	zassert_not_null(pShtcx->myTimer, "myTimer = NULL");
    zassert_equal(pShtcx->pInMbox->count(), 0, "pInMbox->count() != 0");
    zassert_equal(pShtcx->pInMbox, Mbox::getMboxById(Mbox::eShtcxTask),
                  "Error getting mailbox by id");

	delete pShtcx;
}

// MISSING for 100% branch coverage static instantiation does not deliver NULL
// here code lines
// static PoolElem e1 = {eTimerExpired, Mbox::MboxId::eShtcxTask, 's', 'h'};
// pInMbox = new Mbox(name);
// myTimer = new Timer(Shtcx::timer_cb, this, 5, 5);
// are not covered completly.

// test function initDevice
ZTEST(tests_drv_Shtcx, test_drv_Shtcx_initDevice)
{
	Shtcx* pShtcx = new Shtcx("shctx");
	zassert_not_null(pShtcx, "memory alloc failed");
	zassert_not_null(pShtcx->pInMbox, "pInMbox = NULL");
	zassert_not_null(pShtcx->myTimer, "myTimer = NULL");
    zassert_equal(pShtcx->pInMbox->count(), 0, "pInMbox->count() != 0");
    zassert_equal(pShtcx->pInMbox, Mbox::getMboxById(Mbox::eShtcxTask),
                  "Error getting mailbox by id");

	gbReady = true;
	pShtcx->initDevice();
	zassert_true(pShtcx->device_good, "device_good != true");

	delete pShtcx;
}

// test function initDevice
ZTEST(tests_drv_Shtcx, test_drv_Shtcx_initDevice2)
{
	Shtcx* pShtcx = new Shtcx("shctx");
	zassert_not_null(pShtcx, "memory alloc failed");
	zassert_not_null(pShtcx->pInMbox, "pInMbox = NULL");
	zassert_not_null(pShtcx->myTimer, "myTimer = NULL");
    zassert_equal(pShtcx->pInMbox->count(), 0, "pInMbox->count() != 0");
    zassert_equal(pShtcx->pInMbox, Mbox::getMboxById(Mbox::eShtcxTask),
                  "Error getting mailbox by id");

	gbReady = false;
	pShtcx->initDevice();
	zassert_false(pShtcx->device_good, "device_good != false");

	delete pShtcx;
}

// test function timer_cb and timer1_expired
ZTEST(tests_drv_Shtcx, test_drv_Shtcx_timer_cb)
{
    PoolElem* pElem;

	Shtcx* pShtcx = new Shtcx("shctx");
	zassert_not_null(pShtcx, "memory alloc failed");
	zassert_not_null(pShtcx->pInMbox, "pInMbox = NULL");
	zassert_not_null(pShtcx->myTimer, "myTimer = NULL");
    zassert_equal(pShtcx->pInMbox->count(), 0, "pInMbox->count() != 0");
    zassert_equal(pShtcx->pInMbox, Mbox::getMboxById(Mbox::eShtcxTask),
                  "Error getting mailbox by id");

    pShtcx->timer_cb(reinterpret_cast<k_timer*>(pShtcx));

    zassert_equal(pShtcx->pInMbox->count(), 1, "pInMbox->count() != 1");
    pElem = pShtcx->pInMbox->read();
    zassert_equal(pElem->mtype, msgType::eTimerExpired, "Rcvd mtype != msgType::eTimerExpired");

    delete pShtcx;
}    

// test function sample
ZTEST(tests_drv_Shtcx, test_drv_Shtcx_sample)
{
	Shtcx* pShtcx = new Shtcx("shctx");
	zassert_not_null(pShtcx, "memory alloc failed");
	zassert_not_null(pShtcx->pInMbox, "pInMbox = NULL");
	zassert_not_null(pShtcx->myTimer, "myTimer = NULL");
    zassert_equal(pShtcx->pInMbox->count(), 0, "pInMbox->count() != 0");
    zassert_equal(pShtcx->pInMbox, Mbox::getMboxById(Mbox::eShtcxTask),
                  "Error getting mailbox by id");

    gbReady = false;
	pShtcx->sample();

	delete pShtcx;
}

// test function dump
ZTEST(tests_drv_Shtcx, test_drv_Shtcx_dump)
{
	Shtcx* pShtcx = new Shtcx("shctx");
	zassert_not_null(pShtcx, "memory alloc failed");
	zassert_not_null(pShtcx->pInMbox, "pInMbox = NULL");
	zassert_not_null(pShtcx->myTimer, "myTimer = NULL");
    zassert_equal(pShtcx->pInMbox->count(), 0, "pInMbox->count() != 0");
    zassert_equal(pShtcx->pInMbox, Mbox::getMboxById(Mbox::eShtcxTask),
                  "Error getting mailbox by id");

	pShtcx->dump();

	delete pShtcx;
}

// test function readTemperature
ZTEST(tests_drv_Shtcx, test_drv_Shtcx_readTemperature)
{
	Shtcx* pShtcx = new Shtcx("shctx");
	zassert_not_null(pShtcx, "memory alloc failed");
	zassert_not_null(pShtcx->pInMbox, "pInMbox = NULL");
	zassert_not_null(pShtcx->myTimer, "myTimer = NULL");
    zassert_equal(pShtcx->pInMbox->count(), 0, "pInMbox->count() != 0");
    zassert_equal(pShtcx->pInMbox, Mbox::getMboxById(Mbox::eShtcxTask),
                  "Error getting mailbox by id");

	pShtcx->device_good = false;
	pShtcx->readTemperature();

	delete pShtcx;
}

// test function readHumidity
ZTEST(tests_drv_Shtcx, test_drv_Shtcx_readHumidity)
{
	Shtcx* pShtcx = new Shtcx("shctx");
	zassert_not_null(pShtcx, "memory alloc failed");
	zassert_not_null(pShtcx->pInMbox, "pInMbox = NULL");
	zassert_not_null(pShtcx->myTimer, "myTimer = NULL");
    zassert_equal(pShtcx->pInMbox->count(), 0, "pInMbox->count() != 0");
    zassert_equal(pShtcx->pInMbox, Mbox::getMboxById(Mbox::eShtcxTask),
                  "Error getting mailbox by id");

	pShtcx->device_good = false;
	pShtcx->readHumidity();

	delete pShtcx;
}

//Test receive msg eTimerExpired
ZTEST(tests_drv_Shtcx, test_drv_Shtcx_rcv_msg_eTimerExpired)
{
	Shtcx* pShtcx = new Shtcx("shctx");
	zassert_not_null(pShtcx, "memory alloc failed");
	zassert_not_null(pShtcx->pInMbox, "pInMbox = NULL");
	zassert_not_null(pShtcx->myTimer, "myTimer = NULL");
    zassert_equal(pShtcx->pInMbox->count(), 0, "pInMbox->count() != 0");
    zassert_equal(pShtcx->pInMbox, Mbox::getMboxById(Mbox::eShtcxTask),
                  "Error getting mailbox by id");

    gbReady = true;
	pShtcx->device_good = false;
    Mbox::sendMsg(msgType::eTimerExpired, Mbox::eShtcxTask, Mbox::eShtcxTask);

    zassert_equal(pShtcx->pInMbox->count(), 1, "pInMbox->count() != 1");

    pShtcx->task();  

    zassert_equal(pShtcx->pInMbox->count(), 0, "pInMbox->count() != 0");

	delete pShtcx; 
}

//Test receive msg eShtcxReport
ZTEST(tests_drv_Shtcx, test_drv_Shtcx_rcv_msg_eShtcxReport)
{
    PoolElem* pElem;

	Mbox* pDataMgrMbox = new Mbox("DataMgrMbox");
    Mbox::registerMbox(pDataMgrMbox, Mbox::eDataManager);
	zassert_not_null(pDataMgrMbox, "pDataMgrMbox = NULL");

	Shtcx* pShtcx = new Shtcx("shctx");
	zassert_not_null(pShtcx, "memory alloc failed");
	zassert_not_null(pShtcx->pInMbox, "pInMbox = NULL");
	zassert_not_null(pShtcx->myTimer, "myTimer = NULL");
    zassert_equal(pShtcx->pInMbox->count(), 0, "pInMbox->count() != 0");
    zassert_equal(pShtcx->pInMbox, Mbox::getMboxById(Mbox::eShtcxTask),
                  "Error getting mailbox by id");

    gbReady = true;
	pShtcx->device_good = true;
	Mbox::sendMsg(msgType::eShtcxReport, Mbox::eShtcxTask, Mbox::eShtcxTask);

    zassert_equal(pShtcx->pInMbox->count(), 1, "pInMbox->count() != 1");

    pShtcx->task();  

    zassert_equal(pShtcx->pInMbox->count(), 0, "pInMbox->count() != 0");

	pElem = pDataMgrMbox->read(); 
    zassert_equal(pElem->mtype, msgType::eShtcxTemperature, "Rcvd mtype != msgType::eShtcxTemperature");
    zassert_equal(pElem->from, Mbox::eShtcxTask, "Rcvd sender != Mbox::eShtcxTask");
	pElem->free();

	pElem = pDataMgrMbox->read(); 
    zassert_equal(pElem->mtype, msgType::eShtcxHumidity, "Rcvd mtype != msgType::eShtcxHumidity");
    zassert_equal(pElem->from, Mbox::eShtcxTask, "Rcvd sender != Mbox::eShtcxTask");

    pElem->free();
    delete pDataMgrMbox;
	delete pShtcx;
}

//Test receive unexpected msg 
ZTEST(tests_drv_Shtcx, test_drv_Shtcx_rcv_msg_unexpected)
{
	Shtcx* pShtcx = new Shtcx("shctx");
	zassert_not_null(pShtcx, "memory alloc failed");
	zassert_not_null(pShtcx->pInMbox, "pInMbox = NULL");
	zassert_not_null(pShtcx->myTimer, "myTimer = NULL");
    zassert_equal(pShtcx->pInMbox->count(), 0, "pInMbox->count() != 0");
    zassert_equal(pShtcx->pInMbox, Mbox::getMboxById(Mbox::eShtcxTask),
                  "Error getting mailbox by id");

    Mbox::sendMsg(msgType::eResetCause, Mbox::eShtcxTask, Mbox::eShtcxTask);

    zassert_equal(pShtcx->pInMbox->count(), 1, "pInMbox->count() != 1");

    pShtcx->task();  

    zassert_equal(pShtcx->pInMbox->count(), 0, "pInMbox->count() != 0");
	delete pShtcx; 
}

//Test receive no msg 
ZTEST(tests_drv_Shtcx, test_drv_Shtcx_rcv_msg_none)
{
	Shtcx* pShtcx = new Shtcx("shctx");
	zassert_not_null(pShtcx, "memory alloc failed");
	zassert_not_null(pShtcx->pInMbox, "pInMbox = NULL");
	zassert_not_null(pShtcx->myTimer, "myTimer = NULL");
    zassert_equal(pShtcx->pInMbox->count(), 0, "pInMbox->count() != 0");
    zassert_equal(pShtcx->pInMbox, Mbox::getMboxById(Mbox::eShtcxTask),
                  "Error getting mailbox by id");

    pShtcx->pInMbox->write(NULL);
    
    pShtcx->task();  

    zassert_equal(pShtcx->pInMbox->count(), 0, "pInMbox->count() != 0");
	delete pShtcx; 
}
```

## src/test_pwm_pwm.cpp
```c
#include <zephyr/ztest.h>

#define private public
#include "drv/pwm/pwm.h"

#include "stubs.h"

ZTEST_SUITE(tests_drv_Pwm, NULL, NULL, NULL, NULL, NULL);

// test constructor and destructor
ZTEST(tests_drv_Pwm, test_drv_Pwm_constructor)
{
	Pwm* pPwm = new Pwm();

	zassert_not_null(pPwm, "memory alloc failed");
	zassert_false(pPwm->polarity_inverted, "polarity_inverted != false");
	zassert_equal(pPwm->period, 50000, "period != 50000");
	zassert_equal(pPwm->pulse, 25000, "pulse != 25000");

	delete pPwm;
}

// MISSING for 100% branch coverage static instantiation does not deliver NULL
// here code line 
// static Pwm myInstance;
// are not covered completly.

// test function init
ZTEST(tests_drv_Pwm, test_drv_Pwm_init)
{
	Pwm* pPwm = new Pwm();
	zassert_not_null(pPwm, "memory alloc failed");

	gbReady  = true;
	pPwm->init_done = true;

	pPwm->init();
	zassert_true(pPwm->init_done, "init_done != true");

	delete pPwm;
}

// test function init
ZTEST(tests_drv_Pwm, test_drv_Pwm_init2)
{
	Pwm* pPwm = new Pwm();
	zassert_not_null(pPwm, "memory alloc failed");

	gbReady  = true;
	pPwm->init_done = false;

	pPwm->init();
	zassert_true(pPwm->init_done, "init_done != true");

	delete pPwm;
}

// test function init
ZTEST(tests_drv_Pwm, test_drv_Pwm_init3)
{
	Pwm* pPwm = new Pwm();
	zassert_not_null(pPwm, "memory alloc failed");

	gbReady  = false;
	pPwm->init_done = false;

	pPwm->init();
	zassert_true(pPwm->init_done, "init_done != true");

	delete pPwm;
}

// test function setPeriod, setPulseWidth, sync, start, stop
ZTEST(tests_drv_Pwm, test_drv_Pwm_setPeriod)
{
	Pwm::inst()->setPeriod(17);
	zassert_equal(Pwm::inst()->period, 17, "period != 17");

	Pwm::inst()->setPulseWidth(27);
	zassert_equal(Pwm::inst()->pulse, 27, "pulse != 27");

	gbRetVal = true;
	Pwm::inst()->sync();
	Pwm::inst()->start();
	Pwm::inst()->stop();
	
	gbRetVal = false;
	Pwm::inst()->sync();
	Pwm::inst()->start();
	Pwm::inst()->stop();
	
}
```
