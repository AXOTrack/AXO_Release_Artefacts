## CMakeLists.txt
```
cmake_minimum_required(VERSION 3.20.0)
find_package(Zephyr REQUIRED HINTS $ENV{ZEPHYR_BASE})
project(bus)

FILE(GLOB app_sources src/test_i2c.cpp
                      src/test_spi.cpp
                      #src/test_mb_client.cpp
                      #src/test_mb_server.cpp
                      src/stubs.cpp
                      src/test_zz_exit.cpp
)
target_sources(app PRIVATE ${app_sources}
	../../common/src/bus/i2c/i2cbus.cpp
	../../common/src/bus/spi/spibus.cpp
    #../../common/src/bus/mb/modbus_client.cpp
	#../../common/src/bus/mb/modbus_server.cpp
)


zephyr_include_directories(../../include)
zephyr_include_directories(../../common/src)
#zephyr_include_directories(../../app-axo-x1/src)

zephyr_compile_options(-Wno-pointer-arith -Wno-unused-variable -Wno-psabi)
```

## prj.conf
```kconfig
CONFIG_ZTEST=y
CONFIG_ZTEST_NEW_API=y

CONFIG_MAIN_STACK_SIZE=8192
#4096

CONFIG_ZTEST_STACK_SIZE=65536
#32768

CONFIG_LOG=y
CONFIG_PRINTK=y
CONFIG_CPLUSPLUS=y
CONFIG_LIB_CPLUSPLUS=y
CONFIG_EXCEPTIONS=n
CONFIG_STD_CPP17=y
CONFIG_NEWLIB_LIBC=y
CONFIG_NEWLIB_LIBC_MIN_REQUIRED_HEAP_SIZE=4096

# disable assert macros
CONFIG_ASSERT=n
CONFIG_ASSERT_TEST=n

# memory usage
CONFIG_MEM_SLAB_TRACE_MAX_UTILIZATION=y 
CONFIG_SYS_HEAP_RUNTIME_STATS=y

CONFIG_HEAP_MEM_POOL_SIZE=16384

CONFIG_CBPRINTF_FP_SUPPORT=y

# CJSON
CONFIG_NEWLIB_LIBC_FLOAT_PRINTF=y
CONFIG_CJSON_LIB=y

CONFIG_NUM_COOP_PRIORITIES=10
CONFIG_NUM_PREEMPT_PRIORITIES=10
CONFIG_SCHED_SCALABLE=y

# Enable thread awareness for debugging tools supporting it
CONFIG_INIT_STACKS=y
CONFIG_THREAD_NAME=y
CONFIG_THREAD_STACK_INFO=y
CONFIG_THREAD_RUNTIME_STATS=y
CONFIG_THREAD_MONITOR=y
CONFIG_DEBUG_THREAD_INFO=y

#CONFIG_UNIT_TEST=y
CONFIG_UNIT_TEST_BUS=y
CONFIG_COVERAGE=y
CONFIG_COVERAGE_DUMP=y
```

## src/__test_mb_client.cpp
```c
#include <zephyr/ztest.h>

#define private public
#include "bus/mb/modbus_client.h"

#include "stubs.h"

ZTEST_SUITE(tests_bus_mb_client, NULL, NULL, NULL, NULL, NULL);

// test constructor and destructor
ZTEST(tests_bus_mb_client, test_bus_mb_client_constructor)
{
	ModbusRtuClient* pModBus = new ModbusRtuClient();

	zassert_not_null(pModBus, "memory alloc failed");

	delete pModBus;
}

/*/ test init
ZTEST(tests_bus_mb_client, test_bus_mb_client_init)
{
	I2cBus::inst()->init();
	zassert_true(I2cBus::inst()->init_done, "init_done != true");
}

// test init
ZTEST(tests_bus_mb_client, test_bus_mb_client_init2)
{
	I2cBus::inst()->init_done = true;
	I2cBus::inst()->init();
	zassert_true(I2cBus::inst()->init_done, "init_done != true");
}

// test init
ZTEST(tests_bus_mb_client, test_bus_mb_client_init3)
{
	I2cBus::inst()->init_done = false;
	gbRetVal = true;
	gbReady = true;
	I2cBus::inst()->init();
	zassert_true(I2cBus::inst()->init_done, "init_done != true");
}

// test init
ZTEST(tests_bus_mb_client, test_bus_mb_client_init4)
{
	I2cBus::inst()->init_done = false;
	gbRetVal = true;
	gbReady = false;
	I2cBus::inst()->init();
	zassert_true(I2cBus::inst()->init_done, "init_done != true");
}

// test init
ZTEST(tests_bus_mb_client, test_bus_mb_client_init5)
{
	I2cBus::inst()->init_done = false;
	gbRetVal = false;
	gbReady = true;
	I2cBus::inst()->init();
	zassert_true(I2cBus::inst()->init_done, "init_done != true");
}

// test init
ZTEST(tests_bus_mb_client, test_bus_mb_client_init6)
{
	I2cBus::inst()->init_done = false;
	gbRetVal = false;
	gbReady = false;
	I2cBus::inst()->init();
	zassert_true(I2cBus::inst()->init_done, "init_done != true");
}
*/
```

## src/__test_mb_server.cpp
```c
#include <zephyr/ztest.h>

#define private public
#include "bus/mb/modbus_server.h"

#include "stubs.h"

ZTEST_SUITE(tests_bus_mb_server, NULL, NULL, NULL, NULL, NULL);

// test constructor and destructor
ZTEST(tests_bus_mb_server, test_bus_mb_server_constructor)
{
	I2cBus* pI2cBus = new I2cBus();

	zassert_not_null(pI2cBus, "memory alloc failed");

	delete pI2cBus;
}

/*/ test init
ZTEST(tests_bus_mb_server, test_bus_mb_server_init)
{
	I2cBus::inst()->init();
	zassert_true(I2cBus::inst()->init_done, "init_done != true");
}

// test init
ZTEST(tests_bus_mb_server, test_bus_mb_server_init2)
{
	I2cBus::inst()->init_done = true;
	I2cBus::inst()->init();
	zassert_true(I2cBus::inst()->init_done, "init_done != true");
}

// test init
ZTEST(tests_bus_mb_server, test_bus_mb_server_init3)
{
	I2cBus::inst()->init_done = false;
	gbRetVal = true;
	gbReady = true;
	I2cBus::inst()->init();
	zassert_true(I2cBus::inst()->init_done, "init_done != true");
}

// test init
ZTEST(tests_bus_mb_server, test_bus_mb_server_init4)
{
	I2cBus::inst()->init_done = false;
	gbRetVal = true;
	gbReady = false;
	I2cBus::inst()->init();
	zassert_true(I2cBus::inst()->init_done, "init_done != true");
}

// test init
ZTEST(tests_bus_mb_server, test_bus_mb_server_init5)
{
	I2cBus::inst()->init_done = false;
	gbRetVal = false;
	gbReady = true;
	I2cBus::inst()->init();
	zassert_true(I2cBus::inst()->init_done, "init_done != true");
}

// test init
ZTEST(tests_bus_mb_server, test_bus_mb_server_init6)
{
	I2cBus::inst()->init_done = false;
	gbRetVal = false;
	gbReady = false;
	I2cBus::inst()->init();
	zassert_true(I2cBus::inst()->init_done, "init_done != true");
}
*/
```

## src/stubs.cpp
```c
#define private public
/*#include "rtos/mbox.h"
#include "rtos/mpelem.h"
#include "rtos/mpool.h"
#include "rtos/mqueue.h"
#include "rtos/task.h"
#include "rtos/task.h"

#include "bus/spi/spibus.h"
#include "drv/spi/fram.h"
#include "drv/spi/adxl37x.h"
#include "conf/config.h"
#include "./version.h"
*/

#include "stubs.h"

extern "C" void qemu_exit(int status) {
    /* ADP_Stopped_ApplicationExit */
    static volatile unsigned int exit_block[2];

    exit_block[0] = 0x20026;                       /* reason */
    exit_block[1] = status;                        /* exit code */

    register unsigned int r0 __asm__("r0") = 0x20; /* SYS_EXIT_EXTENDED */
    register unsigned int r1 __asm__("r1") = (unsigned int)exit_block;

    __asm__ volatile("bkpt 0xAB" : : "r"(r0), "r"(r1) : "memory");

    /* Should never return */
    for (;;)
        ;
}

bool gbRetVal;
bool gbReady;
struct gpio_dt_spec gGpioDtSpec;

int i2c_configure(const struct device *dev, uint32_t dev_config) {
    if (gbRetVal) {
        return 0;
    }
    return 1;
}

bool my_device_is_ready(const struct device *dev) {
    if (gbReady) {
        return true;
    }
    return false;
}
```

## src/stubs.h
```c
#ifndef __STUBS_H__
#define __STUBS_H__

#include <stdio.h>
#include <stdlib.h>

typedef uint8_t gpio_pin_t;
typedef uint16_t gpio_dt_flags_t;
typedef uint16_t spi_operation_t;

struct gpio_dt_spec {
        //const struct device *port;
        gpio_pin_t pin;
        gpio_dt_flags_t dt_flags;
};
 
struct spi_cs_control {
        struct gpio_dt_spec gpio;
        uint32_t delay;
};
struct spi_config {
        uint32_t frequency;
        spi_operation_t operation;
        uint16_t slave;
        struct spi_cs_control* cs;
};

extern struct gpio_dt_spec gGpioDtSpec;

#define I2C_SPEED_SET(x) x
    
#define I2C_SPEED_STANDARD 0
#define I2C_MODE_CONTROLLER 0

#ifdef DEVICE_DT_GET
    #undef DEVICE_DT_GET
#endif
#define DEVICE_DT_GET(x) x
#define I2C_DEV_NODE NULL

#ifdef DT_NODELABEL
    #undef DT_NODELABEL
#endif    
#define DT_NODELABEL(x) 0
#define GPIO_DT_SPEC_GET(x,y) gGpioDtSpec

#define SPI_WORD_SET(x) x


extern bool gbReady;
extern bool gbRetVal;

#define device_is_ready(dev) my_device_is_ready(dev)

int i2c_configure(const struct device *dev, uint32_t dev_config);
bool my_device_is_ready(const struct device *dev);

#endif // __STUBS_H__
```

## src/test_i2c.cpp
```c
#include <zephyr/ztest.h>

#define private public
#include "bus/i2c/i2cbus.h"

#include "stubs.h"

ZTEST_SUITE(tests_bus_i2c, NULL, NULL, NULL, NULL, NULL);

// test constructor and destructor
ZTEST(tests_bus_i2c, test_bus_i2c_constructor)
{
	I2cBus* pI2cBus = new I2cBus();

	zassert_not_null(pI2cBus, "memory alloc failed");

	delete pI2cBus;
}

// MISSING for 100% branch coverage static instantiation does not deliver NULL
// here code line 
// static I2cBus myInstance;
// are not covered completly.


// test init
ZTEST(tests_bus_i2c, test_bus_i2c_init)
{
	I2cBus::inst()->init();
	zassert_true(I2cBus::inst()->init_done, "init_done != true");
}

// test init
ZTEST(tests_bus_i2c, test_bus_i2c_init2)
{
	I2cBus::inst()->init_done = true;
	I2cBus::inst()->init();
	zassert_true(I2cBus::inst()->init_done, "init_done != true");
}

// test init
ZTEST(tests_bus_i2c, test_bus_i2c_init3)
{
	I2cBus::inst()->init_done = false;
	gbRetVal = true;
	gbReady = true;
	I2cBus::inst()->init();
	zassert_true(I2cBus::inst()->init_done, "init_done != true");
}

// test init
ZTEST(tests_bus_i2c, test_bus_i2c_init4)
{
	I2cBus::inst()->init_done = false;
	gbRetVal = true;
	gbReady = false;
	I2cBus::inst()->init();
	zassert_true(I2cBus::inst()->init_done, "init_done != true");
}

// test init
ZTEST(tests_bus_i2c, test_bus_i2c_init5)
{
	I2cBus::inst()->init_done = false;
	gbRetVal = false;
	gbReady = true;
	I2cBus::inst()->init();
	zassert_true(I2cBus::inst()->init_done, "init_done != true");
}

// test init
ZTEST(tests_bus_i2c, test_bus_i2c_init6)
{
	I2cBus::inst()->init_done = false;
	gbRetVal = false;
	gbReady = false;
	I2cBus::inst()->init();
	zassert_true(I2cBus::inst()->init_done, "init_done != true");
}
```

## src/test_spi.cpp
```c
#include <zephyr/ztest.h>

#define private public
#include "bus/spi/spibus.h"

#include "stubs.h"

ZTEST_SUITE(tests_bus_spi, NULL, NULL, NULL, NULL, NULL);

// test constructor and destructor
ZTEST(tests_bus_spi, test_bus_spi_constructor)
{
	spibus* pSpibus = new spibus();

	zassert_not_null(pSpibus, "memory alloc failed");

	delete pSpibus;
}

// MISSING for 100% branch coverage static instantiation does not deliver NULL
// here code line 
// static spibus myInstance;
// are not covered completly.

// test init
ZTEST(tests_bus_spi, test_bus_spi_init)
{
	spibus::inst()->init();
	zassert_true(spibus::inst()->init_done, "init_done != true");
	zassert_equal(spibus::inst()->spi_cfg.frequency, 8000000U, "spi_cfg.frequency != 8000000U");
	zassert_equal(spibus::inst()->spi_cfg.operation, 8, "spi_cfg.operation != 8");
    //printk("%d\n\n", spibus::inst()->spi_cfg.operation);
}

// test init
ZTEST(tests_bus_spi, test_bus_spi_init2)
{
	spibus::inst()->init_done = true;
	spibus::inst()->init();
	zassert_true(spibus::inst()->init_done, "init_done != true");
}

// test init
ZTEST(tests_bus_spi, test_bus_spi_init3)
{
	spibus::inst()->init_done = false;
	gbReady = true;
	spibus::inst()->init();
	zassert_true(spibus::inst()->init_done, "init_done != true");
}

// test init
ZTEST(tests_bus_spi, test_bus_spi_init4)
{
	spibus::inst()->init_done = false;
	gbReady = false;
	spibus::inst()->init();
	zassert_true(spibus::inst()->init_done, "init_done != true");
}
```

## src/test_zz_exit.cpp
```c
#include <zephyr/ztest.h>

extern "C" void qemu_exit(int status);
extern "C" void gcov_coverage_dump(void);

static void final_teardown(void* fixture) {
#if defined(CONFIG_COVERAGE)
    gcov_coverage_dump();
#endif
    qemu_exit(0);
}

ZTEST_SUITE(ztest_exit, NULL, /* predicate */
            NULL,             /* setup */
            NULL,             /* before */
            NULL,             /* after */
            final_teardown    /* teardown */
);
```
