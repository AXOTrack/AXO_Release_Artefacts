## CMakeLists.txt
```
cmake_minimum_required(VERSION 3.20.0)
find_package(Zephyr REQUIRED HINTS $ENV{ZEPHYR_BASE})
project(util)

FILE(GLOB app_sources #src/test_certmgr.cpp
                      src/test_popcount.cpp
                      src/test_hash.cpp
                      src/test_ecdsasign.cpp
                      src/test_keygen.cpp
                      src/stubs.cpp
)
target_sources(app PRIVATE ${app_sources}
	#../../common/src/util/certmgr.cpp
	../../common/src/util/popcount.cpp
    ../../common/src/util/hash.cpp
    ../../common/src/util/ecdsasign.cpp
    ../../common/src/util/keygen.cpp
)

# NOTE: certmgr is only temporary source, will be removed in the furture if migration to Thingsboard
#       has been completed -> Therefore no unit test neccessary

zephyr_include_directories(../../include)
zephyr_include_directories(../../common/src)
zephyr_include_directories(../../app-axo-x1/src)

zephyr_compile_options(-w -Wno-pointer-arith -Wno-unused-variable -Wno-psabi)
```

## prj.conf
```kconfig
CONFIG_ZTEST=y
CONFIG_ZTEST_NEW_API=y

CONFIG_MAIN_STACK_SIZE=8192
#4096

CONFIG_ZTEST_STACK_SIZE=65536
#32768

CONFIG_LOG=y
CONFIG_PRINTK=y
CONFIG_CPLUSPLUS=y
CONFIG_LIB_CPLUSPLUS=y
CONFIG_EXCEPTIONS=n
CONFIG_STD_CPP17=y
CONFIG_NEWLIB_LIBC=y
CONFIG_NEWLIB_LIBC_MIN_REQUIRED_HEAP_SIZE=4096

# disable assert macros
CONFIG_ASSERT=n
CONFIG_ASSERT_TEST=n

# memory usage
CONFIG_MEM_SLAB_TRACE_MAX_UTILIZATION=y 
CONFIG_SYS_HEAP_RUNTIME_STATS=y

CONFIG_HEAP_MEM_POOL_SIZE=16384

CONFIG_CBPRINTF_FP_SUPPORT=y

# CJSON
CONFIG_NEWLIB_LIBC_FLOAT_PRINTF=y
CONFIG_CJSON_LIB=y

CONFIG_NUM_COOP_PRIORITIES=10
CONFIG_NUM_PREEMPT_PRIORITIES=10
CONFIG_SCHED_SCALABLE=y

# Enable thread awareness for debugging tools supporting it
CONFIG_INIT_STACKS=y
CONFIG_THREAD_NAME=y
CONFIG_THREAD_STACK_INFO=y
CONFIG_THREAD_RUNTIME_STATS=y
CONFIG_THREAD_MONITOR=y
CONFIG_DEBUG_THREAD_INFO=y

#CONFIG_UNIT_TEST=y
CONFIG_UNIT_TEST_UTIL=y
CONFIG_COVERAGE=y
CONFIG_COVERAGE_DUMP=y
```

## src/stubs.cpp
```c
#define private public
/*#include "rtos/mbox.h"
#include "rtos/mpelem.h"
#include "rtos/mpool.h"
#include "rtos/mqueue.h"
#include "rtos/task.h"
#include "rtos/task.h"

#include "bus/spi/spibus.h"
#include "drv/spi/fram.h"
#include "drv/spi/adxl37x.h"
#include "conf/config.h"
#include "./version.h"
*/

#include "util/certmgr.h"
#include "util/keygen.h"
#include "stubs.h"


// -------------------------------------------------------------------------

bool gbRetVal;
bool gbReady;
int  gIntRetVal;
char gBuf[1024];

/*/ -------------------------------------------------------------------------
std::allocator<uint8_t> allocBytes;


void Mbox::sendMsg(enum msgType mType, MboxId senderId, MboxId receiverId) {
    PoolElem* e1 = new PoolElem(mType, senderId);
    e1->buf = NULL;
    e1->bufLen = 0;
    Mbox::send(e1, receiverId);
}

void Mbox::sendMsg(enum msgType mType, MboxId senderId, MboxId receiverId,
                   uint8_t u8DataByte) {
    PoolElem* e1 = new PoolElem(mType, senderId);
    e1->p1 = u8DataByte;
    e1->buf = NULL;
    e1->bufLen = 0;
    Mbox::send(e1, receiverId);
}

void Mbox::sendMsg(enum msgType mType, MboxId senderId, MboxId receiverId,
                   int8_t s8DataByte) {
    PoolElem* e1 = new PoolElem(mType, senderId);
    e1->p2 = s8DataByte;
    e1->buf = NULL;
    e1->bufLen = 0;
    Mbox::send(e1, receiverId);
}

void Mbox::sendMsg(enum msgType mType, MboxId senderId, MboxId receiverId,
                        uint8_t* pData, uint16_t dataLen) {
    PoolElem* e1 = new PoolElem(mType, senderId);
        
    uint8_t* b = allocBytes.allocate(2048);
    memcpy(b, pData, dataLen);
    e1->buf = reinterpret_cast<uint8_t (*)[2048]>(b);
    //printk("sendMsg():  e1->buf = 0x%X\n\n", (unsigned int)e1->buf);
    e1->bufLen = dataLen;
    e1->mtype = mType;
    e1->from = senderId;
    Mbox::send(e1, receiverId);
}

void Mbox::sendMsg(enum msgType mType, MboxId senderId, MboxId receiverId,
                   const std::string& str) {
    PoolElem* e1 = new PoolElem(mType, senderId);
    size_t dataLen = str.size() + 1;
    uint8_t* b = allocBytes.allocate(2048);
    auto rc = snprintf(reinterpret_cast<char*>(b), dataLen, "%s", str.c_str());
    int strLen = strlen(reinterpret_cast<const char*>(b));
    dataLen = strLen ? strLen + 1 : 0;
    e1->buf = (uint8_t (*)[2048])(b);
    e1->bufLen = dataLen;
    e1->mtype = mType;
    e1->from = senderId;
    Mbox::send(e1, receiverId);
}

// -------------------------------------------------------------------------

uint8_t* PoolElem::getBuffer(void) { return *buf; }

void PoolElem::putString(const char* s) {
    std::string str = s;
    size_t dataLen = str.size() + 1;
    uint8_t* b = allocBytes.allocate(2048);
    auto rc = snprintf(reinterpret_cast<char*>(b), dataLen, "%s", str.c_str());
    int strLen = strlen(reinterpret_cast<const char*>(b));
    dataLen = strLen ? strLen + 1 : 0;
    this->buf = (uint8_t (*)[2048])(b);
    this->bufLen = dataLen;
}

void PoolElem::putData(const void* pdata, size_t len) {
    uint8_t* b = allocBytes.allocate(2048);
    memcpy(b, pdata, len);
    this->buf = reinterpret_cast<uint8_t (*)[2048]>(b);
    this->bufLen = len;
}

void PoolElem::Dump() { }

void PoolElem::free() {
    uint8_t* b = reinterpret_cast<uint8_t*>(this->buf);
    //printk("free():  this->buf = 0x%X\n\n", (unsigned int)this->buf);
    //printk("free():  0x%.2X%.2X%.2X%.2X\n\n", (*(uint8_t*)this->buf[0]), 
    //                                  (*(uint8_t*)this->buf[1]),
    //                                  (*(uint8_t*)this->buf[2]), 
    //                                  (*(uint8_t*)this->buf[3]));
    if (this->buf != NULL) {
        allocBytes.deallocate(reinterpret_cast<uint8_t*>(this->buf), 2048);
        this->buf = NULL;
        this->bufLen = 0;
    }
    delete this;
}

// -------------------------------------------------------------------------

void* k_timer_user_data_get(k_timer* timer) {
    return reinterpret_cast<void*>(timer);
}

// -------------------------------------------------------------------

spibus::spibus() { }
spibus::~spibus() { }

spibus* spibus::inst() {
    static spibus myInstance;
    return &myInstance;
}

void spibus::init() { }

// -------------------------------------------------------------------------

spifram::spifram() : dpd_active(false) { }
spifram::~spifram() { }

spifram* spifram::inst() {
    static spifram myInstance;
    return &myInstance;
}

void spifram::init() { }

int spifram::wakeup() { return 0; }

int spifram::sleep() { return 0; }

int spifram::writeBytes(uint32_t addr, uint8_t* data, uint32_t num_bytes) { return 0; }

int spifram::readBytes(uint32_t addr, uint8_t* data, uint32_t num_bytes) {
    for (uint32_t i=0; i<num_bytes; i++) {
        data[i] = i;
    }
    return 0;
}

// -------------------------------------------------------------------------

void Adxl37x::convert(struct sensor_value* val, int16_t value) {
    int32_t micro_ms2 = value * (SENSOR_G / (16 * 1000 / 100));
    val->val1 = micro_ms2 / 1000000;
    val->val2 = micro_ms2 % 1000000;
}

// -------------------------------------------------------------------------

Config* Config::inst() {
    static Config myInstance;
    return &myInstance;
}

Config::Config() { }

Config::~Config() { }

stCfgGeneral* Config::getCfgGeneral() { 
    // 	std::string name;    //!< Name of the device class
	// std::string type;    //!< Type of the device
	// std::string version; //!< Version of the configuration 
    static stCfgGeneral ret = {"a","a","a"};
    return &ret;
}

stCfgMetrics* Config::getCfgMetrics() { 
    // std::string interval;
    static stCfgMetrics ret = {"a"};
    return &ret;
}

stCfgDatalog* Config::getCfgDatalog() {
    // std::string dispmodeoff; 
    // std::string rawtransferon; 
    // std::string disptransferon;  
    // std::string rms_thres;   
    // std::string max_raw_per_day;
    static stCfgDatalog ret_true = {"true","true","true","25","5"};
    static stCfgDatalog ret_false = {"false","false","false","25","5"};
    if (gbRetVal) {
        return &ret_true;
    } else {
        return &ret_false;
    }
}

stCfgDisplacement* Config::getCfgDisplacement() { 
    // std::string b1;
    static stCfgDisplacement ret = {"0.0"};
    return &ret;
}

stCfgSensor*  Config::getCfgSensor(enCfgSensorId id) { 
    // std::string name;       //!< Name of the sensor
	// std::string type;       //!< Type of the sensor
	// std::string actthres;   //!< Activation threshold
	// std::string deactthres; //!< Deactivation threshold
    static stCfgSensor ret = {"a","a","a","a"};
    return &ret;
}

// -------------------------------------------------------------------------

const char* getFwVersion() { return "9.77"; }

// -------------------------------------------------------------------------
*/


static struct fs_file_t stFile;

FlashFS::FlashFS(const char* name) { }

FlashFS& FlashFS::inst() {
    static FlashFS myInstance("fs");
    return myInstance;
}

FlashFS::~FlashFS() { }


bool FlashFS::file_exists(const char* path) {
    switch (gIntRetVal) {
        case 1: 
            if (strcmp(path, BROKER_CFG_FILENAME) == 0) {
                return false;
            } 
            break;
        case 2: 
            if (strcmp(path, JOVIA_CERT_FILENAME) == 0) {
                return false;
            } 
            break;
        case 3: 
            if (strcmp(path, THINGSBOARD_CERT_FILENAME) == 0) {
                return false;
            } 
            break;
        case 20: 
            return false;
            break;
        case 21: 
            if (strcmp(path, PRIVATE_KEY_FILENAME) == 0) {
                if (gbRetVal) {
                    return true;
                } else {
                    return false;
                }
            } 
            break;
        case 22: 
            if (strcmp(path, PUBLIC_KEY_FILENAME) == 0) {
                if (gbRetVal) {
                    return true;
                } else {
                    return false;
                }
            } 
            break;
        case 23: 
            if (strcmp(path, KEY_TRANSFERED_FILENAME) == 0) {
                if (gbRetVal) {
                    return true;
                } else {
                    return false;
                }
            } 
            break;
        default:
            return true;
            break;
    }
    return true;
}

int FlashFS::file_sync(fs_file_t* file) {
    return 0;
}

off_t FlashFS::file_seek(fs_file_t* file, off_t offset, int whence) {
    return 0;
}

fs_file_t* FlashFS::file_open(const char* path, int flags) {
    return reinterpret_cast<fs_file_t*>(this);
}

int FlashFS::file_close(fs_file_t* file) {
    return 0;
}

ssize_t FlashFS::file_read(fs_file_t* file, void* buffer, size_t len) {
    strncpy((char*)buffer, gBuf, 1024);
    return len;
}

ssize_t FlashFS::file_write(fs_file_t* file, const void* buffer, size_t len) {
    strncpy(gBuf, (char*)buffer, 1024);
    return len;
}

int FlashFS::remove(const char* filename) {
    return 0; 
}

void FlashFS::eraseFs() {
    memset(gBuf, 0, sizeof(gBuf));
}

int FlashFS::file_tree(const char *path) {
    return 0; 
} 

int FlashFS::statvfs(const char* path, struct fs_statvfs* buf) {
    return 0; 
}

int FlashFS::unmount()  {
    return 0; 
}

volatile int iret;

int FlashFS::stat(const char* path, struct fs_dirent* st) {
    const int JoviaLen = 1657;
    const int TBLen = 1657;

    switch (gIntRetVal) {
        case 10: 
            if (strcmp(path, JOVIA_CERT_FILENAME) == 0) {
                st->size = JoviaLen;
            } else {
                st->size = 0;
            }
            break;
        case 11: 
            if (strcmp(path, JOVIA_CERT_FILENAME) == 0) {
                st->size = 0;
            }  else {
                st->size = 0;
            }
            break;
        case 12: 
            if (strcmp(path, THINGSBOARD_CERT_FILENAME) == 0) {
                st->size = TBLen;
            }  else {
                st->size = 0;
            }
            break;
        case 13: 
            if (strcmp(path, THINGSBOARD_CERT_FILENAME) == 0) {
                st->size = 0;
            }  else {
                st->size = 0;
            }
            break;
        case 14: 
            st->size = TBLen;
            break;
        default:
            st->size = 0;
            break;
    }
    return 0; 
}


// -----------------------------------------------------------------------------

int modem_key_mgmt_exists(nrf_sec_tag_t sec_tag, enum modem_key_mgmt_cred_type cred_type, bool *exists) {
    *exists = false;
    if (gIntRetVal == -1) {
        return -17;
    } else if (gIntRetVal == 1) {
        *exists = true;
        return 0;
    }
    return 0;
}

int modem_key_mgmt_write(nrf_sec_tag_t sec_tag, enum modem_key_mgmt_cred_type cred_type, const void *buf, size_t len) {
    return 0;
}

int modem_key_mgmt_cmp(nrf_sec_tag_t sec_tag, enum modem_key_mgmt_cred_type cred_type, const void *buf, size_t len) {
    const int JoviaLen = 578;
    const int TBLen = 939;

    if (len == JoviaLen) {
        if (gbRetVal) {
            return 0;
        } else {
            return -1;
        }
    }
    else if (len == TBLen) {
        if (gbRetVal) {
            return -1;
        } else {
            return 0;
        }
    }
    return 0xFF;
}

// -----------------------------------------------------------------------------

/*void mbedtls_sha256_init( mbedtls_sha256_context *ctx ) {

}

void mbedtls_sha256_free( mbedtls_sha256_context *ctx ) {

}


int mbedtls_sha256_starts( mbedtls_sha256_context *ctx, int is224 ) {
    return 0;
}


void mbedtls_sha256_update( mbedtls_sha256_context *ctx, const unsigned char *input, size_t ilen ) {

}


void mbedtls_sha256_finish( mbedtls_sha256_context *ctx, unsigned char output[32] ) {

}*/

void mbedtls_ctr_drbg_init( mbedtls_ctr_drbg_context *ctx ){

}
int mbedtls_ctr_drbg_seed( mbedtls_ctr_drbg_context *ctx,
                   int (*f_entropy)(void *, unsigned char *, size_t),
                   void *p_entropy,
                   const unsigned char *custom,
                   size_t len ) {
    return 0;
}

void mbedtls_ctr_drbg_free( mbedtls_ctr_drbg_context *ctx ) {

}

int mbedtls_ctr_drbg_random( void *p_rng,
                     unsigned char *output, size_t output_len ) {
    return 0;
}

  
int mbedtls_ecp_gen_key( mbedtls_ecp_group_id grp_id, mbedtls_ecp_keypair *key,
                 int (*f_rng)(void *, unsigned char *, size_t), void *p_rng ) {
    return 0;
}


void mbedtls_pk_init( mbedtls_pk_context *ctx ){

}
int mbedtls_pk_setup( mbedtls_pk_context *ctx, const mbedtls_pk_info_t *info ) {
    return 0;
}

void mbedtls_pk_free( mbedtls_pk_context *ctx ){

}

int mbedtls_pk_write_pubkey_pem( const mbedtls_pk_context *ctx, unsigned char *buf, size_t size ) {
    return 0;
}

int mbedtls_pk_write_key_pem( const mbedtls_pk_context *ctx, unsigned char *buf, size_t size ) {
    return 0;
}

const mbedtls_pk_info_t *mbedtls_pk_info_from_type( mbedtls_pk_type_t pk_type ) {
    return NULL;
}

int mbedtls_pk_parse_key( mbedtls_pk_context *ctx,
              const unsigned char *key, size_t keylen,
              const unsigned char *pwd, size_t pwdlen,
              int (*f_rng)(void *, unsigned char *, size_t), void *p_rng ) {
    return 0;
}

int mbedtls_pk_sign( mbedtls_pk_context *ctx, mbedtls_md_type_t md_alg,
              const unsigned char *hash, size_t hash_len,
              unsigned char *sig, size_t sig_size, size_t *sig_len,
              int (*f_rng)(void *, unsigned char *, size_t), void *p_rng )  {
    strcpy((char*)sig, "77777");
    *sig_len = 5;
    return 0;
}


int entropy_get_entropy(const struct device *dev,
                                  uint8_t *buffer,
                                  uint16_t length) {
    return 0;
}

// ------------------------------------------------------
   
bool my_device_is_ready(const struct device *dev) {
    if (gbReady) {
        return true;
    }
    return false;
}

// ------------------------------------------------------
   
void mbedtls_sha1_init( mbedtls_sha1_context *ctx ) { 
    ctx->state = 0;
}

void mbedtls_sha1_free( mbedtls_sha1_context *ctx ) {
    ctx->state += 40;
}

int mbedtls_sha1_starts( mbedtls_sha1_context *ctx ) {
    ctx->state = 17;
    return 0;
}

void mbedtls_sha1_update( mbedtls_sha1_context *ctx, const unsigned char *input, size_t ilen ) {
    ctx->state = 27;
}

void mbedtls_sha1_finish( mbedtls_sha1_context *ctx, unsigned char output[20] ) {
    unsigned char buf[20] ={1,1,1,1,1,1,1,1,1,1,2,2,2,2,2,2,2,2,2,2};
    ctx->state = 37;
    memcpy(output, buf, 20);
}


void mbedtls_sha256_init( mbedtls_sha256_context *ctx ) { 
    ctx->state = 0;
}

void mbedtls_sha256_free( mbedtls_sha256_context *ctx ) {
    ctx->state += 40;
}

int mbedtls_sha256_starts( mbedtls_sha256_context *ctx, int is224) {
    ctx->state = 17;
    return 0;
}

void mbedtls_sha256_update( mbedtls_sha256_context *ctx, const unsigned char *input, size_t ilen ) {
    ctx->state = 27;
}

void mbedtls_sha256_finish( mbedtls_sha256_context *ctx, unsigned char output[20] ) {
    unsigned char buf[20] ={1,1,1,1,1,1,1,1,1,1,2,2,2,2,2,2,2,2,2,2};
    ctx->state = 37;
    memcpy(output, buf, 20);
}
```

## src/stubs.h
```c
#ifndef __STUBS_H__
#define __STUBS_H__

#include <stdlib.h>
#include <stdio.h>
#include <string.h>

extern bool gbRetVal;
extern bool gbReady;
extern int gIntRetVal;
extern char gBuf[1024];

//const char* getFwVersion();

struct fs_file_t {
   FILE* pF;
};

#define FS_O_READ       0x01
#define FS_O_WRITE      0x02
#define FS_O_RDWR       (FS_O_READ | FS_O_WRITE)
#define FS_O_MODE_MASK  0x03
 
#define FS_O_CREATE     0x10
#define FS_O_APPEND     0x20
#define FS_O_TRUNC      0x40
#define FS_O_FLAGS_MASK 0x70
 
#define FS_SEEK_SET  0
#define FS_SEEK_CUR  1
#define FS_SEEK_END  2
 
#define MAX_FILE_NAME 128

//int file_remove(const char* path);

enum fs_dir_entry_type {
        FS_DIR_ENTRY_FILE = 0,
        FS_DIR_ENTRY_DIR
};
 struct fs_dirent {
        enum fs_dir_entry_type type;
        char name[MAX_FILE_NAME + 1];
        size_t size;
};
 
struct fs_statvfs {
        unsigned long f_bsize;
        unsigned long f_frsize;
        unsigned long f_blocks;
        unsigned long f_bfree;
};

class FlashFS {
 public:
    explicit FlashFS(const char* name = "??");

    static FlashFS& inst();
    FlashFS() = delete;
    virtual ~FlashFS();
    bool file_exists(const char* path);
    int file_sync(fs_file_t* file);
    off_t file_seek(fs_file_t* file, off_t offset, int whence);    
    fs_file_t* file_open(const char* path, int flags);
    int file_close(fs_file_t* file);
    ssize_t file_read(fs_file_t* file, void* buffer, size_t size);
    ssize_t file_write(fs_file_t* file, const void* buffer, size_t size);
    int remove(const char* path);
    static void eraseFs();
    int file_tree(const char *path);
    int statvfs(const char* path, struct fs_statvfs* buf);
    int unmount();
    int stat(const char* path, struct fs_dirent* st);
};

//void* k_timer_user_data_get(k_timer* timer);

typedef uint32_t nrf_sec_tag_t;

enum modem_key_mgmt_cred_type {
	MODEM_KEY_MGMT_CRED_TYPE_CA_CHAIN,
	MODEM_KEY_MGMT_CRED_TYPE_PUBLIC_CERT,
	MODEM_KEY_MGMT_CRED_TYPE_PRIVATE_CERT,
	MODEM_KEY_MGMT_CRED_TYPE_PSK,
	MODEM_KEY_MGMT_CRED_TYPE_IDENTITY
};

int modem_key_mgmt_exists(nrf_sec_tag_t sec_tag,
			  enum modem_key_mgmt_cred_type cred_type,
			  bool *exists);
int modem_key_mgmt_write(nrf_sec_tag_t sec_tag,
			 enum modem_key_mgmt_cred_type cred_type,
			 const void *buf, size_t len);
int modem_key_mgmt_cmp(nrf_sec_tag_t sec_tag,
		       enum modem_key_mgmt_cred_type cred_type,
		       const void *buf, size_t len);

// ----------------------------------------------------------------------

typedef struct
{
    uint32_t state; //[8];               
    //uint32_t total[2];          
    //unsigned char buffer[64];   
} mbedtls_sha1_context;

typedef struct
{
    uint32_t state; //[8];               
    //uint32_t total[2];          
    //unsigned char buffer[64];   
} mbedtls_sha256_context;

void mbedtls_sha1_init( mbedtls_sha1_context *ctx );
void mbedtls_sha1_free( mbedtls_sha1_context *ctx );
int mbedtls_sha1_starts( mbedtls_sha1_context *ctx );
void mbedtls_sha1_update( mbedtls_sha1_context *ctx, const unsigned char *input, size_t ilen );
void mbedtls_sha1_finish( mbedtls_sha1_context *ctx, unsigned char output[20] );

void mbedtls_sha256_init( mbedtls_sha256_context *ctx );
void mbedtls_sha256_free( mbedtls_sha256_context *ctx );
int mbedtls_sha256_starts( mbedtls_sha256_context *ctx, int is224 );
void mbedtls_sha256_update( mbedtls_sha256_context *ctx, const unsigned char *input, size_t ilen );
void mbedtls_sha256_finish( mbedtls_sha256_context *ctx, unsigned char output[20] );

// ----------------------------------------------------------------------


#ifdef DT_CHOSEN
    #undef DT_CHOSEN
#endif
#define DT_CHOSEN(y) y

#ifdef DEVICE_DT_GET
    #undef DEVICE_DT_GET
#endif
#define DEVICE_DT_GET(x) x

#ifdef DEVICE_NAME_GET
    #undef DEVICE_NAME_GET
#endif
#define DEVICE_NAME_GET(id) "name"

#define zephyr_entropy 0

#define device_is_ready(dev) my_device_is_ready(dev)

bool my_device_is_ready(const struct device *dev);

// ----------------------------------------------------------------------

#define MBEDTLS_ECDSA_MAX_LEN 124

/*typedef struct
{
        uint32_t state[8];            
        uint32_t total[2];            
        unsigned char buffer[64];     
        int is224;                    
} mbedtls_sha256_context;

void mbedtls_sha256_init( mbedtls_sha256_context *ctx );
void mbedtls_sha256_free( mbedtls_sha256_context *ctx );
int mbedtls_sha256_starts( mbedtls_sha256_context *ctx, int is224 );
void mbedtls_sha256_update( mbedtls_sha256_context *ctx, const unsigned char *input, size_t ilen );
void mbedtls_sha256_finish( mbedtls_sha256_context *ctx, unsigned char output[32] );*/

typedef struct
{
    unsigned int                    keybits;   
    uint32_t                        key[8];    
} mbedtls_aes_context;

typedef struct
{
    unsigned char counter[16];  
    int reseed_counter;         
    int prediction_resistance;  
    size_t entropy_len;         
    int reseed_interval;        
    mbedtls_aes_context aes_ctx;        
    int (*f_entropy)(void *, unsigned char *, size_t);
    void *p_entropy;            
} mbedtls_ctr_drbg_context;

typedef enum {
    MBEDTLS_PK_NONE=0,
    MBEDTLS_PK_ECKEY,
    MBEDTLS_PK_ECKEY_DH,
    MBEDTLS_PK_ECDSA,
    MBEDTLS_PK_RSA_ALT,
    MBEDTLS_PK_RSASSA_PSS,
} mbedtls_pk_type_t;

 typedef enum {
    MBEDTLS_MD_NONE=0,
    MBEDTLS_MD_MD2,
     MBEDTLS_MD_MD4,
    MBEDTLS_MD_MD5,
   MBEDTLS_MD_SHA1,
    MBEDTLS_MD_SHA224,
     MBEDTLS_MD_SHA256,
     MBEDTLS_MD_SHA384,
    MBEDTLS_MD_SHA512,
     MBEDTLS_MD_RIPEMD160,
} mbedtls_md_type_t;

 typedef enum
{
    MBEDTLS_ECP_DP_NONE = 0,
    MBEDTLS_ECP_DP_SECP192R1,      
    MBEDTLS_ECP_DP_SECP224R1,      
    MBEDTLS_ECP_DP_SECP256R1,      
    MBEDTLS_ECP_DP_SECP384R1,      
    MBEDTLS_ECP_DP_SECP521R1,      
    MBEDTLS_ECP_DP_BP256R1,        
    MBEDTLS_ECP_DP_BP384R1,        
    MBEDTLS_ECP_DP_BP512R1,        
    MBEDTLS_ECP_DP_CURVE25519,           
     MBEDTLS_ECP_DP_SECP192K1,      
    MBEDTLS_ECP_DP_SECP224K1,      
   MBEDTLS_ECP_DP_SECP256K1,      
} mbedtls_ecp_group_id;

 typedef enum
{
    MBEDTLS_PK_DEBUG_NONE = 0,
    MBEDTLS_PK_DEBUG_MPI,
     MBEDTLS_PK_DEBUG_ECP,
} mbedtls_pk_debug_type;

typedef struct
{
    mbedtls_pk_debug_type type;
     const char *name;
     void *value;
} mbedtls_pk_debug_item;

struct mbedtls_pk_info_t
{
        mbedtls_pk_type_t type;
        const char *name;
        size_t (*get_bitlen)( const void * );
        int (*can_do)( mbedtls_pk_type_t type );
        int (*verify_func)( void *ctx, mbedtls_md_type_t md_alg,
                                const unsigned char *hash, size_t hash_len,
                                const unsigned char *sig, size_t sig_len );
        int (*sign_func)( void *ctx, mbedtls_md_type_t md_alg,
                        const unsigned char *hash, size_t hash_len,
                        unsigned char *sig, size_t *sig_len,
                        int (*f_rng)(void *, unsigned char *, size_t),
                        void *p_rng );
        int (*decrypt_func)( void *ctx, const unsigned char *input, size_t ilen,
                                unsigned char *output, size_t *olen, size_t osize,
                                int (*f_rng)(void *, unsigned char *, size_t),
                                void *p_rng );
        int (*encrypt_func)( void *ctx, const unsigned char *input, size_t ilen,
                                unsigned char *output, size_t *olen, size_t osize,
                                int (*f_rng)(void *, unsigned char *, size_t),
                                void *p_rng );
        int (*check_pair_func)( const void *pub, const void *prv );
        void * (*ctx_alloc_func)( void );
        void (*ctx_free_func)( void *ctx );
        void (*debug_func)( const void *ctx, mbedtls_pk_debug_item *items );
};

typedef uint32_t mbedtls_mpi_uint;

typedef struct
{
    int s;              
    size_t n;           
    mbedtls_mpi_uint *p;          
} mbedtls_mpi;

typedef struct
{
    mbedtls_mpi X;          
    mbedtls_mpi Y;          
    mbedtls_mpi Z;          
} mbedtls_ecp_point;

typedef struct
{
    mbedtls_ecp_group_id id;    
   mbedtls_mpi P;              
    mbedtls_mpi A;              
    mbedtls_mpi B;              
    mbedtls_ecp_point G;        
    mbedtls_mpi N;              
    size_t pbits;       
     size_t nbits;       
     unsigned int h;     
     int (*modp)(mbedtls_mpi *); 
     int (*t_pre)(mbedtls_ecp_point *, void *);  
     int (*t_post)(mbedtls_ecp_point *, void *); 
    void *t_data;                       
     mbedtls_ecp_point *T;       
    size_t T_size;      
} mbedtls_ecp_group;

typedef struct
{
    mbedtls_ecp_group grp;      
    mbedtls_mpi d;              
    mbedtls_ecp_point Q;        
} mbedtls_ecp_keypair;



typedef struct
{
    const mbedtls_pk_info_t *   pk_info; 
    void *                      pk_ctx;  
} mbedtls_pk_context;

void mbedtls_ctr_drbg_init( mbedtls_ctr_drbg_context *ctx );
int mbedtls_ctr_drbg_seed( mbedtls_ctr_drbg_context *ctx,
                   int (*f_entropy)(void *, unsigned char *, size_t),
                   void *p_entropy,
                   const unsigned char *custom,
                   size_t len );
void mbedtls_ctr_drbg_free( mbedtls_ctr_drbg_context *ctx );

int mbedtls_ctr_drbg_random( void *p_rng,
                     unsigned char *output, size_t output_len );
  
int mbedtls_ecp_gen_key( mbedtls_ecp_group_id grp_id, mbedtls_ecp_keypair *key,
                 int (*f_rng)(void *, unsigned char *, size_t), void *p_rng );

   void mbedtls_pk_init( mbedtls_pk_context *ctx );
   int mbedtls_pk_setup( mbedtls_pk_context *ctx, const mbedtls_pk_info_t *info );
   void mbedtls_pk_free( mbedtls_pk_context *ctx );

int mbedtls_pk_write_pubkey_pem( const mbedtls_pk_context *ctx, unsigned char *buf, size_t size );
int mbedtls_pk_write_key_pem( const mbedtls_pk_context *ctx, unsigned char *buf, size_t size );  
const mbedtls_pk_info_t *mbedtls_pk_info_from_type( mbedtls_pk_type_t pk_type ); 
static inline mbedtls_ecp_keypair *mbedtls_pk_ec( const mbedtls_pk_context pk )
{
    return( (mbedtls_ecp_keypair *) (pk).pk_ctx );
}
int mbedtls_pk_parse_key( mbedtls_pk_context *ctx,
              const unsigned char *key, size_t keylen,
              const unsigned char *pwd, size_t pwdlen,
              int (*f_rng)(void *, unsigned char *, size_t), void *p_rng );
int mbedtls_pk_sign( mbedtls_pk_context *ctx, mbedtls_md_type_t md_alg,
              const unsigned char *hash, size_t hash_len,
              unsigned char *sig, size_t sig_size, size_t *sig_len,
              int (*f_rng)(void *, unsigned char *, size_t), void *p_rng );              

int entropy_get_entropy(const struct device *dev,
                                  uint8_t *buffer,
                                  uint16_t length);

#endif // __STUBS_H__
```

## src/test_certmgr.cpp
```c
#include <zephyr/ztest.h>
#include <vector>
#include <algorithm>

#include <cJSON.h>
#include <cJSON_os.h>

#define private public
#include "util/certmgr.h"

#include "stubs.h"

ZTEST_SUITE(tests_util_certmgr, NULL, NULL, NULL, NULL, NULL);

// test constructor and destructor
ZTEST(tests_util_certmgr, test_util_certmgr_constructor)
{
	certmgr* pCertmgr = new certmgr();

	zassert_not_null(pCertmgr, "memory alloc failed");

	delete pCertmgr;
}

// test function init
ZTEST(tests_util_certmgr, test_util_certmgr_init)
{
	gbRetVal = true;
	gIntRetVal = 1;
	strncpy(gBuf, "3,3", 1024);
	certmgr::inst()->init();
	zassert_equal(certmgr::inst()->brokerCfg.currentBroker, 3, "currentBroker != 3");
	zassert_equal(certmgr::inst()->brokerCfg.desiredBroker, 3, "desiredBroker != 3");
}

// test function CheckCertExistInModem
ZTEST(tests_util_certmgr, test_util_certmgr_CheckCertExistInModem)
{
	bool bRet; 
	gIntRetVal = -1;
	bRet = certmgr::inst()->CheckCertExistInModem(MODEM_KEY_MGMT_CRED_TYPE_PUBLIC_CERT);
	zassert_false(bRet, "bRet != false");

	gIntRetVal = 0;
	bRet = certmgr::inst()->CheckCertExistInModem(MODEM_KEY_MGMT_CRED_TYPE_PUBLIC_CERT);
	zassert_false(bRet, "bRet != false");

	gIntRetVal = 1;
	bRet = certmgr::inst()->CheckCertExistInModem(MODEM_KEY_MGMT_CRED_TYPE_PUBLIC_CERT);
	zassert_true(bRet, "bRet != true");
}

// test function CompareRootCertInModem
#if 0
ZTEST(tests_util_certmgr, test_util_certmgr_CompareRootCertInModem)
{
	bool bRet; 
	gbRetVal = true;
	bRet = certmgr::inst()->CompareRootCertInModem(JoviaRootCert, sizeof(JoviaRootCert));
	zassert_true(bRet, "bRet != true");

	gbRetVal = false;
	bRet = certmgr::inst()->CheckCertExistInModem(JoviaRootCert, sizeof(JoviaRootCert));
	zassert_false(bRet, "bRet != false");
}
#endif

// test function GetConfiguredBrokerInModem
ZTEST(tests_util_certmgr, test_util_certmgr_GetConfiguredBrokerInModem)
{
	enBroker eRet; 

	gIntRetVal = 1;
	gbRetVal = true;
	eRet = certmgr::inst()->GetConfiguredBrokerInModem();
	//printk("broker == %d\n", eRet);
	zassert_equal(eRet, eBroker_JOVIA, "eRet != eBroker_JOVIA");

	gbRetVal = false;
	eRet = certmgr::inst()->GetConfiguredBrokerInModem();
	//printk("broker == %d\n", eRet);
	zassert_equal(eRet, eBroker_THINGSBOARD, "eRet != eBroker_THINGSBOARD");

	gbRetVal = true;
	eRet = certmgr::inst()->GetConfiguredBrokerInModem();
	//printk("broker == %d\n", eRet);
	zassert_equal(eRet, eBroker_JOVIA, "eRet != eBroker_JOVIA");

	gbRetVal = false;
	eRet = certmgr::inst()->GetConfiguredBrokerInModem();
	//printk("broker == %d\n", eRet);
	zassert_equal(eRet, eBroker_THINGSBOARD, "eRet != eBroker_THINGSBOARD");

	gIntRetVal = -1;
	gbRetVal = false;
	eRet = certmgr::inst()->GetConfiguredBrokerInModem();
	//printk("broker == %d\n", eRet);
	zassert_equal(eRet, eBroker_NONE, "eRet != eBroker_NONE");

}

// test function WriteJoviaRootCert2Modem
ZTEST(tests_util_certmgr, test_util_certmgr_WriteJoviaRootCert2Modem)
{
	int iRet; 
	gbRetVal = true;

	iRet = certmgr::inst()->WriteJoviaRootCert2Modem();
	zassert_equal(iRet, 0, "iRet != 0");
}

// test function WriteThingsboardRootCert2Modem
ZTEST(tests_util_certmgr, test_util_certmgr_WriteThingsboardRootCert2Modem)
{
	int iRet; 
	gbRetVal = true;

	iRet = certmgr::inst()->WriteThingsboardRootCert2Modem();
	zassert_equal(iRet, 0, "iRet != 0");
}

// test function WriteDeviceCert2Modem
ZTEST(tests_util_certmgr, test_util_certmgr_WriteDeviceCert2Modem)
{
	int iRet; 
	gbRetVal = true;

	iRet = certmgr::inst()->WriteDeviceCert2Modem();
	zassert_equal(iRet, 0, "iRet != 0");
}

// test function WriteDeviceKey2Modem
ZTEST(tests_util_certmgr, test_util_certmgr_WriteDeviceKey2Modem)
{
	int iRet; 
	gbRetVal = true;

	iRet = certmgr::inst()->WriteDeviceKey2Modem();
	zassert_equal(iRet, 0, "iRet != 0");
}


// test function AllPrecondFullFilled
ZTEST(tests_util_certmgr, test_util_certmgr_AllPrecondFullFilled)
{
	bool bRet; 

	gIntRetVal = 1;
	bRet = certmgr::inst()->AllPrecondFullFilled();
	zassert_false(bRet, "bRet != false");

	gIntRetVal = 2;
	bRet = certmgr::inst()->AllPrecondFullFilled();
	zassert_false(bRet, "bRet != false");

	gIntRetVal = 3;
	bRet = certmgr::inst()->AllPrecondFullFilled();
	zassert_false(bRet, "bRet != false");

	gIntRetVal = 10;
	bRet = certmgr::inst()->AllPrecondFullFilled();
	zassert_false(bRet, "bRet != false");

	gIntRetVal = 11;
	bRet = certmgr::inst()->AllPrecondFullFilled();
	zassert_false(bRet, "bRet != false");

	gIntRetVal = 12;
	bRet = certmgr::inst()->AllPrecondFullFilled();
	zassert_false(bRet, "bRet != false");

	gIntRetVal = 13;
	bRet = certmgr::inst()->AllPrecondFullFilled();
	zassert_false(bRet, "bRet != false");

	gIntRetVal = 14;
	bRet = certmgr::inst()->AllPrecondFullFilled();
	zassert_true(bRet, "bRet != true");
}

/*/ test function readBrokerCfg
ZTEST(tests_util_certmgr, test_util_readBrokerCfg)
{
	stBrokerCfg cfg;

	gIntRetVal = 1;
	cfg = certmgr::inst()->readBrokerCfg();
	printk("current = %d, desired = %d\n", cfg.currentBroker, cfg.desiredBroker);
	//zassert_equal(cfg.currentBroker, 0, "currentBroker != 0");
	//zassert_equal(cfg.desiredBroker, 0, "desiredBroker != 0");
}

// test function readBrokerCfg
ZTEST(tests_util_certmgr, test_util_readBrokerCfg2)
{
	stBrokerCfg cfg;

	gIntRetVal = 4;
	strncpy(gBuf, "3,3", 1024);
	cfg = certmgr::inst()->readBrokerCfg();
	printk("current = %d, desired = %d\n", cfg.currentBroker, cfg.desiredBroker);
	//zassert_equal(cfg.currentBroker, 0, "currentBroker != 0");
	//zassert_equal(cfg.desiredBroker, 0, "desiredBroker != 0");
}

// test function readBrokerCfg
ZTEST(tests_util_certmgr, test_util_readBrokerCfg3)
{
	stBrokerCfg cfg;

	gIntRetVal = 4;
	strncpy(gBuf, "3,7", 1024);
	cfg = certmgr::inst()->readBrokerCfg();
	printk("current = %d, desired = %d\n", cfg.currentBroker, cfg.desiredBroker);
	//zassert_equal(cfg.currentBroker, 0, "currentBroker != 0");
	//zassert_equal(cfg.desiredBroker, 0, "desiredBroker != 0");
}

ZTEST(tests_util_certmgr, test_util_readBrokerCfg4)
{
	stBrokerCfg cfg;

	gIntRetVal = 4;
	// test function readBrokerCfg
	strncpy(gBuf, "7,3", 1024);
	cfg = certmgr::inst()->readBrokerCfg();
	printk("current = %d, desired = %d\n", cfg.currentBroker, cfg.desiredBroker);
	//zassert_equal(cfg.currentBroker, 0, "currentBroker != 0");
	//zassert_equal(cfg.desiredBroker, 0, "desiredBroker != 0");
}
*/

// test function writeBrokerCfg
ZTEST(tests_util_certmgr, test_util_writeBrokerCfg)
{
	gIntRetVal = 1;
	certmgr::inst()->writeBrokerCfg(eBroker_JOVIA, eBroker_JOVIA);

	gIntRetVal = 4;
	certmgr::inst()->writeBrokerCfg(eBroker_JOVIA, eBroker_JOVIA);
}

// test function getCurrentBroker
ZTEST(tests_util_certmgr, test_util_getCurrentBroker)
{
	enBroker eRet;

	certmgr::inst()->brokerCfg.currentBroker = eBroker_JOVIA;
	certmgr::inst()->brokerCfg.desiredBroker = eBroker_JOVIA;

	eRet = certmgr::inst()->getCurrentBroker();
	zassert_equal(eRet, eBroker_JOVIA, "eRet != eBroker_JOVIA");

	certmgr::inst()->brokerCfg.currentBroker = eBroker_THINGSBOARD;
	certmgr::inst()->brokerCfg.desiredBroker = eBroker_THINGSBOARD;

	eRet = certmgr::inst()->getCurrentBroker();
	zassert_equal(eRet, eBroker_THINGSBOARD, "eRet != eBroker_THINGSBOARD");

	certmgr::inst()->brokerCfg.currentBroker = eBroker_NONE;
	certmgr::inst()->brokerCfg.desiredBroker = eBroker_NONE;

	eRet = certmgr::inst()->getCurrentBroker();
	zassert_equal(eRet, eBroker_NONE, "eRet != eBroker_NONE");
}

// test function getDesiredBroker
ZTEST(tests_util_certmgr, test_util_getDesiredBroker)
{
	enBroker eRet;

	certmgr::inst()->brokerCfg.currentBroker = eBroker_JOVIA;
	certmgr::inst()->brokerCfg.desiredBroker = eBroker_JOVIA;

	eRet = certmgr::inst()->getDesiredBroker();
	zassert_equal(eRet, eBroker_JOVIA, "eRet != eBroker_JOVIA");

	certmgr::inst()->brokerCfg.currentBroker = eBroker_THINGSBOARD;
	certmgr::inst()->brokerCfg.desiredBroker = eBroker_THINGSBOARD;

	eRet = certmgr::inst()->getDesiredBroker();
	zassert_equal(eRet, eBroker_THINGSBOARD, "eRet != eBroker_THINGSBOARD");

	certmgr::inst()->brokerCfg.currentBroker = eBroker_NONE;
	certmgr::inst()->brokerCfg.desiredBroker = eBroker_NONE;

	eRet = certmgr::inst()->getDesiredBroker();
	zassert_equal(eRet, eBroker_NONE, "eRet != eBroker_NONE");
}

// test function writeDeviceCert
ZTEST(tests_util_certmgr, test_util_writeDeviceCert)
{
	gIntRetVal = 2;
	certmgr::inst()->writeDeviceCert(eBroker_JOVIA, NULL);

	gIntRetVal = 4;
	certmgr::inst()->writeDeviceCert(eBroker_JOVIA, NULL);

	gIntRetVal = 3;
	certmgr::inst()->writeDeviceCert(eBroker_THINGSBOARD, NULL);

	gIntRetVal = 4;
	certmgr::inst()->writeDeviceCert(eBroker_THINGSBOARD, NULL);

	gIntRetVal = 3;
	certmgr::inst()->writeDeviceCert(eBroker_NONE, NULL);
}

// test function appendDeviceCert
ZTEST(tests_util_certmgr, test_util_appendDeviceCert)
{
	gIntRetVal = 2;
	certmgr::inst()->appendDeviceCert(eBroker_JOVIA, NULL);

	gIntRetVal = 4;
	certmgr::inst()->appendDeviceCert(eBroker_JOVIA, NULL);

	gIntRetVal = 3;
	certmgr::inst()->appendDeviceCert(eBroker_THINGSBOARD, NULL);

	gIntRetVal = 4;
	certmgr::inst()->appendDeviceCert(eBroker_THINGSBOARD, NULL);

	gIntRetVal = 3;
	certmgr::inst()->appendDeviceCert(eBroker_NONE, NULL);
}

// test function appendDeviceKey
ZTEST(tests_util_certmgr, test_util_appendDeviceKey)
{
	gIntRetVal = 2;
	certmgr::inst()->appendDeviceKey(eBroker_JOVIA, NULL);
}

// test function printCert
ZTEST(tests_util_certmgr, test_util_printCert)
{
	char s[32] = "1234567890";
	certmgr::inst()->printCert(s);
}

// test function readDeviceCertAndKey
ZTEST(tests_util_certmgr, test_util_readDeviceCertAndKey)
{
	strncpy(gBuf, "sdfsdfsdfssdsdfdf", 1024);
	
	gIntRetVal = 2;
	certmgr::inst()->readDeviceCertAndKey(eBroker_JOVIA);

	gIntRetVal = 4;
	certmgr::inst()->readDeviceCertAndKey(eBroker_JOVIA);

	char s[1024] = "{\"cmd\" : \"CERT_JOVIA1\",\"cert\" : \"-----BEGIN CERTIFICATE-----MIICQTGz8Mt+s=-----END CERTIFICATE----- -----BEGIN PRIVATE KEY-----MIG2Ag-----END PRIVATE KEY-----\"}";
	strncpy(gBuf, s, 1024);

	gIntRetVal = 3;
	certmgr::inst()->readDeviceCertAndKey(eBroker_THINGSBOARD);

	gIntRetVal = 4;
	certmgr::inst()->readDeviceCertAndKey(eBroker_THINGSBOARD);

	gIntRetVal = 3;
	certmgr::inst()->readDeviceCertAndKey(eBroker_NONE);
}

// test function parseCert
ZTEST(tests_util_certmgr, test_util_parseCert)
{
	certmgr::inst()->root_obj = NULL;
	char s[1024] = "{\"cmd\" : \"CERT_JOVIA1\",\"cert\" : \"-----BEGIN CERTIFICATE-----MIICQTGz8Mt+s=-----END CERTIFICATE-----\"}";
	certmgr::inst()->parseCert(s, (char*)"CERT_JOVIA1");
	zassert_not_null(certmgr::inst()->root_obj, "root_obj = NULL");

	certmgr::inst()->root_obj = cJSON_Parse((const char*)s);
	certmgr::inst()->parseCert(s, (char*)"CERT_JOVIA1");
	zassert_not_null(certmgr::inst()->root_obj, "root_obj = NULL");
}

// test function storeJoviaCert1
ZTEST(tests_util_certmgr, test_util_storeJoviaCert1)
{
	char s[1024] = "{\"cmd\" : \"CERT_JOVIA1\",\"cert\" : \"-----BEGIN CERTIFICATE-----MIICQTGz8Mt+s=-----END CERTIFICATE-----\"}";
	certmgr::inst()->storeJoviaCert1(s);
	zassert_not_null(certmgr::inst()->root_obj, "root_obj = NULL");
}

// test function storeJoviaCert2
ZTEST(tests_util_certmgr, test_util_storeJoviaCert2)
{
	char s[1024] = "{\"cmd\" : \"CERT_JOVIA2\",\"cert\" : \"-----BEGIN CERTIFICATE-----MIICQTGz8Mt+s=-----END CERTIFICATE-----\"}";
	certmgr::inst()->storeJoviaCert2(s);
	zassert_not_null(certmgr::inst()->root_obj, "root_obj = NULL");
}

// test function storeJoviaKey
ZTEST(tests_util_certmgr, test_util_storeJoviaKey)
{
	char s[1024] = "{\"cmd\" : \"KEY_JOVIA\",\"cert\" : \"-----BEGIN PRIVATE KEY-----MIICQTGz8Mt+s=-----END PRIVATE KEY-----\"}";
	certmgr::inst()->storeJoviaKey(s);
	zassert_not_null(certmgr::inst()->root_obj, "root_obj = NULL");
}

// test function storeThingsboardCert1
ZTEST(tests_util_certmgr, test_util_storeThingsboardCert1)
{
	char s[1024] = "{\"cmd\" : \"CERT_THINGSBOARD1\",\"cert\" : \"-----BEGIN CERTIFICATE-----MIICQTGz8Mt+s=-----END CERTIFICATE-----\"}";
	certmgr::inst()->storeThingsboardCert1(s);
	zassert_not_null(certmgr::inst()->root_obj, "root_obj = NULL");
}

// test function storeThingsboardCert2
ZTEST(tests_util_certmgr, test_util_storeThingsboardCert2)
{
	char s[1024] = "{\"cmd\" : \"CERT_THINGSBOARD2\",\"cert\" : \"-----BEGIN CERTIFICATE-----MIICQTGz8Mt+s=-----END CERTIFICATE-----\"}";
	certmgr::inst()->storeThingsboardCert2(s);
	zassert_not_null(certmgr::inst()->root_obj, "root_obj = NULL");
}

// test function storeThingsboardKey
ZTEST(tests_util_certmgr, test_util_storeThingsboardKey)
{
	char s[1024] = "{\"cmd\" : \"KEY_THINGSBOARD\",\"cert\" : \"-----BEGIN PRIVATE KEY-----MIICQTGz8Mt+s=-----END PRIVATE KEY-----\"}";
	certmgr::inst()->storeThingsboardKey(s);
	zassert_not_null(certmgr::inst()->root_obj, "root_obj = NULL");
}

// test function GetFsStat ...
ZTEST(tests_util_certmgr, test_util_certmgr_GetFsStat)
{
	certmgr::inst()->GetFsStat();
	certmgr::inst()->EraseFs();
	certmgr::inst()->ListFs();
}
```

## src/test_ecdsasign.cpp
```c
#include <zephyr/ztest.h>


#define private public
#include "util/ecdsasign.h"

#include "stubs.h"

extern int entropy_func(void* ctx, unsigned char* buf, size_t len);

ZTEST_SUITE(tests_util_ecdsasign, NULL, NULL, NULL, NULL, NULL);

// test constructor and destructor
ZTEST(tests_util_ecdsasign, test_util_ecdsasign_constructor)
{
	gbReady = true;
	ECDSASigner* pECDSASigner = new ECDSASigner();
	zassert_not_null(pECDSASigner, "memory alloc failed");
	delete pECDSASigner;
}

// MISSING for 100% branch coverage static instantiation does not deliver NULL
// here code line 
// static ECDSASigner myInstance;
// are not covered completly.

// test constructor and destructor
ZTEST(tests_util_ecdsasign, test_util_ecdsasign_constructor2)
{
	gbReady = false;
	ECDSASigner* pECDSASigner = new ECDSASigner();
	zassert_not_null(pECDSASigner, "memory alloc failed");
	delete pECDSASigner;
}

// test function entropy_func
ZTEST(tests_util_ecdsasign, test_util_ecdsasign_entropy_func)
{
	unsigned char buf[16];
	int iRet = entropy_func(NULL, buf, 16);
	zassert_equal(iRet, 0, "iRet != 0");
}

// test function setPrivateKey
ZTEST(tests_util_ecdsasign, test_util_ecdsasign_setPrivateKey)
{
	ECDSASigner::inst()->setPrivateKey("qwertz");
}

// test function signHash
ZTEST(tests_util_ecdsasign, test_util_ecdsasign_signHash)
{
	std::string s; 
	s = ECDSASigner::inst()->signHash((const unsigned char*)"12345678980", 10);
	//printk("s = %s\n", s.c_str());
	zassert(strcmp(s.c_str(), "77777")==0, "string %s not correct", s.c_str());	
}

// test function string_to_hex
ZTEST(tests_util_ecdsasign, test_util_ecdsasign_string_to_hex)
{
	std::string s; 
	s = ECDSASigner::inst()->string_to_hex("64");
	//printk("s = %s\n", s.c_str());
	zassert(strcmp(s.c_str(), "3634")==0, "string %s not correct", s.c_str());	
}

// test function printSignature
ZTEST(tests_util_ecdsasign, test_util_ecdsasign_printSignature)
{
	ECDSASigner::inst()->printSignature("12345678980");
}
```

## src/test_hash.cpp
```c
#include <zephyr/ztest.h>


#define private public
#include "util/hash.h"

#include "stubs.h"

ZTEST_SUITE(tests_util_hash, NULL, NULL, NULL, NULL, NULL);

// test constructor and destructor
ZTEST(tests_util_hash, test_util_hash_constructor)
{
	Hash* pHash = new Hash();
	zassert_not_null(pHash, "memory alloc failed");
	delete pHash;
}

// MISSING for 100% branch coverage static instantiation does not deliver NULL
// here code line 
// static Hash myInstance;
// are not covered completly.


// test function init
ZTEST(tests_util_hash, test_util_hash_init)
{
	Hash::inst()->init();
	printk("state = %d\n\n", Hash::inst()->sha_ctx.state);
	//zassert_equal(Hash::inst()->sha_ctx.state, 17, "sha_ctx.state != 17");
}

// test function update
ZTEST(tests_util_hash, test_util_hash_update)
{
	Hash::inst()->update(NULL, 23);
	zassert_equal(Hash::inst()->sha_ctx.state, 27, "sha_ctx.state != 27");
}

// test function finalize and print
ZTEST(tests_util_hash, test_util_hash_finalize)
{
	uint8_t* pBuf;
	uint16_t len;
	int i;

	Hash::inst()->finalize();
	//printk("state = %d\n\n", Hash::inst()->sha_ctx.state);
	zassert_equal(Hash::inst()->sha_ctx.state, 77, "sha_ctx.state != 77");
	for (i = 0; i < 10; i++) {
		zassert_equal(Hash::inst()->hash[i], 1, "hash[i] != 1");
		zassert_equal(Hash::inst()->hash[i+10], 2, "hash[i+10] != 2");
	}

	Hash::inst()->print();

	pBuf = Hash::inst()->getHash();
	for (i = 0; i < 10; i++) {
		zassert_equal(pBuf[i], 1, "pBuf[i] != 1");
		zassert_equal(pBuf[i+10], 2, "pBuf[i+10] != 2");
	}

	len = Hash::inst()->getHashLen();
	zassert_equal(len, SHA_HASH_SIZE, "len != SHA_HASH_SIZE");
}
```

## src/test_keygen.cpp
```c
#include <zephyr/ztest.h>


#define private public
#include "util/keygen.h"

#include "stubs.h"

extern int entropy_func2(void* ctx, unsigned char* buf, size_t len);

ZTEST_SUITE(tests_util_keygen, NULL, NULL, NULL, NULL, NULL);

// test constructor and destructor
ZTEST(tests_util_keygen, test_util_keygen_constructor)
{
	KeyGen* pKeyGen = new KeyGen();
	zassert_not_null(pKeyGen, "memory alloc failed");
	zassert_false(pKeyGen->keygen_done, "keygen_done != false");
	zassert_false(pKeyGen->transfer_done, "transfer_done != false");
	delete pKeyGen;
}

// MISSING for 100% branch coverage static instantiation does not deliver NULL
// here code line 
// static KeyGen myInstance;
// are not covered completly.


// test function entropy_func2
ZTEST(tests_util_keygen, test_util_keygen_entropy_func2)
{
	int iRet = entropy_func2(NULL, NULL, 1);
	zassert_equal(iRet, 1, "iRet != 1");
}

// test function init
ZTEST(tests_util_keygen, test_util_keygen_init)
{
	gIntRetVal = 20;
	gbReady  = true;
	KeyGen::inst()->init();
	zassert_false(KeyGen::inst()->keygen_done, "keygen_done != false");
	zassert_false(KeyGen::inst()->transfer_done, "transfer_done != false");

	gIntRetVal = 20;
	gbReady  = false;
	KeyGen::inst()->init();
	zassert_false(KeyGen::inst()->keygen_done, "keygen_done != false");
	zassert_false(KeyGen::inst()->transfer_done, "transfer_done != false");

	gIntRetVal = 23;
	gbRetVal = true;
	KeyGen::inst()->init();
	zassert_true(KeyGen::inst()->keygen_done, "keygen_done != true");
	zassert_true(KeyGen::inst()->transfer_done, "transfer_done != true");

	gIntRetVal = 20;
	gbReady  = false;
	KeyGen::inst()->init();
	zassert_true(KeyGen::inst()->keygen_done, "keygen_done != true");
	zassert_true(KeyGen::inst()->transfer_done, "transfer_done != true");

	gIntRetVal = 21;
	gbRetVal = false;
	KeyGen::inst()->init();
	zassert_true(KeyGen::inst()->keygen_done, "keygen_done != true");
	zassert_true(KeyGen::inst()->transfer_done, "transfer_done != true");

	gIntRetVal = 22;
	gbRetVal = false;
	KeyGen::inst()->init();
	zassert_true(KeyGen::inst()->keygen_done, "keygen_done != true");
	zassert_true(KeyGen::inst()->transfer_done, "transfer_done != true");

	gIntRetVal = 2000;
	gbRetVal = false;
	KeyGen::inst()->init();
	zassert_true(KeyGen::inst()->keygen_done, "keygen_done != true");
	zassert_true(KeyGen::inst()->transfer_done, "transfer_done != true");
}

// test function bIsKeyTransfered
ZTEST(tests_util_keygen, test_util_keygen_bIsKeyTransfered)
{
	bool bRet;

	KeyGen::inst()->transfer_done = true;
	bRet = KeyGen::inst()->bIsKeyTransfered();
	zassert_true(KeyGen::inst()->transfer_done, "transfer_done != true");

	KeyGen::inst()->transfer_done = false;
	bRet = KeyGen::inst()->bIsKeyTransfered();
	zassert_false(KeyGen::inst()->transfer_done, "transfer_done != false");
}

// test function setKeyTransfered
ZTEST(tests_util_keygen, test_util_keygen_setKeyTransfered)
{
	KeyGen::inst()->setKeyTransfered();
	zassert_true(KeyGen::inst()->transfer_done, "transfer_done != true");
	zassert(strcmp(gBuf, "1")==0, "gBuf %s not correct", gBuf);
}

// test function getPublicKey
ZTEST(tests_util_keygen, test_util_keygen_getPublicKey)
{
	uint16_t uRet; 
	char buf[1024];

	strncpy(gBuf, "1234567890", 32);
	gbReady = true;

	uRet = KeyGen::inst()->getPublicKey((unsigned char*)buf, 10);
	zassert_equal(uRet, 10, "uRet != 10");
	zassert(strcmp((const char*)gBuf, (const char*)buf)==0, "buf %s not correct", buf);
}

// test function getPrivateKey, printKey and deleteKeyFiles
ZTEST(tests_util_keygen, test_util_keygen_getPrivateKey)
{
	std::string s;

	strncpy(gBuf, "1234567890", 32);
	gbReady = true;

	s = KeyGen::inst()->getPrivateKey();
	zassert_equal(s.length(), 10, "s.length() != 10");
	zassert(strcmp((const char*)gBuf, (const char*)s.c_str())==0, "string %s not correct", s.c_str());

	KeyGen::inst()->printKey((unsigned char*)s.c_str(), 10);
	KeyGen::inst()->printKey(s);

	gIntRetVal = 20;
	KeyGen::inst()->deleteKeyFiles();
	gIntRetVal = 2000;
	KeyGen::inst()->deleteKeyFiles();
}
```

## src/test_popcount.cpp
```c
#include <zephyr/ztest.h>

#define private public
#include "util/popcount.h"

#include "stubs.h"

ZTEST_SUITE(tests_util_popcount, NULL, NULL, NULL, NULL, NULL);

// test constructor and destructor
ZTEST(tests_util_popcount, test_util_popcount)
{
    int iRet;
    
    iRet = popcount32(0);
    zassert_equal(iRet, 0, "iRet != 0");

    iRet = popcount32(2);
    zassert_equal(iRet, 1, "iRet != 1");

    iRet = popcount32(5);
    zassert_equal(iRet, 2, "iRet != 2");

    iRet = popcount32(0xF);
    zassert_equal(iRet, 4, "iRet != 4");

    iRet = popcount32(0xFF);
    zassert_equal(iRet, 8, "iRet != 8");
}
```
