## CMakeLists.txt
```
cmake_minimum_required(VERSION 3.20.0)
find_package(Zephyr REQUIRED HINTS $ENV{ZEPHYR_BASE})
project(modem)

FILE(GLOB app_sources src/test_lte_monitor.cpp
                      src/stubs.cpp
)
target_sources(app PRIVATE ${app_sources}
	../../common/src/modem/lte_monitor.cpp
    ../../common/src/rtos/mbox.cpp
    ../../common/src/rtos/task.cpp
    ../../common/src/rtos/timer.cpp
)


zephyr_include_directories(../../include)
zephyr_include_directories(../../common/src)
zephyr_include_directories(../../app-axo-x1/src)

zephyr_compile_options(-Wno-pointer-arith -Wno-unused-variable -Wno-psabi)
```

## prj.conf
```kconfig
CONFIG_ZTEST=y
CONFIG_ZTEST_NEW_API=y

CONFIG_MAIN_STACK_SIZE=8192
#4096

CONFIG_ZTEST_STACK_SIZE=65536
#32768

CONFIG_LOG=y
CONFIG_PRINTK=y
CONFIG_CPLUSPLUS=y
CONFIG_LIB_CPLUSPLUS=y
CONFIG_EXCEPTIONS=n
CONFIG_STD_CPP17=y
CONFIG_NEWLIB_LIBC=y
CONFIG_NEWLIB_LIBC_MIN_REQUIRED_HEAP_SIZE=4096

# disable assert macros
CONFIG_ASSERT=n
CONFIG_ASSERT_TEST=n

# memory usage
CONFIG_MEM_SLAB_TRACE_MAX_UTILIZATION=y 
CONFIG_SYS_HEAP_RUNTIME_STATS=y

CONFIG_HEAP_MEM_POOL_SIZE=16384

CONFIG_CBPRINTF_FP_SUPPORT=y

# CJSON
CONFIG_NEWLIB_LIBC_FLOAT_PRINTF=y
CONFIG_CJSON_LIB=y

CONFIG_NUM_COOP_PRIORITIES=10
CONFIG_NUM_PREEMPT_PRIORITIES=10
CONFIG_SCHED_SCALABLE=y

# Enable thread awareness for debugging tools supporting it
CONFIG_INIT_STACKS=y
CONFIG_THREAD_NAME=y
CONFIG_THREAD_STACK_INFO=y
CONFIG_THREAD_RUNTIME_STATS=y
CONFIG_THREAD_MONITOR=y
CONFIG_DEBUG_THREAD_INFO=y

CONFIG_UNIT_TEST=y
CONFIG_UNIT_TEST_MODEM=y
CONFIG_COVERAGE=y
CONFIG_COVERAGE_DUMP=y
```

## src/stubs.cpp
```c
#define private public
#include "rtos/mbox.h"
#include "rtos/mpelem.h"
#include "rtos/mpool.h"
#include "rtos/mqueue.h"
#include "rtos/task.h"
#include "rtos/timer.h"

/*#include "bus/spi/spibus.h"
#include "drv/spi/fram.h"
#include "drv/spi/adxl37x.h"
#include "conf/config.h"
#include "./version.h"*/


#include "stubs.h"


// -------------------------------------------------------------------------

uint8_t gbU8;

int modem_info_init(void) {
    return 0;
}

int	modem_info_get_batt_voltage(int *val) {
    *val = 20;
    return 0;
}

int modem_info_get_temperature(int *val) {
    *val = 25;
    return 0;
}

int modem_info_get_fw_version (char *buf, size_t buf_size) {
    return 0;
}

int modem_info_string_get(enum modem_info info, char *buf, const size_t buf_size) {
    if (gbU8 == 0) {
            return -1;
    }
    if (info == MODEM_INFO_IMSI) {
        //char imsi_buf[15 + 6 + 1]; /* Add 6 for \r\nOK\r\n and 1 for \0 */
        strncpy(buf, "123456789012345\r\nOK\r\n\0", buf_size);
    } else if (info == MODEM_INFO_IMEI) {
        //char imei_buf[15 + 6 + 1]; /* Add 6 for \r\nOK\r\n and 1 for \0 */
        strncpy(buf, "098765432109876\r\nOK\r\n\0", buf_size);
    }
    return 0;
}

int nrf_modem_at_scanf(const char* cmd, const char* fmt, ...) {
    switch (gbU8) {
        case 0:     return -1;    break;
        case 1:     return  1;    break;
        case 2:     return  2;    break;
        case 3:     return  3;    break;
        case 0xFF:  return  0;    break;
    }
    return 0;
}

int nrf_modem_at_printf(const char* fmt, ...) {
    return 0;
}

void at_monitor_resume(struct at_monitor_entry* mon) { 
    //struct at_monitor_entry m1;
    mon->filter = NULL;
    //mon->handler = at_ecsq_handler;
    mon->flags.direct = 1;
    mon->flags.paused = 1;
}

int lte_lc_psm_get(int *tau, int *active_time) {
	if (gbU8 == 3) {
        return -1;
    }
    return 0;
}

int RSRP_IDX_TO_DBM(int inout) {
	if (gbU8 == 0) {
        return 0;
    }
    return 10;
}


// -------------------------------------------------------------------------
std::allocator<uint8_t> allocBytes;


void Mbox::sendMsg(enum msgType mType, MboxId senderId, MboxId receiverId) {
    PoolElem* e1 = new PoolElem(mType, senderId);
    e1->buf = NULL;
    e1->bufLen = 0;
    Mbox::send(e1, receiverId);
}

void Mbox::sendMsg(enum msgType mType, MboxId senderId, MboxId receiverId,
                   uint8_t u8DataByte) {
    PoolElem* e1 = new PoolElem(mType, senderId);
    e1->p1 = u8DataByte;
    e1->buf = NULL;
    e1->bufLen = 0;
    Mbox::send(e1, receiverId);
}

void Mbox::sendMsg(enum msgType mType, MboxId senderId, MboxId receiverId,
                   int8_t s8DataByte) {
    PoolElem* e1 = new PoolElem(mType, senderId);
    e1->p2 = s8DataByte;
    e1->buf = NULL;
    e1->bufLen = 0;
    Mbox::send(e1, receiverId);
}

void Mbox::sendMsg(enum msgType mType, MboxId senderId, MboxId receiverId,
                        uint8_t* pData, uint16_t dataLen) {
    PoolElem* e1 = new PoolElem(mType, senderId);
        
    uint8_t* b = allocBytes.allocate(2048);
    memcpy(b, pData, dataLen);
    e1->buf = reinterpret_cast<uint8_t (*)[2048]>(b);
    //printk("sendMsg():  e1->buf = 0x%X\n\n", (unsigned int)e1->buf);
    e1->bufLen = dataLen;
    e1->mtype = mType;
    e1->from = senderId;
    Mbox::send(e1, receiverId);
}

void Mbox::sendMsg(enum msgType mType, MboxId senderId, MboxId receiverId,
                   const std::string& str) {
    PoolElem* e1 = new PoolElem(mType, senderId);
    size_t dataLen = str.size() + 1;
    uint8_t* b = allocBytes.allocate(2048);
    auto rc = snprintf(reinterpret_cast<char*>(b), dataLen, "%s", str.c_str());
    int strLen = strlen(reinterpret_cast<const char*>(b));
    dataLen = strLen ? strLen + 1 : 0;
    e1->buf = (uint8_t (*)[2048])(b);
    e1->bufLen = dataLen;
    e1->mtype = mType;
    e1->from = senderId;
    Mbox::send(e1, receiverId);
}

// -------------------------------------------------------------------------

uint8_t* PoolElem::getBuffer(void) { return *buf; }

void PoolElem::putString(const char* s) {
    std::string str = s;
    size_t dataLen = str.size() + 1;
    uint8_t* b = allocBytes.allocate(2048);
    auto rc = snprintf(reinterpret_cast<char*>(b), dataLen, "%s", str.c_str());
    int strLen = strlen(reinterpret_cast<const char*>(b));
    dataLen = strLen ? strLen + 1 : 0;
    this->buf = (uint8_t (*)[2048])(b);
    this->bufLen = dataLen;
}

void PoolElem::putData(const void* pdata, size_t len) {
    uint8_t* b = allocBytes.allocate(2048);
    memcpy(b, pdata, len);
    this->buf = reinterpret_cast<uint8_t (*)[2048]>(b);
    this->bufLen = len;
}

void PoolElem::Dump() { }

void PoolElem::free() {
    uint8_t* b = reinterpret_cast<uint8_t*>(this->buf);
    //printk("free():  this->buf = 0x%X\n\n", (unsigned int)this->buf);
    //printk("free():  0x%.2X%.2X%.2X%.2X\n\n", (*(uint8_t*)this->buf[0]), 
    //                                  (*(uint8_t*)this->buf[1]),
    //                                  (*(uint8_t*)this->buf[2]), 
    //                                  (*(uint8_t*)this->buf[3]));
    if (this->buf != NULL) {
        allocBytes.deallocate(reinterpret_cast<uint8_t*>(this->buf), 2048);
        this->buf = NULL;
        this->bufLen = 0;
    }
    delete this;
}

// -------------------------------------------------------------------------

//Timer::Timer(k_timer_expiry_t cb, void* pUser, uint32_t duration,uint32_t period) {}
//void Timer::start() {}

//void* k_timer_user_data_get(k_timer* timer) {
//    return reinterpret_cast<void*>(timer);
//}
void* my_k_timer_user_data_get(k_timer* timer) {
    return reinterpret_cast<void*>(timer);
}

/*/ -------------------------------------------------------------------

spibus::spibus() { }
spibus::~spibus() { }

spibus* spibus::inst() {
    static spibus myInstance;
    return &myInstance;
}

void spibus::init() { }

// -------------------------------------------------------------------------

spifram::spifram() : dpd_active(false) { }
spifram::~spifram() { }

spifram* spifram::inst() {
    static spifram myInstance;
    return &myInstance;
}

void spifram::init() { }

int spifram::wakeup() { return 0; }

int spifram::sleep() { return 0; }

int spifram::writeBytes(uint32_t addr, uint8_t* data, uint32_t num_bytes) { return 0; }

int spifram::readBytes(uint32_t addr, uint8_t* data, uint32_t num_bytes) {
    for (uint32_t i=0; i<num_bytes; i++) {
        data[i] = i;
    }
    return 0;
}

// -------------------------------------------------------------------------

void Adxl37x::convert(struct sensor_value* val, int16_t value) {
    int32_t micro_ms2 = value * (SENSOR_G / (16 * 1000 / 100));
    val->val1 = micro_ms2 / 1000000;
    val->val2 = micro_ms2 % 1000000;
}

// -------------------------------------------------------------------------

Config* Config::inst() {
    static Config myInstance;
    return &myInstance;
}

Config::Config() { }

Config::~Config() { }

stCfgGeneral* Config::getCfgGeneral() { 
    // 	std::string name;    //!< Name of the device class
	// std::string type;    //!< Type of the device
	// std::string version; //!< Version of the configuration 
    static stCfgGeneral ret = {"a","a","a"};
    return &ret;
}

stCfgMetrics* Config::getCfgMetrics() { 
    // std::string interval;
    static stCfgMetrics ret = {"a"};
    return &ret;
}

stCfgDatalog* Config::getCfgDatalog() {
    // std::string dispmodeoff; 
    // std::string rawtransferon; 
    // std::string disptransferon;  
    // std::string rms_thres;   
    // std::string max_raw_per_day;
    static stCfgDatalog ret_true = {"true","true","true","25","5"};
    static stCfgDatalog ret_false = {"false","false","false","25","5"};
    if (gbRetVal) {
        return &ret_true;
    } else {
        return &ret_false;
    }
}

stCfgDisplacement* Config::getCfgDisplacement() { 
    // std::string b1;
    static stCfgDisplacement ret = {"0.0"};
    return &ret;
}

stCfgSensor*  Config::getCfgSensor(enCfgSensorId id) { 
    // std::string name;       //!< Name of the sensor
	// std::string type;       //!< Type of the sensor
	// std::string actthres;   //!< Activation threshold
	// std::string deactthres; //!< Deactivation threshold
    static stCfgSensor ret = {"a","a","a","a"};
    return &ret;
}

// -------------------------------------------------------------------------

const char* getFwVersion() { return "9.77"; }

// -------------------------------------------------------------------------
*/

/*char gBuf[1024];

static struct fs_file_t stFile;

FlashFS::FlashFS(const char* name) { }

FlashFS& FlashFS::inst() {
    static FlashFS myInstance("fs");
    return myInstance;
}

FlashFS::~FlashFS() { }


bool FlashFS::file_exists(const char* path) {
    return gbRetVal;
}

int FlashFS::file_sync(fs_file_t* file) {
    return 0;
}

off_t FlashFS::file_seek(fs_file_t* file, off_t offset, int whence) {
    return 0;
}

fs_file_t* FlashFS::file_open(const char* path, int flags) {
    return reinterpret_cast<fs_file_t*>(this);
}

int FlashFS::file_close(fs_file_t* file) {
    return 0;
}

ssize_t FlashFS::file_read(fs_file_t* file, void* buffer, size_t len) {
    strncpy((char*)buffer, gBuf, 1024);
    return len;
}

ssize_t FlashFS::file_write(fs_file_t* file, const void* buffer, size_t len) {
    strncpy(gBuf, (char*)buffer, 1024);
    return len;
}

int FlashFS::remove(const char* filename) {
    return 0; 
}*/
```

## src/stubs.h
```c
#ifndef __STUBS_H__
#define __STUBS_H__

#include <stdio.h>
#include <stdlib.h>

extern uint8_t gbU8;

#define MODEM_INFO_FWVER_SIZE 41
//#define RSRP_IDX_TO_DBM(rsrp) ((rsrp) < 0 ?  (rsrp) - 140 : (rsrp) - 141)

enum  	modem_info {
  MODEM_INFO_RSRP , MODEM_INFO_CUR_BAND , MODEM_INFO_SUP_BAND , MODEM_INFO_AREA_CODE ,
  MODEM_INFO_UE_MODE , MODEM_INFO_OPERATOR , MODEM_INFO_MCC , MODEM_INFO_MNC ,
  MODEM_INFO_CELLID , MODEM_INFO_IP_ADDRESS , MODEM_INFO_UICC , MODEM_INFO_BATTERY ,
  MODEM_INFO_TEMP , MODEM_INFO_FW_VERSION , MODEM_INFO_ICCID , MODEM_INFO_LTE_MODE ,
  MODEM_INFO_NBIOT_MODE , MODEM_INFO_GPS_MODE , MODEM_INFO_IMSI , MODEM_INFO_IMEI ,
  MODEM_INFO_DATE_TIME , MODEM_INFO_APN , MODEM_INFO_COUNT
};

#define k_timer_user_data_get(x) my_k_timer_user_data_get(x)

void* my_k_timer_user_data_get(k_timer* timer);


typedef void (*at_monitor_handler_t)(const char *notif);

struct at_monitor_entry {
    const char *filter;
    const at_monitor_handler_t handler;
    struct {
        uint8_t paused : 1; /* Monitor is paused. */
        uint8_t direct : 1; /* Dispatch in ISR. */
    } flags;
};


int modem_info_init(void);
int	modem_info_get_batt_voltage(int *val);
int	modem_info_get_temperature(int *val);
int modem_info_get_fw_version (char *buf, size_t buf_size);
int modem_info_string_get(enum modem_info info, char *buf, const size_t buf_size);

int nrf_modem_at_scanf(const char* cmd, const char* fmt, ...);
int nrf_modem_at_printf(const char* fmt, ...);

void at_monitor_resume(struct at_monitor_entry* mon);

int lte_lc_psm_get(int *tau, int *active_time);

int RSRP_IDX_TO_DBM(int inout);




#endif // __STUBS_H__
```

## src/test_lte_monitor.cpp
```c
#include <zephyr/ztest.h>
//#include <vector>
//#include <algorithm>

#define private public
#define protected public
#include "modem/lte_monitor.h"
#include "rtos/timer.h"

#include "stubs.h"

ZTEST_SUITE(tests_lte_monitor, NULL, NULL, NULL, NULL, NULL);

// test constructor and destructor
ZTEST(tests_lte_monitor, test_lte_monitor_constructor)
{
	LteMonitor* pLteMonitor = new LteMonitor("LTE");
	zassert_not_null(pLteMonitor, "memory alloc failed");
	zassert_not_null(pLteMonitor->pInMbox, "pInMbox = NULL");
    zassert_not_null(pLteMonitor->myTimer, "myTimer = NULL");

	delete pLteMonitor;
}

// MISSING for 100% branch coverage operator new does not deliver NULL
// here code lines 
// pInMbox = new Mbox(name); 
// myTimer = new Timer(RmsTask::timer_cb, this, 5, 0);
// static PoolElem e1 = {eTimerExpired, Mbox::MboxId::eLteConnector, 'l', 'm'};
// are not covered completly.


// test function timer_cb and timer1_expired
ZTEST(tests_lte_monitor, test_lte_monitor_timer_cb)
{
    PoolElem* pElem;

    LteMonitor* pLteMonitor = new LteMonitor("LTE");
	zassert_not_null(pLteMonitor, "memory alloc failed");
	zassert_not_null(pLteMonitor->pInMbox, "pInMbox = NULL");
    zassert_not_null(pLteMonitor->myTimer, "myTimer = NULL");
    zassert_equal(pLteMonitor->pInMbox->count(), 0, "pInMbox->count() != 0");
    zassert_equal(pLteMonitor->pInMbox, Mbox::getMboxById(Mbox::eLteMonitor),
                  "Error getting mailbox by id");

    pLteMonitor->timer_cb(reinterpret_cast<k_timer*>(pLteMonitor));

    zassert_equal(pLteMonitor->pInMbox->count(), 1, "pInMbox->count() != 1");
    pElem = pLteMonitor->pInMbox->read();
    zassert_equal(pElem->mtype, msgType::eTimerExpired, "Rcvd mtype != msgType::eTimerExpired");

    delete pLteMonitor;
}  


//Test receive msg eTimerExpired 
ZTEST(tests_lte_monitor, test_lte_monitor_rcv_msg_eTimerExpired)
{
    PoolElem* pElem;

	Mbox* pHttpConnMbox = new Mbox("HttpConnMbox");
    Mbox::registerMbox(pHttpConnMbox, Mbox::eHttpConnector);
	zassert_not_null(pHttpConnMbox, "pHttpConnMbox = NULL");

    LteMonitor* pLteMonitor = new LteMonitor("LTE");
	zassert_not_null(pLteMonitor, "memory alloc failed");
	zassert_not_null(pLteMonitor->pInMbox, "pInMbox = NULL");
    zassert_equal(pLteMonitor->pInMbox, Mbox::getMboxById(Mbox::eLteMonitor),
                  "Error getting mailbox by id");

    Mbox::sendMsg(msgType::eTimerExpired, Mbox::eLteMonitor, Mbox::eLteMonitor);

    zassert_equal(pLteMonitor->pInMbox->count(), 1, "pInMbox->count() != 1");

	gbU8 = 0xFF;
    pLteMonitor->task();  

    zassert_equal(pLteMonitor->pInMbox->count(), 0, "pInMbox->count() != 0");
    zassert_equal(pHttpConnMbox->count(), 1, "pHttpConnMbox->count() != 1");

	zassert(strcmp(pLteMonitor->imsi, "123456789012345")==0, "IMSI %s not correct", pLteMonitor->imsi);
	zassert(strcmp(pLteMonitor->imei, "098765432109876")==0, "IMEI %s not correct", pLteMonitor->imei);

    pElem = pHttpConnMbox->read();
    zassert_equal(pElem->mtype, msgType::eLteIMEI, "Rcvd mtype != msgType::eLteIMEI");
    zassert_equal(pElem->from, Mbox::eLteMonitor, "Rcvd sender != Mbox::eAdxlRms");

    pElem->free();
    delete pHttpConnMbox;
	delete pLteMonitor; 
}

//Test receive msg eLteLinkQuality 
ZTEST(tests_lte_monitor, test_lte_monitor_rcv_msg_eLteLinkQuality)
{
    LteMonitor* pLteMonitor = new LteMonitor("LTE");
	zassert_not_null(pLteMonitor, "memory alloc failed");
	zassert_not_null(pLteMonitor->pInMbox, "pInMbox = NULL");
    zassert_equal(pLteMonitor->pInMbox, Mbox::getMboxById(Mbox::eLteMonitor),
                  "Error getting mailbox by id");

    Mbox::sendMsg(msgType::eLteLinkQuality, Mbox::eLteMonitor, Mbox::eLteMonitor, (int8_t)-7);

    zassert_equal(pLteMonitor->pInMbox->count(), 1, "pInMbox->count() != 1");

    pLteMonitor->task();  

    zassert_equal(pLteMonitor->pInMbox->count(), 0, "pInMbox->count() != 0");
    zassert_equal(pLteMonitor->linkQuality, -7, "linkQuality != -7");

	delete pLteMonitor; 
}

//Test receive msg eLteReport 
ZTEST(tests_lte_monitor, test_lte_monitor_rcv_msg_eLteReport)
{
    PoolElem* pElem;

	Mbox* pDataMgrMbox = new Mbox("DataMgrMbox");
    Mbox::registerMbox(pDataMgrMbox, Mbox::eDataManager);
	zassert_not_null(pDataMgrMbox, "pDataMgrMbox = NULL");

    LteMonitor* pLteMonitor = new LteMonitor("LTE");
	zassert_not_null(pLteMonitor, "memory alloc failed");
	zassert_not_null(pLteMonitor->pInMbox, "pInMbox = NULL");
    zassert_equal(pLteMonitor->pInMbox, Mbox::getMboxById(Mbox::eLteMonitor),
                  "Error getting mailbox by id");

    Mbox::sendMsg(msgType::eLteReport, Mbox::eDataManager, Mbox::eLteMonitor);

    zassert_equal(pLteMonitor->pInMbox->count(), 1, "pInMbox->count() != 1");

    pLteMonitor->task();  

    zassert_equal(pLteMonitor->pInMbox->count(), 0, "pInMbox->count() != 0");
    zassert_equal(pDataMgrMbox->count(), 5, "pHttpConnMbox->count() != 5");
	//printk("pDataMgrMbox->count() = %d\n, pDataMgrMbox->count());

	zassert(strcmp(pLteMonitor->imsi, "123456789012345")==0, "IMSI %s not correct", pLteMonitor->imsi);
	zassert_equal(pLteMonitor->battVoltage, 20, "battVoltage != 20");
	zassert_equal(pLteMonitor->temperature, 25, "temperature != 25");

    pElem = pDataMgrMbox->read();
   	//printk("pElem->mtype = %d\n", pElem->mtype);
	zassert_equal(pElem->mtype, msgType::eLteLinkQuality, "Rcvd mtype != msgType::eLteLinkQuality");
    zassert_equal(pElem->from, Mbox::eLteMonitor, "Rcvd sender != Mbox::eLteMonitor");
    pElem->free();

    pElem = pDataMgrMbox->read();
   	//printk("pElem->mtype = %d\n", pElem->mtype);
	zassert_equal(pElem->mtype, msgType::eLteIMSI, "Rcvd mtype != msgType::eLteIMSI");
    zassert_equal(pElem->from, Mbox::eLteMonitor, "Rcvd sender != Mbox::eLteMonitor");
    pElem->free();

    pElem = pDataMgrMbox->read();
   	//printk("pElem->mtype = %d\n", pElem->mtype);
	zassert_equal(pElem->mtype, msgType::eLtePsmAct, "Rcvd mtype != msgType::eLtePsmAct");
    zassert_equal(pElem->from, Mbox::eLteMonitor, "Rcvd sender != Mbox::eLteMonitor");
    pElem->free();

    pElem = pDataMgrMbox->read();
   	//printk("pElem->mtype = %d\n", pElem->mtype);
	zassert_equal(pElem->mtype, msgType::eLteBattVoltage, "Rcvd mtype != msgType::eLteBattVoltage");
    zassert_equal(pElem->from, Mbox::eLteMonitor, "Rcvd sender != Mbox::eLteMonitor");
    pElem->free();

    pElem = pDataMgrMbox->read();
   	//printk("pElem->mtype = %d\n", pElem->mtype);
	zassert_equal(pElem->mtype, msgType::eLteTemperature, "Rcvd mtype != msgType::eLteTemperature");
    zassert_equal(pElem->from, Mbox::eLteMonitor, "Rcvd sender != Mbox::eLteMonitor");
    pElem->free();

    delete pDataMgrMbox;
	delete pLteMonitor; 
}

//Test receive unexpected msg 
ZTEST(tests_lte_monitor, test_lte_monitor_rcv_msg_unexpected)
{
    LteMonitor* pLteMonitor = new LteMonitor("LTE");
	zassert_not_null(pLteMonitor, "memory alloc failed");
	zassert_not_null(pLteMonitor->pInMbox, "pInMbox = NULL");
    zassert_equal(pLteMonitor->pInMbox->count(), 0, "pInMbox->count() != 0");
    zassert_equal(pLteMonitor->pInMbox, Mbox::getMboxById(Mbox::eLteMonitor),
                  "Error getting mailbox by id");

    Mbox::sendMsg(msgType::eResetCause, Mbox::eLteMonitor, Mbox::eLteMonitor);

    zassert_equal(pLteMonitor->pInMbox->count(), 1, "pInMbox->count() != 1");

    pLteMonitor->task();  

    zassert_equal(pLteMonitor->pInMbox->count(), 0, "pInMbox->count() != 0");
	delete pLteMonitor; 
}

//Test receive no msg 
ZTEST(tests_lte_monitor, test_lte_monitor_rcv_msg_none)
{
    LteMonitor* pLteMonitor = new LteMonitor("LTE");
	zassert_not_null(pLteMonitor, "memory alloc failed");
	zassert_not_null(pLteMonitor->pInMbox, "pInMbox = NULL");
    zassert_equal(pLteMonitor->pInMbox->count(), 0, "pInMbox->count() != 0");
    zassert_equal(pLteMonitor->pInMbox, Mbox::getMboxById(Mbox::eLteMonitor),
                  "Error getting mailbox by id");

    pLteMonitor->pInMbox->write(NULL);
    
    pLteMonitor->task();  

    zassert_equal(pLteMonitor->pInMbox->count(), 0, "pInMbox->count() != 0");
	delete pLteMonitor; 
}

//Test function resume_all_notifications, ...
ZTEST(tests_lte_monitor, test_lte_monitor_resume_all_notifications)
{
	char buf[32];
	const char* pBuf = &buf[0];
	int rc;

    LteMonitor* pLteMonitor = new LteMonitor("LTE");
	zassert_not_null(pLteMonitor, "memory alloc failed");
	zassert_not_null(pLteMonitor->pInMbox, "pInMbox = NULL");

	pLteMonitor->resume_all_notifications();
	zassert_equal(pLteMonitor->catch_all.filter, NULL, "catch_all.filter != NULL");
	zassert_equal(pLteMonitor->catch_all.flags.direct, 1, "catch_all.flags.direct != 1");
	zassert_equal(pLteMonitor->catch_all.flags.paused, 1, "catch_all.flags.paused != 1");

	pLteMonitor->at_notif_handler(NULL);

	pLteMonitor->register_link_quality_notifications();

	pLteMonitor->resume_link_quality_notifications();
	zassert_equal(pLteMonitor->link_quality.filter, NULL, "link_quality.filter != NULL");
	zassert_equal(pLteMonitor->link_quality.flags.direct, 1, "link_quality.flags.direct != 1");
	zassert_equal(pLteMonitor->link_quality.flags.paused, 1, "link_quality.flags.paused != 1");

	pLteMonitor->register_network_notifications();

	pLteMonitor->resume_network_notifications();
	zassert_equal(pLteMonitor->network.filter, NULL, "network.filter != NULL");
	zassert_equal(pLteMonitor->network.flags.direct, 1, "network.flags.direct != 1");
	zassert_equal(pLteMonitor->network.flags.paused, 1, "network.flags.paused != 1");

	pBuf = pLteMonitor->cereg_str_get(NO_NETWORK);
	zassert(strcmp(pBuf, "no network")==0, "ret0 %s not correct", pBuf);
	pBuf = pLteMonitor->cereg_str_get(HOME);
	zassert(strcmp(pBuf, "home")==0, "ret1 %s not correct", pBuf);
	pBuf = pLteMonitor->cereg_str_get(SEARCHING);
	zassert(strcmp(pBuf, "searching")==0, "ret2 %s not correct", pBuf);
	pBuf = pLteMonitor->cereg_str_get(DENIED);
	zassert(strcmp(pBuf, "denied")==0, "ret3 %s not correct", pBuf);
	pBuf = pLteMonitor->cereg_str_get(UNKNOWN);
	zassert(strcmp(pBuf, "unknown")==0, "ret4 %s not correct", pBuf);
	pBuf = pLteMonitor->cereg_str_get(ROAMING);
	zassert(strcmp(pBuf, "roaming")==0, "ret5 %s not correct", pBuf);
	pBuf = pLteMonitor->cereg_str_get(EMERGENCY);
	zassert(strcmp(pBuf, "emergency")==0, "ret6 %s not correct", pBuf);
	pBuf = pLteMonitor->cereg_str_get(UICC_FAILURE);
	zassert(strcmp(pBuf, "UICC failure")==0, "ret7 %s not correct", pBuf);
	pBuf = pLteMonitor->cereg_str_get((enum cereg_status)99);
	zassert(strcmp(pBuf, "unexpected")==0, "ret8 %s not correct", pBuf);

	pLteMonitor->at_cereg_handler("1");

    gbU8 = 0;
	pLteMonitor->psm_read();
    gbU8 = 1;
	pLteMonitor->psm_read();
    gbU8 = 2;
	pLteMonitor->psm_read();
    gbU8 = 3;
	pLteMonitor->psm_read();
    gbU8 = 0xFF;
	pLteMonitor->psm_read();

	gbU8 = 0;
	rc = pLteMonitor->getIMEI();
	zassert_equal(rc, -5, "rc != -5");

	rc = pLteMonitor->getIMSI();
	zassert_equal(rc, -5, "rc != -5");

	delete pLteMonitor; 
}

//Test function at_ecsq_handler
ZTEST(tests_lte_monitor, test_lte_monitor_at_ecsq_handler)
{
    LteMonitor* pLteMonitor = new LteMonitor("LTE");
	zassert_not_null(pLteMonitor, "memory alloc failed");
	zassert_not_null(pLteMonitor->pInMbox, "pInMbox = NULL");
    zassert_equal(pLteMonitor->pInMbox->count(), 0, "pInMbox->count() != 0");
    zassert_equal(pLteMonitor->pInMbox, Mbox::getMboxById(Mbox::eLteMonitor),
                  "Error getting mailbox by id");

	gbU8 = 0;
	pLteMonitor->at_ecsq_handler("22");
    zassert_equal(pLteMonitor->pInMbox->count(), 1, "pInMbox->count() != 1");

	pLteMonitor->task(); 
    zassert_equal(pLteMonitor->pInMbox->count(), 0, "pInMbox->count() != 0");

	gbU8 = 10;
	pLteMonitor->at_ecsq_handler("22");
    zassert_equal(pLteMonitor->pInMbox->count(), 1, "pInMbox->count() != 1");

	pLteMonitor->task(); 
    zassert_equal(pLteMonitor->pInMbox->count(), 0, "pInMbox->count() != 0");
	delete pLteMonitor; 
}

//Test function reportFwVersion
ZTEST(tests_lte_monitor, test_lte_monitor_reportFwVersion)
{
    PoolElem* pElem;

	Mbox* pDataMgrMbox = new Mbox("DataMgrMbox");
    Mbox::registerMbox(pDataMgrMbox, Mbox::eDataManager);
	zassert_not_null(pDataMgrMbox, "pDataMgrMbox = NULL");

    LteMonitor* pLteMonitor = new LteMonitor("LTE");
	zassert_not_null(pLteMonitor, "memory alloc failed");
	zassert_not_null(pLteMonitor->pInMbox, "pInMbox = NULL");
    zassert_equal(pLteMonitor->pInMbox->count(), 0, "pInMbox->count() != 0");
    zassert_equal(pLteMonitor->pInMbox, Mbox::getMboxById(Mbox::eLteMonitor),
                  "Error getting mailbox by id");

	pLteMonitor->reportFwVersion(Mbox::eDataManager);
    pElem = pDataMgrMbox->read();
   	//printk("pElem->mtype = %d\n", pElem->mtype);
	zassert_equal(pElem->mtype, msgType::eLteFwVersion, "Rcvd mtype != msgType::eLteFwVersion");
    zassert_equal(pElem->from, Mbox::eLteMonitor, "Rcvd sender != Mbox::eLteMonitor");
    pElem->free();

    delete pDataMgrMbox;
	delete pLteMonitor; 
}
```
