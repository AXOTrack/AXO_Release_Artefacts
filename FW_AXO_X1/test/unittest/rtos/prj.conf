## CMakeLists.txt
```
# SPDX-License-Identifier: Apache-2.0

cmake_minimum_required(VERSION 3.20.0)
find_package(Zephyr REQUIRED HINTS $ENV{ZEPHYR_BASE})
project(integration)

# NOTE: sema and mutex makes problems !!  To be investigated

#FILE(GLOB app_sources src/*.cpp)
FILE(GLOB app_sources   src/test_mempool.cpp
                        src/test_mbox.cpp
                        src/test_mutex.cpp
                        src/test_mpool.cpp
                        src/test_mpelem.cpp
                        src/test_task.cpp
                        src/test_timer.cpp
                        src/test_sema.cpp
                        src/test_mqueue.cpp
                        src/stubs.cpp)
target_sources(app PRIVATE ${app_sources}
    ../../common/src/rtos/mpelem.cpp
    ../../common/src/rtos/mempool.h
    ../../common/src/rtos/mqueue.h
    ../../common/src/rtos/mpool.cpp
    ../../common/src/rtos/mbox.cpp
    ../../common/src/rtos/sema.cpp
    ../../common/src/rtos/mutex.cpp
    ../../common/src/rtos/task.cpp
    ../../common/src/rtos/timer.cpp
)

zephyr_include_directories(../../include)
zephyr_include_directories(../../common/src)

zephyr_compile_options(-Wno-pointer-arith -Wno-unused-variable -Wno-psabi)
```

## prj.conf
```kconfig
CONFIG_ZTEST=y
CONFIG_ZTEST_NEW_API=y

#CONFIG_QEMU_ICOUNT=y
CONFIG_MAIN_STACK_SIZE=8192
#4096

CONFIG_ZTEST_STACK_SIZE=65536
#32768

CONFIG_LOG=y
CONFIG_PRINTK=y
CONFIG_CPLUSPLUS=y
CONFIG_LIB_CPLUSPLUS=y
CONFIG_EXCEPTIONS=n
CONFIG_STD_CPP17=y
CONFIG_NEWLIB_LIBC=y
CONFIG_NEWLIB_LIBC_MIN_REQUIRED_HEAP_SIZE=4096

# disable assert macros
CONFIG_ASSERT=n
CONFIG_ASSERT_TEST=n

# memory usage
CONFIG_MEM_SLAB_TRACE_MAX_UTILIZATION=y 
CONFIG_SYS_HEAP_RUNTIME_STATS=y

CONFIG_HEAP_MEM_POOL_SIZE=16384

CONFIG_CBPRINTF_FP_SUPPORT=y

# CJSON
CONFIG_NEWLIB_LIBC_FLOAT_PRINTF=y
CONFIG_CJSON_LIB=y

CONFIG_NUM_COOP_PRIORITIES=10
CONFIG_NUM_PREEMPT_PRIORITIES=10
CONFIG_SCHED_SCALABLE=y

# Enable thread awareness for debugging tools supporting it
CONFIG_INIT_STACKS=y
CONFIG_THREAD_NAME=y
CONFIG_THREAD_STACK_INFO=y
CONFIG_THREAD_RUNTIME_STATS=y
CONFIG_THREAD_MONITOR=y
CONFIG_DEBUG_THREAD_INFO=y


#CONFIG_UNIT_TEST=y
CONFIG_UNIT_TEST_RTOS=y
CONFIG_COVERAGE=y
CONFIG_COVERAGE_DUMP=y
```

## src/stubs.cpp
```c
#define private public
#include "rtos/mbox.h"
#include "rtos/mpelem.h"
#include "rtos/mpool.h"
#include "rtos/mqueue.h"
#include "rtos/task.h"


// -------------------------------------------------------------------------

bool gbRetVal;

// -------------------------------------------------------------------------
/*std::allocator<uint8_t> allocBytes;


void Mbox::sendMsg(enum msgType mType, MboxId senderId, MboxId receiverId) {
    PoolElem* e1 = new PoolElem(mType, senderId);
    e1->buf = NULL;
    e1->bufLen = 0;
    Mbox::send(e1, receiverId);
}

void Mbox::sendMsg(enum msgType mType, MboxId senderId, MboxId receiverId,
                   uint8_t u8DataByte) {
    PoolElem* e1 = new PoolElem(mType, senderId);
    e1->p1 = u8DataByte;
    e1->buf = NULL;
    e1->bufLen = 0;
    Mbox::send(e1, receiverId);
}

void Mbox::sendMsg(enum msgType mType, MboxId senderId, MboxId receiverId,
                   int8_t s8DataByte) {
    PoolElem* e1 = new PoolElem(mType, senderId);
    e1->p2 = s8DataByte;
    e1->buf = NULL;
    e1->bufLen = 0;
    Mbox::send(e1, receiverId);
}

void Mbox::sendMsg(enum msgType mType, MboxId senderId, MboxId receiverId,
                        uint8_t* pData, uint16_t dataLen) {
    PoolElem* e1 = new PoolElem(mType, senderId);
        
    uint8_t* b = allocBytes.allocate(2048);
    memcpy(b, pData, dataLen);
    e1->buf = reinterpret_cast<uint8_t (*)[2048]>(b);
    //printk("sendMsg():  e1->buf = 0x%X\n\n", (unsigned int)e1->buf);
    e1->bufLen = dataLen;
    e1->mtype = mType;
    e1->from = senderId;
    Mbox::send(e1, receiverId);
}

void Mbox::sendMsg(enum msgType mType, MboxId senderId, MboxId receiverId,
                   const std::string& str) {
    PoolElem* e1 = new PoolElem(mType, senderId);
    size_t dataLen = str.size() + 1;
    uint8_t* b = allocBytes.allocate(2048);
    auto rc = snprintf(reinterpret_cast<char*>(b), dataLen, "%s", str.c_str());
    int strLen = strlen(reinterpret_cast<const char*>(b));
    dataLen = strLen ? strLen + 1 : 0;
    e1->buf = (uint8_t (*)[2048])(b);
    e1->bufLen = dataLen;
    e1->mtype = mType;
    e1->from = senderId;
    Mbox::send(e1, receiverId);
}

void PoolElem::free() {
    uint8_t* b = reinterpret_cast<uint8_t*>(this->buf);
    if (this->buf != NULL) {
        allocBytes.deallocate(reinterpret_cast<uint8_t*>(this->buf), 2048);
        this->buf = NULL;
        this->bufLen = 0;
    }
    delete this;
}

static struct k_mem_slab slab;

int k_mem_slab_init (struct k_mem_slab* slab ,void* buffer, size_t block_size, uint32_t num_blocks) {
    slab->num_blocks = num_blocks;
    slab->num_used   = 0;
    slab->max_used   = 0;
    slab->block_size = block_size;
    return 0;
}*/

/*int k_mem_slab_alloc(struct k_mem_slab*	slab, void** mem, k_timeout_t timeout) {
    if (slab->num_used < slab->num_blocks) {
        slab->num_used++;
    }
    if (slab->max_used < slab->num_used) {
        slab->max_used++;
    }
    return 0;
}

void k_mem_slab_free(struct k_mem_slab* slab, void* mem) {
    if (slab->num_used > 0) {
        slab->num_used--;
    }
}

void* k_timer_user_data_get(k_timer* timer) {
    return reinterpret_cast<void*>(timer);
}*/
```

## src/stubs.h
```c
#ifndef __STUBS_H__
#define __STUBS_H__

#include <cstdint>

//#include "rtos/mbox.h"
//#include "rtos/mpelem.h"
//#include "rtos/mpool.h"


/*#define FRAM_5_SEC_RAW_DATA_SPACE     5
#define FRAM_15_SEC_RAW_DATA_SPACE   15

typedef enum _enCfgSensorId {
	eSensor_adxl372, //!< Acceleration sensor ADXL372
	eSensor_MAX      //!< Number of sensors mentioned in dynamic configuration
} enCfgSensorId;

typedef struct _stCfgGeneral {
	std::string name;    //!< Name of the device class
	std::string type;    //!< Type of the device
	std::string version; //!< Version of the configuration
} stCfgGeneral;

typedef struct _stCfgSensor {
	std::string name;       //!< Name of the sensor
	std::string type;       //!< Type of the sensor
	std::string actthres;   //!< Activation threshold
	std::string deactthres; //!< Deactivation threshold
} stCfgSensor;

typedef struct _stCfgMetrics {
	std::string interval;  //!< Metrics transmission interval
} stCfgMetrics;

typedef struct _stCfgDisplacement {
	std::string b1;  //!< Beautification factor 1
} stCfgDisplacement;

typedef struct _stCfgDatalog {	
   std::string dispmodeoff; 
   std::string rawtransferon; 
   std::string disptransferon;  
   std::string rms_thres;   
   std::string max_raw_per_day; 
} stCfgDatalog;



class Config {
 public:
    static Config* inst();
    void init();
    virtual ~Config();

    stCfgGeneral* getCfgGeneral();
    stCfgMetrics* getCfgMetrics();
    stCfgDatalog* getCfgDatalog();
    //stCfgDisplacement* getCfgDisplacement();
    stCfgSensor*  getCfgSensor(enCfgSensorId id);

    //unsigned char* getConfigJson();
 private:
    Config();

};


const char* getFwVersion();

class FlashFS {
 public:
    explicit FlashFS(const char* name = "??");

    static FlashFS& inst();
    FlashFS() = delete;
    virtual ~FlashFS();
    bool file_exists(const char* path);
};

class MetricsBuilder {
 public:
    MetricsBuilder();
    ~MetricsBuilder();

    std::string payload;
    std::string tmp;
    std::string pubkey; 

    void add(PoolElem* pElem);
    void setConfigVersion(std::string& s);
    void setActivationThres(std::string& s);
    void setDeactivationThres(std::string& s);
    void setDispModeOffFlag(std::string& s);
    void setRawTransferOnFlag(std::string& s);
    void setDispTransferOnFlag(std::string& s);
    void setPublicKey(std::string& s);
    void setMetricsInterval(std::string& s);
    void set_Z_RmsThres(std::string& s);

    int scaleBattIn(int32_t ad_in);  // consider voltage divider at A/D in

    void finalize(void);
    void reset();

    bool isComplete();
    void print(void);
    std::string& getPayload(void);   
};

class MeasurementBuilder {
 public:
    explicit MeasurementBuilder(bool have_http_connector = true);
    ~MeasurementBuilder();

    bool have_http_connector; 

    std::string payload;

    void add(PoolElem* pElem);

    void finalize(void);
    void reset();

    bool isComplete(bool disp_mode_off, double rmsZThres);
    std::string& getPayload(void);
};

class KeyGen {
 public:
    ~KeyGen();

    static KeyGen* inst();

    uint16_t getPublicKey(unsigned char* pBuf, size_t len);
    std::string getPrivateKey();
    
 private:
    KeyGen();
};
*/

/*struct k_mem_slab {
   uint32_t num_blocks;
   uint32_t num_used;
   uint32_t max_used;
   uint32_t block_size;
};*/


//void* k_timer_user_data_get(k_timer* timer);

#endif // __STUBS_H__
```

## src/test_mbox.cpp
```c
#include <stddef.h>
#include <stdint.h>
#include <stdio.h>
#include <stdlib.h>
//#include <syscalls/rand32.h>
#include <zephyr/kernel.h>
#include <zephyr/ztest.h>

#include "rtos/mbox.h"
#include "rtos/mpelem.h"
#include "rtos/mpool.h"
#include "rtos/mqueue.h"

ZTEST_SUITE(mbox_tests, NULL, NULL, NULL, NULL, NULL);

ZTEST(mbox_tests, test_mbox_constructor) {
    Mbox* pInMbox;
    pInMbox = new Mbox("test");
    zassert_equal(pInMbox->count(), 0, "Error creating mailbox");
    delete pInMbox;
}

ZTEST(mbox_tests, test_mbox_registerMBox) {
    Mbox* pInMbox;
    pInMbox = new Mbox("test");
    zassert_equal(pInMbox->count(), 0, "Error creating mailbox");

    // Generate random mailbox id to test
    Mbox::MboxId id = Mbox::MboxId::eDemoTask; //(Mbox::MboxId)(sys_rand32_get() % Mbox::MboxId::eMboxMax);

    Mbox::registerMbox(pInMbox, id);
    zassert_equal(pInMbox, Mbox::getMboxById(id),
                  "Error getting mailbox by id");

    delete pInMbox;
}

ZTEST(mbox_tests, test_mbox_write) {
    Mbox* pInMbox;
    pInMbox = new Mbox("test");
    zassert_equal(pInMbox->count(), 0, "Error creating mailbox");

    // Get memory pool element
    PoolElem* e1 = MsgPool::inst()->getNewElem(15);
    zassert_not_null(e1, "Failed to get new pool element");

    // Write max slot number of elements to the mailbox
    e1->putString("test_string");
    for (uint32_t i = 1; i <= pInMbox->getMaxSlots(); i++) {
        pInMbox->write(e1);
        zassert_equal(pInMbox->count(), i, "Error writing to the mailbox");
    }

    // Try to add element greater than max slots, it should fail
    pInMbox->write(e1);
    zassert_not_equal(pInMbox->count(), 9, "Error writing to the mailbox");

    // Free the memory pool element
    e1->free();
    delete pInMbox;
}

ZTEST(mbox_tests, test_mbox_send) {
    Mbox* pInMbox;
    pInMbox = new Mbox("test");
    zassert_equal(pInMbox->count(), 0, "Error creating mailbox");
    Mbox::registerMbox(pInMbox, Mbox::MboxId::eDemoTask);

    // Get memory pool element
    PoolElem* e1 = MsgPool::inst()->getNewElem(15);
    zassert_not_null(e1, "Failed to get new pool element");

    // Write max slot number of elements to the mailbox
    e1->putString("test_string");

    // Try to add element greater than max slots, it should fail
    pInMbox->send(e1, Mbox::MboxId::eDemoTask);
    zassert_not_equal(pInMbox->count(), 9, "Error writing to the mailbox");

    pInMbox->stats();

    // Free the memory pool element
    e1->free();
    delete pInMbox;
}

ZTEST(mbox_tests, test_mbox_read) {
    Mbox* pInMbox;
    pInMbox = new Mbox("test");
    zassert_equal(pInMbox->count(), 0, "Error creating mailbox");

    // Read mailbox when no element is there, should return null
    // PoolElem* er = pInMbox->read();
    // zassert_is_null(er, "Failed to get new pool element");

    // Get memory pool element
    PoolElem* e1 = MsgPool::inst()->getNewElem(15);
    zassert_not_null(e1, "Failed to get new pool element");

    // Write mem pool element to the mailbox
    e1->putString("test_string");
    pInMbox->write(e1);

    // Read mailbox when no element is there, should return null
    PoolElem* er = pInMbox->read();
    zassert_not_null(er, "Failed to read mailbox");
    zassert_equal(e1, er, "Error reading the mem pool element");

    // Free the memory pool element
    er->free();
    delete pInMbox;
}

// test function sendMsg(enum msgType mType, MboxId senderId, MboxId receiverId);
ZTEST(mbox_tests, test_mbox_sendMsg_0) {
    Mbox* pInMbox;
    pInMbox = new Mbox("test");
    Mbox::registerMbox(pInMbox, Mbox::eRmsStore);
    zassert_not_null(pInMbox, "pInMbox = NULL");
    zassert_equal(pInMbox->count(), 0, "Error creating mailbox");

    Mbox::sendMsg(msgType::eAdxlStorageDumpAll, Mbox::MboxId::eMain, Mbox::MboxId::eRmsStore);

    // Read mailbox when no element is there, should return null
    PoolElem* e1 = pInMbox->read();
    zassert_not_null(e1, "Failed to read mailbox");
    zassert_equal(e1->mtype, msgType::eAdxlStorageDumpAll, "Wrong msgType");
    zassert_equal(e1->from, Mbox::MboxId::eMain, "Wrong msg sender");

    // Free the memory pool element
    e1->free();
    delete pInMbox;
}

// test function static void sendMsg(enum msgType mType, MboxId senderId, MboxId receiverId, uint8_t u8DataByte);
ZTEST(mbox_tests, test_mbox_sendMsg_u8) {
    Mbox* pInMbox;
    pInMbox = new Mbox("test");
    Mbox::registerMbox(pInMbox, Mbox::eRmsStore);
    zassert_not_null(pInMbox, "pInMbox = NULL");
    zassert_equal(pInMbox->count(), 0, "Error creating mailbox");

    Mbox::sendMsg(msgType::eAdxlStorageDumpAll, Mbox::MboxId::eMain, Mbox::MboxId::eRmsStore, (uint8_t)17);

    // Read mailbox when no element is there, should return null
    PoolElem* e1 = pInMbox->read();
    zassert_not_null(e1, "Failed to read mailbox");
    zassert_equal(e1->mtype, msgType::eAdxlStorageDumpAll, "Wrong msgType");
    zassert_equal(e1->from, Mbox::MboxId::eMain, "Wrong msg sender");
    zassert_equal(e1->p1, 17, "Wrong u8 content");

    // Free the memory pool element
    e1->free();
    delete pInMbox;
}

// test function  sendMsg(enum msgType mType, MboxId senderId, MboxId receiverId, int8_t s8DataByte);
ZTEST(mbox_tests, test_mbox_sendMsg_s8) {
    Mbox* pInMbox;
    pInMbox = new Mbox("test");
    Mbox::registerMbox(pInMbox, Mbox::eRmsStore);
    zassert_not_null(pInMbox, "pInMbox = NULL");
    zassert_equal(pInMbox->count(), 0, "Error creating mailbox");

    Mbox::sendMsg(msgType::eAdxlStorageDumpAll, Mbox::MboxId::eMain, Mbox::MboxId::eRmsStore, (int8_t)-17);

    // Read mailbox when no element is there, should return null
    PoolElem* e1 = pInMbox->read();
    zassert_not_null(e1, "Failed to read mailbox");
    zassert_equal(e1->mtype, msgType::eAdxlStorageDumpAll, "Wrong msgType");
    zassert_equal(e1->from, Mbox::MboxId::eMain, "Wrong msg sender");
    zassert_equal(e1->p2, -17, "Wrong s8 content");

    // Free the memory pool element
    e1->free();
    delete pInMbox;
}

// test function  sendMsg(enum msgType mType, MboxId senderId, MboxId receiverId,uint8_t* pData, uint16_t dataLen);
ZTEST(mbox_tests, test_mbox_sendMsg_buf) {
    Mbox* pInMbox;
    uint8_t buf[4] = {17,18,19,20};
    uint16_t datalen = 4;
    uint8_t* pBuf;

    pInMbox = new Mbox("test");
    Mbox::registerMbox(pInMbox, Mbox::eRmsStore);
    zassert_not_null(pInMbox, "pInMbox = NULL");
    zassert_equal(pInMbox->count(), 0, "Error creating mailbox");

    Mbox::sendMsg(msgType::eAdxlStorageDumpAll, Mbox::MboxId::eMain, Mbox::MboxId::eRmsStore, buf, datalen);

    // Read mailbox when no element is there, should return null
    PoolElem* e1 = pInMbox->read();
    pBuf = e1->getBuffer();
    zassert_not_null(e1, "Failed to read mailbox");
    zassert_equal(e1->mtype, msgType::eAdxlStorageDumpAll, "Wrong msgType");
    zassert_equal(e1->from, Mbox::MboxId::eMain, "Wrong msg sender");
    printk("bufsize = %d\n", e1->getBufferSize());
    //zassert_equal(e1->getBufferSize(), 32, "Wrong buffer size");
    zassert_equal(pBuf[0], 17, "Wrong pBuf[0] content");
    zassert_equal(pBuf[1], 18, "Wrong pBuf[1] content");
    zassert_equal(pBuf[2], 19, "Wrong pBuf[2] content");
    zassert_equal(pBuf[3], 20, "Wrong pBuf[3] content");

    // Free the memory pool element
    e1->free();
    delete pInMbox;
}

// test function  sendMsg(enum msgType mType, MboxId senderId, MboxId receiverId,const std::string& str);
ZTEST(mbox_tests, test_mbox_sendMsg_string) {
    Mbox* pInMbox;
    std::string s = "testTestTest";
    std::string s2;
    unsigned char* pBuf;

    pInMbox = new Mbox("test");
    Mbox::registerMbox(pInMbox, Mbox::eRmsStore);
    zassert_not_null(pInMbox, "pInMbox = NULL");
    zassert_equal(pInMbox->count(), 0, "Error creating mailbox");

    Mbox::sendMsg(msgType::eAdxlStorageDumpAll, Mbox::MboxId::eMain, Mbox::MboxId::eRmsStore, s);

    // Read mailbox when no element is there, should return null
    PoolElem* e1 = pInMbox->read();
    pBuf = e1->getBuffer();
    zassert_not_null(e1, "Failed to read mailbox");
    zassert_equal(e1->mtype, msgType::eAdxlStorageDumpAll, "Wrong msgType");
    zassert_equal(e1->from, Mbox::MboxId::eMain, "Wrong msg sender");
    printk("bufsize = %d\n", e1->getBufferSize());
    //zassert_equal(e1->getBufferSize(), 13, "Wrong buffer size");
    zassert(strcmp(s.c_str(), "testTestTest")==0, "wrong string content");

    // Free the memory pool element
    e1->free();
    delete pInMbox;
}
```

## src/test_mempool.cpp
```c
#include <stddef.h>
#include <stdint.h>
#include <stdio.h>
#include <stdlib.h>
//#include <zephyr/kernel.h>
#include <zephyr/ztest.h>

#include "rtos/mbox.h"
#include "rtos/mpelem.h"
#include "rtos/mpool.h"
#include "rtos/mqueue.h"

#include "stubs.h"
 


ZTEST_SUITE(tests_mempool, NULL, NULL, NULL, NULL, NULL);

ZTEST(tests_mempool, mempool_test)
{
	int32_t rc;
    unsigned char (*out1)[16];
    unsigned char (*out2)[16];
    unsigned char (*out3)[16];
    unsigned char (*out4)[16];
    unsigned char (*out5)[16];
    uint16_t in;
	std::string s;
	std::string exp;

    MemoryPool<uint8_t[16], 4> p;

    out1 = p.alloc();
	zassert_equal(p.size(), 4, "size() != 4");
	zassert_equal(p.blocksize(), 16, "blocksize() != 16");
	zassert_equal(p.used(), 1, "used() != 1");
	zassert_equal(p.maxused(), 1, "maxused() != 1");
	zassert_equal(p.available(), 3, "available() != 3");
    p.stats();

    out2 = p.alloc();
	zassert_equal(p.used(), 2, "used() != 2");
	zassert_equal(p.maxused(), 2, "maxused() != 2");
	zassert_equal(p.available(), 2, "available() != 2");
    p.stats();

    out3 = p.alloc();
	zassert_equal(p.used(), 3, "used() != 3");
	zassert_equal(p.maxused(), 3, "maxused() != 3");
	zassert_equal(p.available(), 1, "available() != 1");
    p.stats();

    p.free(out2);
	zassert_equal(p.used(), 2, "used() != 2");
	zassert_equal(p.maxused(), 3, "maxused() != 3");
	zassert_equal(p.available(), 2, "available() != 2");
    p.stats();

    out2 = p.alloc();
	zassert_equal(p.used(), 3, "used() != 3");
	zassert_equal(p.maxused(), 3, "maxused() != 3");
	zassert_equal(p.available(), 1, "available() != 1");
    p.stats();

    out4 = p.alloc();
	zassert_equal(p.used(), 4, "used() != 4");
	zassert_equal(p.maxused(), 4, "maxused() != 4");
	zassert_equal(p.available(), 0, "available() != 0");
    p.stats();

    out5 = p.alloc();
    zassert_is_null(out5, "memory pool empty");
    p.stats();
}

ZTEST(tests_mempool, mempool_test2)
{
	int32_t rc;
    unsigned char (*out1)[64];
    unsigned char (*out2)[64];
    unsigned char (*out3)[64];
    unsigned char (*out4)[64];
    unsigned char (*out5)[64];
    uint16_t in;
	std::string s;
	std::string exp;

    MemoryPool<uint8_t[64], 4> p;

    out1 = p.alloc();
	zassert_equal(p.size(), 4, "size() != 4");
	zassert_equal(p.blocksize(), 64, "blocksize() != 64");
	zassert_equal(p.used(), 1, "used() != 1");
	zassert_equal(p.maxused(), 1, "maxused() != 1");
	zassert_equal(p.available(), 3, "available() != 3");
    p.stats();

    out2 = p.alloc();
	zassert_equal(p.used(), 2, "used() != 2");
	zassert_equal(p.maxused(), 2, "maxused() != 2");
	zassert_equal(p.available(), 2, "available() != 2");
    p.stats();

    out3 = p.alloc();
	zassert_equal(p.used(), 3, "used() != 3");
	zassert_equal(p.maxused(), 3, "maxused() != 3");
	zassert_equal(p.available(), 1, "available() != 1");
    p.stats();

    p.free(out2);
	zassert_equal(p.used(), 2, "used() != 2");
	zassert_equal(p.maxused(), 3, "maxused() != 3");
	zassert_equal(p.available(), 2, "available() != 2");
    p.stats();

    out2 = p.alloc();
	zassert_equal(p.used(), 3, "used() != 3");
	zassert_equal(p.maxused(), 3, "maxused() != 3");
	zassert_equal(p.available(), 1, "available() != 1");
    p.stats();

    out4 = p.alloc();
	zassert_equal(p.used(), 4, "used() != 4");
	zassert_equal(p.maxused(), 4, "maxused() != 4");
	zassert_equal(p.available(), 0, "available() != 0");
    p.stats();

    out5 = p.alloc();
    zassert_is_null(out5, "memory pool empty");
    p.stats();
}

/*ZTEST(mempool_tests, test_mempool) { zassert_true(1, "1 was false"); }

ZTEST(mempool_tests, test_mempool_init) {
    // Test if memory pool is initialized properly
}

ZTEST(mempool_tests, test_mempool_alloc) {
    // Test if different sized memory elements can be obtained from the memory
    // pool
}

ZTEST(mempool_tests, test_mempool_free) {
    // Test if obtained memory pool elements are freed properly
}*/
```

## src/test_mpelem.cpp
```c
#include <zephyr/ztest.h>
//#include <vector>
//#include <algorithm>

#define private public
#include "rtos/mempool.h"
#include "rtos/mpool.h"
#include "rtos/mpelem.h"


ZTEST_SUITE(mpelem_tests, NULL, NULL, NULL, NULL, NULL);

ZTEST(mpelem_tests, test_mpelem_constructor) {
    MsgPool* p = MsgPool::inst();
    PoolElem* pMsg;
    uint16_t size = 20;

    pMsg = p->getNewElem(size);
    zassert_not_null(pMsg, "pMsg == NULL");

    pMsg->free();
}

ZTEST(mpelem_tests, test_mpelem_putString) {
    MsgPool* p = MsgPool::inst();
    PoolElem* pMsg;
    uint16_t size = 20;
    uint16_t bufsize;
    char* pStr;

    pMsg = p->getNewElem(size);
    zassert_not_null(pMsg, "pMsg == NULL");
    zassert_false(pMsg->inPool, "inpool == true");
    pMsg->putString("123-Test");
    zassert_equal(pMsg->bufLen, 32, "bufLen != 32");
    bufsize = pMsg->getBufferSize();
    zassert_equal(bufsize, 32, "bufsize != 32");
    zassert_equal(pMsg->dataLen, 9, "dataLen != 9");
    pStr = (char*)pMsg->getBuffer();
    zassert(strcmp(pStr, "123-Test")==0, "wrong string");

    pMsg->DumpAsString();
    pMsg->DumpAsStringHex(pMsg->bufLen);
    pMsg->DumpAsStringHex();

    pMsg->free();
    zassert_true(pMsg->inPool, "inpool == false");
}

ZTEST(mpelem_tests, test_mpelem_putString2) {
    MsgPool* p = MsgPool::inst();
    PoolElem* pMsg;
    uint16_t size = 20;
    uint16_t bufsize;
    char* pStr;

    pMsg = p->getNewElem(size);
    zassert_not_null(pMsg, "pMsg == NULL");
    zassert_false(pMsg->inPool, "inpool == true");
    pMsg->putString("");
    zassert_equal(pMsg->bufLen, 32, "bufLen != 32");
    bufsize = pMsg->getBufferSize();
    zassert_equal(bufsize, 32, "bufsize != 32");
    zassert_equal(pMsg->dataLen, 0, "dataLen != 0");
    pStr = (char*)pMsg->getBuffer();
    zassert(strcmp(pStr, "")==0, "wrong string");

    pMsg->DumpAsString();
    pMsg->DumpAsStringHex(pMsg->bufLen);
    pMsg->DumpAsStringHex();

    pMsg->free();
    zassert_true(pMsg->inPool, "inpool == false");
}

ZTEST(mpelem_tests, test_mpelem_putData) {
    MsgPool* p = MsgPool::inst();
    PoolElem* pMsg;
    uint16_t size = 4;
    uint16_t bufsize;
    uint8_t* pData;
    char data[4] = {1,2,3,4};

    pMsg = p->getNewElem(size);
    zassert_not_null(pMsg, "pMsg == NULL");
    zassert_false(pMsg->inPool, "inpool == true");
    pMsg->putData(data, 4);
    zassert_equal(pMsg->bufLen, 32, "bufLen != 32");
    bufsize = pMsg->getBufferSize();
    zassert_equal(bufsize, 32, "bufsize != 32");
    zassert_equal(pMsg->dataLen, 4, "dataLen != 4");
    pData = pMsg->getBuffer();
    zassert_equal(pData[0], 1, "pData[0] != 1");
    zassert_equal(pData[1], 2, "pData[0] != 2");
    zassert_equal(pData[2], 3, "pData[0] != 3");
    zassert_equal(pData[3], 4, "pData[0] != 4");

    pMsg->Dump();

    pMsg->clearBuffer();
    zassert_equal(pMsg->dataLen, 0, "dataLen != 0");

    pMsg->free();
    zassert_true(pMsg->inPool, "inpool == false");
}
```

## src/test_mpool.cpp
```c
#include <zephyr/ztest.h>
#include <vector>
#include <algorithm>

#define private public
#include "rtos/mempool.h"
#include "rtos/mpool.h"
#include "rtos/mpelem.h"

ZTEST_SUITE(tests_msgpool, NULL, NULL, NULL, NULL, NULL);

ZTEST(tests_msgpool, msgpool_test_constructor) {
    MsgPool* pMsgPool;
    pMsgPool = new MsgPool();
    zassert_not_null(pMsgPool);
    delete pMsgPool;
}

// MISSING for 100% branch coverage operator new does not deliver NULL
// here code lines 
// static MsgPool myInstance;
// are not covered completly.

ZTEST(tests_msgpool, msgpool_test_0)
{
    MsgPool* p = MsgPool::inst();
    PoolElem* pMsg[17];

    zassert_equal(p->size(), 16, "size() != 16");

    for (int i = 0; i < 16; i++) {
        pMsg[i] = p->getNewElem();
        printk("size = %d, used = %d, max used = %d, available = %d\n\n", 
               p->size(), p->used(), p->maxused(), p->available());
        zassert_equal(p->used(), i+1, "used() != %d", i+1);
        zassert_equal(p->maxused(), i+1, "maxused() != %d", i+1);
        zassert_equal(p->available(), 16-(i+1), "available() != %d", 16-(i+1));
    }
    
    pMsg[16] = p->getNewElem();
    printk("MsgPool empty, pMsg = NULL\n\n");
    zassert_is_null(pMsg[16]);
    zassert_equal(p->used(), 16, "used() != 16");
    zassert_equal(p->maxused(), 16, "maxused() != 16");
    zassert_equal(p->available(), 0, "available() != 0");

    for (int i = 0; i < 16; i++) {
        pMsg[i]->free();
        printk("size = %d, used = %d, max used = %d, available = %d\n\n", 
                p->size(), p->used(), p->maxused(), p->available());
        zassert_equal(p->used(), 16-(i+1), "used() != %d", 16-(i+1));
        zassert_equal(p->maxused(), 16, "maxused() != 16");
        zassert_equal(p->available(), i+1, "available() != %d", i+1);
    }
}

ZTEST(tests_msgpool, msgpool_test_32)
{
    MsgPool* p = MsgPool::inst();
    PoolElem* pMsg[9];
    uint16_t size = 30;

    zassert_equal(p->bufpool_size(size), 8, "bufpool_size() != 8");

    for (int i = 0; i < 8; i++) {
        pMsg[i] = p->getNewElem(size);
        printk("MsgPool: size = %d, used = %d, max used = %d, available = %d\n", 
            p->size(), p->used(), p->maxused(), p->available());
        printk("BufPool: size = %d, used = %d, max used = %d, available = %d\n\n", 
            p->bufpool_size(size), p->bufpool_used(size), p->bufpool_maxused(size), 
            p->bufpool_available(size));
        zassert_equal(p->bufpool_used(size), i+1, "bufpool_used() != %d", i+1);
        zassert_equal(p->bufpool_maxused(size), i+1, "bufpool_maxused() != %d", i+1);
        zassert_equal(p->bufpool_available(size), 8-(i+1), "bufpool_available() != %d", 8-(i+1));
    }
    
    pMsg[9] = p->getNewElem();
    printk("BufferPool empty, pMsg->buffer = NULL\n\n");
    zassert_is_null(pMsg[9]->getBuffer());
    zassert_equal(p->bufpool_used(size), 8, "bufpool_used() != 8");
    zassert_equal(p->bufpool_maxused(size), 8, "bufpool_maxused() != 8");
    zassert_equal(p->bufpool_available(size), 0, "bufpool_available() != 0");
    pMsg[9]->free();

    for (int i = 0; i < 8; i++) {
        pMsg[i]->free();
        printk("BufPool: size = %d, used = %d, max used = %d, available = %d\n\n", 
            p->bufpool_size(size), p->bufpool_used(size), p->bufpool_maxused(size), 
            p->bufpool_available(size));
        zassert_equal(p->bufpool_used(size), 8-(i+1), "bufpool_used() != %d", 8-(i+1));
        zassert_equal(p->bufpool_maxused(size), 8, "bufpool_maxused() != 8");
        zassert_equal(p->bufpool_available(size), i+1, "bufpool_available() != %d", i+1);
    }
}

ZTEST(tests_msgpool, msgpool_test_128)
{
    MsgPool* p = MsgPool::inst();
    PoolElem* pMsg[5];
    uint16_t size = 120;

    zassert_equal(p->bufpool_size(size), 4, "bufpool_size() != 4");

    for (int i = 0; i < 4; i++) {
        pMsg[i] = p->getNewElem(size);
        printk("MsgPool: size = %d, used = %d, max used = %d, available = %d\n", 
            p->size(), p->used(), p->maxused(), p->available());
        printk("BufPool: size = %d, used = %d, max used = %d, available = %d\n\n", 
            p->bufpool_size(size), p->bufpool_used(size), p->bufpool_maxused(size), 
            p->bufpool_available(size));
        zassert_equal(p->bufpool_used(size), i+1, "bufpool_used() != %d", i+1);
        zassert_equal(p->bufpool_maxused(size), i+1, "bufpool_maxused() != %d", i+1);
        zassert_equal(p->bufpool_available(size), 4-(i+1), "bufpool_available() != %d", 4-(i+1));
    }
    
    pMsg[5] = p->getNewElem();
    printk("BufferPool empty, pMsg->buffer = NULL\n\n");
    zassert_is_null(pMsg[5]->getBuffer());
    zassert_equal(p->bufpool_used(size), 4, "bufpool_used() != 4");
    zassert_equal(p->bufpool_maxused(size), 4, "bufpool_maxused() != 4");
    zassert_equal(p->bufpool_available(size), 0, "bufpool_available() != 0");
    pMsg[5]->free();

    for (int i = 0; i < 4; i++) {
        pMsg[i]->free();
        printk("BufPool: size = %d, used = %d, max used = %d, available = %d\n\n", 
            p->bufpool_size(size), p->bufpool_used(size), p->bufpool_maxused(size), 
            p->bufpool_available(size));
        zassert_equal(p->bufpool_used(size),4-(i+1), "bufpool_used() != %d", 4-(i+1));
        zassert_equal(p->bufpool_maxused(size), 4, "bufpool_maxused() != 4");
        zassert_equal(p->bufpool_available(size), i+1, "bufpool_available() != %d", i+1);
    }
}

ZTEST(tests_msgpool, msgpool_test_256)
{
    MsgPool* p = MsgPool::inst();
    PoolElem* pMsg[5];
    uint16_t size = 250;

    zassert_equal(p->bufpool_size(size), 4, "bufpool_size() != 4");

    for (int i = 0; i < 4; i++) {
        pMsg[i] = p->getNewElem(size);
        printk("MsgPool: size = %d, used = %d, max used = %d, available = %d\n", 
            p->size(), p->used(), p->maxused(), p->available());
            printk("BufPool: size = %d, used = %d, max used = %d, available = %d\n\n", 
                p->bufpool_size(size), p->bufpool_used(size), p->bufpool_maxused(size), 
            p->bufpool_available(size));
        zassert_equal(p->bufpool_used(size), i+1, "bufpool_used() != %d", i+1);
        zassert_equal(p->bufpool_maxused(size), i+1, "bufpool_maxused() != %d", i+1);
        zassert_equal(p->bufpool_available(size), 4-(i+1), "bufpool_available() != %d", 4-(i+1));
    }
    
    pMsg[5] = p->getNewElem();
    printk("BufferPool empty, pMsg->buffer = NULL\n\n");
    zassert_is_null(pMsg[5]->getBuffer());
    zassert_equal(p->bufpool_used(size), 4, "bufpool_used() != 4");
    zassert_equal(p->bufpool_maxused(size), 4, "bufpool_maxused() != 4");
    zassert_equal(p->bufpool_available(size), 0, "bufpool_available() != 0");
    pMsg[5]->free();

    for (int i = 0; i < 4; i++) {
        pMsg[i]->free();
        printk("BufPool: size = %d, used = %d, max used = %d, available = %d\n\n", 
            p->bufpool_size(size), p->bufpool_used(size), p->bufpool_maxused(size), 
            p->bufpool_available(size));
        zassert_equal(p->bufpool_used(size), 4-(i+1), "bufpool_used() != %d", 4-(i+1));
        zassert_equal(p->bufpool_maxused(size), 4, "bufpool_maxused() != 4");
        zassert_equal(p->bufpool_available(size), i+1, "bufpool_available() != %d", i+1);
    }
}

ZTEST(tests_msgpool, msgpool_test_512)
{
    MsgPool* p = MsgPool::inst();
    PoolElem* pMsg[3];
    uint16_t size = 500;

    zassert_equal(p->bufpool_size(size), 2, "bufpool_size() != 2");

    for (int i = 0; i < 2; i++) {
        pMsg[i] = p->getNewElem(size);
        printk("MsgPool: size = %d, used = %d, max used = %d, available = %d\n", 
            p->size(), p->used(), p->maxused(), p->available());
        printk("BufPool: size = %d, used = %d, max used = %d, available = %d\n\n", 
            p->bufpool_size(size), p->bufpool_used(size), p->bufpool_maxused(size), 
            p->bufpool_available(size));
        zassert_equal(p->bufpool_used(size), i+1, "bufpool_used() != %d", i+1);
        zassert_equal(p->bufpool_maxused(size), i+1, "bufpool_maxused() != %d", i+1);
        zassert_equal(p->bufpool_available(size), 2-(i+1), "bufpool_available() != %d", 2-(i+1));
    }
    
    pMsg[3] = p->getNewElem();
    printk("BufferPool empty, pMsg->buffer = NULL\n\n");
    zassert_is_null(pMsg[3]->getBuffer());
    zassert_equal(p->bufpool_used(size), 2, "bufpool_used() != 2");
    zassert_equal(p->bufpool_maxused(size), 2, "bufpool_maxused() != 2");
    zassert_equal(p->bufpool_available(size), 0, "bufpool_available() != 0");
    pMsg[3]->free();

    for (int i = 0; i < 2; i++) {
        pMsg[i]->free();
        printk("BufPool: size = %d, used = %d, max used = %d, available = %d\n\n", 
            p->bufpool_size(size), p->bufpool_used(size), p->bufpool_maxused(size), 
            p->bufpool_available(size));
        zassert_equal(p->bufpool_used(size), 2-(i+1), "bufpool_used() != %d", 2-(i+1));
        zassert_equal(p->bufpool_maxused(size), 2, "bufpool_maxused() != 2");
        zassert_equal(p->bufpool_available(size), i+1, "bufpool_available() != %d", i+1);
    }
}


ZTEST(tests_msgpool, msgpool_test_1024)
{
    MsgPool* p = MsgPool::inst();
    PoolElem* pMsg[5];
    uint16_t size = 1000;

    zassert_equal(p->bufpool_size(size), 4, "bufpool_size() != 4");

    for (int i = 0; i < 4; i++) {
        pMsg[i] = p->getNewElem(size);
        printk("MsgPool: size = %d, used = %d, max used = %d, available = %d\n", 
            p->size(), p->used(), p->maxused(), p->available());
        printk("BufPool: size = %d, used = %d, max used = %d, available = %d\n\n", 
            p->bufpool_size(size), p->bufpool_used(size), p->bufpool_maxused(size), 
            p->bufpool_available(size));
        zassert_equal(p->bufpool_used(size), i+1, "bufpool_used() != %d", i+1);
        zassert_equal(p->bufpool_maxused(size), i+1, "bufpool_maxused() != %d", i+1);
        zassert_equal(p->bufpool_available(size), 4-(i+1), "bufpool_available() != %d", 4-(i+1));
    }
    
    pMsg[5] = p->getNewElem();
    printk("BufferPool empty, pMsg->buffer = NULL\n\n");
    zassert_is_null(pMsg[5]->getBuffer());
    zassert_equal(p->bufpool_used(size), 4, "bufpool_used() != 4");
    zassert_equal(p->bufpool_maxused(size), 4, "bufpool_maxused() != 4");
    zassert_equal(p->bufpool_available(size), 0, "bufpool_available() != 0");
    pMsg[5]->free();

    for (int i = 0; i < 4; i++) {
        pMsg[i]->free();
        printk("BufPool: size = %d, used = %d, max used = %d, available = %d\n\n", 
            p->bufpool_size(size), p->bufpool_used(size), p->bufpool_maxused(size), 
            p->bufpool_available(size));
        zassert_equal(p->bufpool_used(size), 4-(i+1), "bufpool_used() != %d", 4-(i+1));
        zassert_equal(p->bufpool_maxused(size), 4, "bufpool_maxused() != 4");
        zassert_equal(p->bufpool_available(size), i+1, "bufpool_available() != %d", i+1);
    }
}

ZTEST(tests_msgpool, msgpool_test_1024_2)
{
    MsgPool* p = MsgPool::inst();
    PoolElem* pMsg[5];
    uint16_t size = 1024;

    zassert_equal(p->bufpool_size(size), 4, "bufpool_size() != 4");

    for (int i = 0; i < 4; i++) {
        pMsg[i] = p->getNewElem(size);
        printk("MsgPool: size = %d, used = %d, max used = %d, available = %d\n", 
            p->size(), p->used(), p->maxused(), p->available());
        printk("BufPool: size = %d, used = %d, max used = %d, available = %d\n\n", 
            p->bufpool_size(size), p->bufpool_used(size), p->bufpool_maxused(size), 
            p->bufpool_available(size));
        zassert_equal(p->bufpool_used(size), i+1, "bufpool_used() != %d", i+1);
        zassert_equal(p->bufpool_maxused(size), i+1, "bufpool_maxused() != %d", i+1);
        zassert_equal(p->bufpool_available(size), 4-(i+1), "bufpool_available() != %d", 4-(i+1));
    }
    
    pMsg[5] = p->getNewElem();
    printk("BufferPool empty, pMsg->buffer = NULL\n\n");
    zassert_is_null(pMsg[5]->getBuffer());
    zassert_equal(p->bufpool_used(size), 4, "bufpool_used() != 4");
    zassert_equal(p->bufpool_maxused(size), 4, "bufpool_maxused() != 4");
    zassert_equal(p->bufpool_available(size), 0, "bufpool_available() != 0");
    pMsg[5]->free();

    for (int i = 0; i < 4; i++) {
        pMsg[i]->free();
        printk("BufPool: size = %d, used = %d, max used = %d, available = %d\n\n", 
            p->bufpool_size(size), p->bufpool_used(size), p->bufpool_maxused(size), 
            p->bufpool_available(size));
        zassert_equal(p->bufpool_used(size), 4-(i+1), "bufpool_used() != %d", 4-(i+1));
        zassert_equal(p->bufpool_maxused(size), 4, "bufpool_maxused() != 4");
        zassert_equal(p->bufpool_available(size), i+1, "bufpool_available() != %d", i+1);
    }
}

ZTEST(tests_msgpool, msgpool_test_invalid_size)
{
    MsgPool* p = MsgPool::inst();
    PoolElem* pMsg;
    PoolElem* pMsg2;
    uint16_t size = 1070;

    pMsg = p->getNewElem(1020);
    pMsg2 = p->getNewElem(size);
    pMsg->bufLen = size;
    p->freeElem(pMsg);

    p->stats();

    p->bufpool_size(0);
    p->bufpool_size(size);
    p->bufpool_used(0);
    p->bufpool_used(size);
    p->bufpool_maxused(0);
    p->bufpool_maxused(size);
    p->bufpool_available(0);
    p->bufpool_available(size);
}
```

## src/test_mqueue.cpp
```c
#include <stddef.h>
#include <stdint.h>
#include <stdio.h>
#include <stdlib.h>
#include <zephyr/kernel.h>
#include <zephyr/ztest.h>

#include "rtos/mbox.h"
#include "rtos/mpelem.h"
#include "rtos/mpool.h"
#include "rtos/mqueue.h"

/*#include <zephyr/ztest.h>
#include <vector>
#include <algorithm>

#define private public
#include "rtos/MessageQueue.h"*/

ZTEST_SUITE(tests_msgqueue, NULL, NULL, NULL, NULL, NULL);

ZTEST(tests_msgqueue, msgqueue_test)
{
	int32_t rc;
    uint16_t* out;
    uint16_t in;
	std::string s;
	std::string exp;

    MQueue<uint16_t, 3> q;

    in = 11;
	rc = q.put(&in);
	zassert_equal(rc, 0, "rc != 0");
	zassert_equal(q.size(), 3, "size() != 3");
	zassert_equal(q.count(), 1,  "used() != 1");
	zassert_equal(q.avail(), 2, "available() != 2");
	zassert_equal(q.msg_size(), 4, "msg_size() != 4");
	printk("put:  used = %d, available = %d, enqued value = %d\n\n", q.count(), q.avail(), in);

    q.stats();

    in = 12;
	rc = q.put(&in);
	zassert_equal(rc, 0, "rc != 0");
	zassert_equal(q.count(), 2, "used() != 2");
	zassert_equal(q.avail(), 1, "available() != 1");
	printk("put:  used = %d, available = %d, enqued value = %d\n\n", q.count(), q.avail(), in);

	out = q.get();
	//zassert_equal(*out, 11, "val != 0");
	zassert_equal(q.count(), 1, "used() != 1");
	zassert_equal(q.avail(), 1, "available() != 1");
	printk("put:  used = %d, available = %d, enqued value = %d\n\n", q.count(), q.avail(), in);

    in = 13;
	rc = q.put(&in);
	zassert_equal(rc, 0, "rc != 0");
	zassert_equal(q.count(), 2, "used() != 2");
	printk("put:  used = %d, available = %d, enqued value = %d\n\n", q.count(), q.avail(), in);

    in = 14;
	rc = q.put(&in);
	zassert_equal(rc, 0, "rc != 0");
	zassert_equal(q.count(), 3, "used() != 3");
	printk("put:  used = %d, available = %d, enqued value = %d\n\n", q.count(), q.avail(), in);
	// Queue full

    in = 14;
	rc = q.put(&in);
	zassert_equal(rc, -35, "rc != -35");
}
```

## src/test_mutex.cpp
```c
#include <zephyr/ztest.h>
#include <vector>
#include <algorithm>

#define private public
#include "rtos/mutex.h"


/*/ Thread-Stapel und Steuerblöcke
#define STACK_SIZE 512
#define PRIORITY 5

K_THREAD_STACK_DEFINE(thread_1_stack, STACK_SIZE);
K_THREAD_STACK_DEFINE(thread_2_stack, STACK_SIZE);

static struct k_thread thread_1_data;
static struct k_thread thread_2_data;

static Mutex tm;

void thread_entry1(void *p1, void *p2, void *p3)
{
	int rc;

	rc = tm.lock();
	zassert_equal(rc, 0, "rc != 0");
	zassert_equal(tm.mutex_handle.lock_count, 1, "lock_count != 1");
	printk("Thread1 lock:  count = %d\n", tm.mutex_handle.lock_count);

	k_sleep(K_MSEC(10));
	printk("Thread1 unlock\n");
	tm.unlock();

	rc = tm.lock_timed(100);     // warte 100 ms maximal bis frei (unlocked)
	zassert_equal(rc, 0, "rc != 0");
	zassert_equal(tm.mutex_handle.lock_count, 1, "lock_count != 1");
	printk("Thread1 lock_timed:  count = %d\n", tm.mutex_handle.lock_count);
}

void thread_entry2(void *p1, void *p2, void *p3)
{
	int rc;

	rc = tm.lock_timed(100);     // warte 100 ms maximal bis frei (unlocked)
	zassert_equal(rc, 0, "rc != 0");
	zassert_equal(tm.mutex_handle.lock_count, 1, "lock_count != 1");
	printk("Thread2 lock_timed:  count = %d\n", tm.mutex_handle.lock_count);

	printk("Thread2 unlock\n");
	tm.unlock();
	k_sleep(K_MSEC(10));

	rc = tm.lock_timed(100);     // warte 100 ms maximal bis frei (unlocked)
	zassert_equal(rc, -11, "rc != -11");
	zassert_equal(tm.mutex_handle.lock_count, 1, "lock_count != 1");
	printk("Thread2 lock_timed:  count = %d, rc = %d\n", tm.mutex_handle.lock_count, rc);
}

*/

ZTEST_SUITE(tests_mutex, NULL, NULL, NULL, NULL, NULL);

ZTEST(tests_mutex, mutex_test1)
{
	int rc;
	Mutex* m = new Mutex();

	zassert_not_null(m, "memory alloc failed");

	rc = m->lock();
	zassert_equal(rc, 0, "rc != 0");
	zassert_equal(m->mutex_handle.lock_count, 1, "lock_count != 1");
	printk("lock:  count = %d\n\n", m->mutex_handle.lock_count);

	m->unlock();
	zassert_equal(m->mutex_handle.lock_count, 0, "lock_count != 0");
	printk("unlock:  count = %d\n\n", m->mutex_handle.lock_count);

	rc = m->lock();
	zassert_equal(rc, 0, "rc != 0");
	zassert_equal(m->mutex_handle.lock_count, 1, "lock_count != 1");
	printk("lock:  count = %d\n\n", m->mutex_handle.lock_count);

	rc = m->lock();
	zassert_equal(rc, 0, "rc != 0");
	zassert_equal(m->mutex_handle.lock_count, 2, "lock_count != 2");
	printk("lock:  count = %d\n\n", m->mutex_handle.lock_count);

	m->unlock();
	zassert_equal(m->mutex_handle.lock_count, 1, "lock_count != 1");
	printk("unlock:  count = %d\n\n", m->mutex_handle.lock_count);

	m->unlock();
	zassert_equal(m->mutex_handle.lock_count, 0, "lock_count != 0");
	printk("unlock:  count = %d\n\n", m->mutex_handle.lock_count);

	delete m;
}

/*ZTEST(tests_mutex, mutex_test2)
{
    k_thread_create(&thread_1_data, thread_1_stack, STACK_SIZE, thread_entry1, 
		NULL, NULL, NULL, PRIORITY, 0, K_NO_WAIT);

	k_thread_create(&thread_2_data, thread_2_stack, STACK_SIZE, thread_entry2, 
		NULL, NULL, NULL, PRIORITY, 0, K_NO_WAIT);

	// Warten, bis beide Threads fertig sind
	k_thread_join(&thread_1_data, K_FOREVER);
	k_thread_join(&thread_2_data, K_FOREVER);
}*/

ZTEST(tests_mutex, mutex_test3)
{
	int rc;
	Mutex* m = new Mutex();

	zassert_not_null(m, "memory alloc failed");

	rc = m->lock_timed(10);
	zassert_equal(rc, 0, "rc != 0");
	zassert_equal(m->mutex_handle.lock_count, 1, "lock_count != 1");
	printk("lock:  count = %d\n\n", m->mutex_handle.lock_count);

	//m->unlock();
	//zassert_equal(m->mutex_handle.lock_count, 0, "lock_count != 0");
	//printk("unlock:  count = %d\n\n", m->mutex_handle.lock_count);
}
```

## src/test_sema.cpp
```c
#include <zephyr/ztest.h>
#include <vector>
#include <algorithm>

#define private public
#include "rtos/sema.h"

/*/ Thread-Stapel und Steuerblöcke
#define STACK_SIZE 512
#define PRIORITY 5

K_THREAD_STACK_DEFINE(thread_1_stack, STACK_SIZE);
K_THREAD_STACK_DEFINE(thread_2_stack, STACK_SIZE);

static struct k_thread thread_1_data;
static struct k_thread thread_2_data;

static Sema ts(0);

void thread_entry1(void *p1, void *p2, void *p3)
{
	int rc;

	k_sleep(K_MSEC(10));

	rc = ts.wait();
	zassert_equal(rc, 0, "rc != 0");
	zassert_equal(ts.count(), 0, "count != 0");
	printk("Thread1 wait:  count = %d\n\n", ts.count());

	k_sleep(K_MSEC(20));

	rc = ts.wait();
	zassert_equal(rc, 0, "rc != 0");
	zassert_equal(ts.count(), 1, "count != 1");
	printk("Thread1 wait:  count = %d\n\n", ts.count());

	rc = ts.wait();
	zassert_equal(rc, 0, "rc != 0");
	zassert_equal(ts.count(), 0, "count != 0");
	printk("Thread1 wait:  count = %d\n\n", ts.count());

	rc = ts.wait_timed(100);
	zassert_equal(rc, 0, "rc != 0");
	zassert_equal(ts.count(), 0, "count != 0");
	printk("Thread1 wait_timed:  count = %d\n\n", ts.count());

	rc = ts.wait_timed(100);
	zassert_equal(rc, -11, "rc != -11");
	zassert_equal(ts.count(), 0, "count != 0");
	printk("Thread1 wait_timed:  rc = %d, count = %d\n\n", rc, ts.count());
}

void thread_entry2(void *p1, void *p2, void *p3)
{
	int rc;

	ts.signal();
	zassert_equal(ts.count(), 1, "count != 1");
	printk("Thread2 signal:  count = %d\n\n", ts.count());

	k_sleep(K_MSEC(10));

	ts.signal();
	zassert_equal(ts.count(), 1, "count != 1");
	printk("Thread2 signal:  count = %d\n\n", ts.count());

	ts.signal();
	zassert_equal(ts.count(), 2, "count != 2");
	printk("Thread2 signal:  count = %d\n\n", ts.count());

	k_sleep(K_MSEC(50));

	ts.signal();
	// count 0, because execution of wait_timed in thread 1 directly after ts.signal();
	zassert_equal(ts.count(), 0, "count != 0");
	printk("Thread2 signal:  count = %d\n\n", ts.count());

}*/

ZTEST_SUITE(tests_sema, NULL, NULL, NULL, NULL, NULL);

ZTEST(tests_sema, sema_test1)
{
	int rc;
	uint32_t cnt = 0;
	Sema* s = new Sema(0);
	zassert_not_null(s, "memory alloc failed");

	s->signal();
	//zassert_equal(s.count(), 2, "count != 2");
	cnt = s->count();
	printk("signal count = %d\n\n", cnt);

	rc = s->wait();
	zassert_equal(rc, 0, "rc != 0");
	cnt = s->count();
	printk("wait count = %d\n\n", cnt);

	s->signal();
	//zassert_equal(s.count(), 2, "count != 2");
	cnt = s->count();
	printk("signal count = %d\n\n", cnt);

	rc = s->wait_timed(10);
	zassert_equal(rc, 0, "rc != 0");
	cnt = s->count();
	printk("wait_timed count = %d\n\n", cnt);

	delete s;
}

/*ZTEST(tests_sema, sema_test2)
{
    k_thread_create(&thread_1_data, thread_1_stack, STACK_SIZE, thread_entry1, 
		NULL, NULL, NULL, PRIORITY, 0, K_NO_WAIT);

	k_thread_create(&thread_2_data, thread_2_stack, STACK_SIZE, thread_entry2, 
		NULL, NULL, NULL, PRIORITY, 0, K_NO_WAIT);

	// Warten, bis beide Threads fertig sind
	k_thread_join(&thread_1_data, K_FOREVER);
	k_thread_join(&thread_2_data, K_FOREVER);
}*/
```

## src/test_task.cpp
```c
#include <zephyr/ztest.h>
//#include <vector>
//#include <algorithm>

#define private public
#include "rtos/task.h"


#define STACK_SIZE 1024
#define PRIORITY 5
static K_THREAD_STACK_DEFINE(TASK_STACK, STACK_SIZE);


class TestTask : public Task {
 public:
    explicit TestTask(const char* name = "??");
    virtual ~TestTask();
    virtual void task(void);

 private:
};

TestTask::TestTask(const char* name) : Task(name) {
}

TestTask::~TestTask() { }

void TestTask::task(void) { 
}


ZTEST_SUITE(tests_task, NULL, NULL, NULL, NULL, NULL);

// test constructor and destructor
ZTEST(tests_task, tests_task_constructor)
{
	TestTask* pTask = new TestTask("test");

	zassert_not_null(pTask, "memory alloc failed");

    pTask->create(TASK_STACK, STACK_SIZE, PRIORITY);
    pTask->setId(17);
    pTask->start();
    pTask->configure();
    pTask->task();

	delete pTask; 
}

// test function taskCode
ZTEST(tests_task, tests_task_taskCode)
{
	TestTask* pTask = new TestTask("test");

	zassert_not_null(pTask, "memory alloc failed");

    pTask->create(TASK_STACK, STACK_SIZE, PRIORITY);
    pTask->start();
    Task::taskCode((void*)pTask,NULL,NULL);

	delete pTask; 
}
```

## src/test_timer.cpp
```c
#include <zephyr/ztest.h>
//#include <vector>
//#include <algorithm>

#define private public
#include "rtos/timer.h"


void timer_cb(k_timer* timer) {
    void* p1 = k_timer_user_data_get(timer);
    printk("Timer expired\n");
}


ZTEST_SUITE(tests_timer, NULL, NULL, NULL, NULL, NULL);

// test constructor and destructor
ZTEST(tests_timer, tests_timer_constructor)
{
    Timer* pTimer = new Timer(timer_cb, NULL, 1, 0);

    pTimer->start();
    printk("Timer start\n");
    pTimer->stop();
    printk("Timer stop\n");

    pTimer->reconfigure(2, 0);
    printk("Timer reconfigure\n");
    pTimer->start();
    printk("Timer start 2\n");

    pTimer->stop();
    printk("Timer stop\n");
    //k_sleep(K_MSEC(2000));

    pTimer->start(1, 0);
    printk("Timer start 1\n");
    pTimer->stop();
    printk("Timer stop\n");

    //k_sleep(K_MSEC(2000));

    pTimer->restart();
    printk("Timer restart 1\n");
    //k_sleep(K_MSEC(2000));
    delete pTimer;
}
```
