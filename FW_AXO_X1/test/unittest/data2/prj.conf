## CMakeLists.txt
```
cmake_minimum_required(VERSION 3.20.0)
find_package(Zephyr REQUIRED HINTS $ENV{ZEPHYR_BASE})
project(data)

#FILE(GLOB app_sources src/*.cpp)
FILE(GLOB app_sources src/test_pdata.cpp
                      src/stubs.cpp
)
target_sources(app PRIVATE ${app_sources}
	../../common/src/data/pdata.cpp
    ../../common/src/rtos/mbox.cpp
    ../../common/src/rtos/task.cpp
    ../../common/src/rtos/timer.cpp
)


zephyr_include_directories(../../include)
zephyr_include_directories(../../common/src)
zephyr_include_directories(../../app-axo-x1/src)

zephyr_compile_options(-Wno-pointer-arith -Wno-unused-variable -Wno-psabi)
```

## prj.conf
```kconfig
CONFIG_ZTEST=y
CONFIG_ZTEST_NEW_API=y

CONFIG_MAIN_STACK_SIZE=8192
#4096

CONFIG_ZTEST_STACK_SIZE=65536
#32768

CONFIG_LOG=y
CONFIG_PRINTK=y
CONFIG_CPLUSPLUS=y
CONFIG_LIB_CPLUSPLUS=y
CONFIG_EXCEPTIONS=n
CONFIG_STD_CPP17=y
CONFIG_NEWLIB_LIBC=y
CONFIG_NEWLIB_LIBC_MIN_REQUIRED_HEAP_SIZE=4096

# disable assert macros
CONFIG_ASSERT=n
CONFIG_ASSERT_TEST=n

# memory usage
CONFIG_MEM_SLAB_TRACE_MAX_UTILIZATION=y 
CONFIG_SYS_HEAP_RUNTIME_STATS=y

CONFIG_HEAP_MEM_POOL_SIZE=16384

CONFIG_CBPRINTF_FP_SUPPORT=y

# CJSON
CONFIG_NEWLIB_LIBC_FLOAT_PRINTF=y
CONFIG_CJSON_LIB=y

CONFIG_NUM_COOP_PRIORITIES=10
CONFIG_NUM_PREEMPT_PRIORITIES=10
CONFIG_SCHED_SCALABLE=y

# Enable thread awareness for debugging tools supporting it
CONFIG_INIT_STACKS=y
CONFIG_THREAD_NAME=y
CONFIG_THREAD_STACK_INFO=y
CONFIG_THREAD_RUNTIME_STATS=y
CONFIG_THREAD_MONITOR=y
CONFIG_DEBUG_THREAD_INFO=y


CONFIG_UNIT_TEST=y
CONFIG_UNIT_TEST_DATA=y
CONFIG_COVERAGE=y
CONFIG_COVERAGE_DUMP=y
```

## src/stubs.cpp
```c
#define private public
#include "rtos/mbox.h"
#include "rtos/mpelem.h"
#include "rtos/mpool.h"
#include "rtos/mqueue.h"
#include "rtos/task.h"

#include "bus/spi/spibus.h"
#include "drv/spi/fram.h"
#include "drv/spi/adxl37x.h"
//#include "conf/config.h"
#include "./version.h"


#include "stubs.h"


// -------------------------------------------------------------------------

bool gbRetVal;

// -------------------------------------------------------------------------
std::allocator<uint8_t> allocBytes;


void Mbox::sendMsg(enum msgType mType, MboxId senderId, MboxId receiverId) {
    PoolElem* e1 = new PoolElem(mType, senderId);
    e1->buf = NULL;
    e1->bufLen = 0;
    Mbox::send(e1, receiverId);
}

void Mbox::sendMsg(enum msgType mType, MboxId senderId, MboxId receiverId,
                   uint8_t u8DataByte) {
    PoolElem* e1 = new PoolElem(mType, senderId);
    e1->p1 = u8DataByte;
    e1->buf = NULL;
    e1->bufLen = 0;
    Mbox::send(e1, receiverId);
}

void Mbox::sendMsg(enum msgType mType, MboxId senderId, MboxId receiverId,
                   int8_t s8DataByte) {
    PoolElem* e1 = new PoolElem(mType, senderId);
    e1->p2 = s8DataByte;
    e1->buf = NULL;
    e1->bufLen = 0;
    Mbox::send(e1, receiverId);
}

void Mbox::sendMsg(enum msgType mType, MboxId senderId, MboxId receiverId,
                        uint8_t* pData, uint16_t dataLen) {
    PoolElem* e1 = new PoolElem(mType, senderId);
        
    uint8_t* b = allocBytes.allocate(2048);
    memcpy(b, pData, dataLen);
    e1->buf = reinterpret_cast<uint8_t (*)[2048]>(b);
    //printk("sendMsg():  e1->buf = 0x%X\n\n", (unsigned int)e1->buf);
    e1->bufLen = dataLen;
    e1->mtype = mType;
    e1->from = senderId;
    Mbox::send(e1, receiverId);
}

void Mbox::sendMsg(enum msgType mType, MboxId senderId, MboxId receiverId,
                   const std::string& str) {
    PoolElem* e1 = new PoolElem(mType, senderId);
    size_t dataLen = str.size() + 1;
    uint8_t* b = allocBytes.allocate(2048);
    auto rc = snprintf(reinterpret_cast<char*>(b), dataLen, "%s", str.c_str());
    int strLen = strlen(reinterpret_cast<const char*>(b));
    dataLen = strLen ? strLen + 1 : 0;
    e1->buf = (uint8_t (*)[2048])(b);
    e1->bufLen = dataLen;
    e1->mtype = mType;
    e1->from = senderId;
    Mbox::send(e1, receiverId);
}

// -------------------------------------------------------------------------

uint8_t* PoolElem::getBuffer(void) { return *buf; }

void PoolElem::putString(const char* s) {
    std::string str = s;
    size_t dataLen = str.size() + 1;
    uint8_t* b = allocBytes.allocate(2048);
    auto rc = snprintf(reinterpret_cast<char*>(b), dataLen, "%s", str.c_str());
    int strLen = strlen(reinterpret_cast<const char*>(b));
    dataLen = strLen ? strLen + 1 : 0;
    this->buf = (uint8_t (*)[2048])(b);
    this->bufLen = dataLen;
}

void PoolElem::putData(const void* pdata, size_t len) {
    uint8_t* b = allocBytes.allocate(2048);
    memcpy(b, pdata, len);
    this->buf = reinterpret_cast<uint8_t (*)[2048]>(b);
    this->bufLen = len;
}

void PoolElem::Dump() { }

void PoolElem::free() {
    uint8_t* b = reinterpret_cast<uint8_t*>(this->buf);
    /*printk("free():  this->buf = 0x%X\n\n", (unsigned int)this->buf);
    printk("free():  0x%.2X%.2X%.2X%.2X\n\n", (*(uint8_t*)this->buf[0]), 
                                      (*(uint8_t*)this->buf[1]),
                                      (*(uint8_t*)this->buf[2]), 
                                      (*(uint8_t*)this->buf[3]));*/
    if (this->buf != NULL) {
        allocBytes.deallocate(reinterpret_cast<uint8_t*>(this->buf), 2048);
        this->buf = NULL;
        this->bufLen = 0;
    }
    delete this;
}

// -------------------------------------------------------------------------

//void* k_timer_user_data_get(k_timer* timer) {
//    return reinterpret_cast<void*>(timer);
//}
void* my_k_timer_user_data_get(k_timer* timer) {
    return reinterpret_cast<void*>(timer);
}


// -------------------------------------------------------------------

spibus::spibus() { }
spibus::~spibus() { }

spibus* spibus::inst() {
    static spibus myInstance;
    return &myInstance;
}

void spibus::init() { }

// -------------------------------------------------------------------------

spifram::spifram() : dpd_active(false) { }
spifram::~spifram() { }

spifram* spifram::inst() {
    static spifram myInstance;
    return &myInstance;
}

void spifram::init() { }

int spifram::wakeup() { return 0; }

int spifram::sleep() { return 0; }

int spifram::writeBytes(uint32_t addr, uint8_t* data, uint32_t num_bytes) { return 0; }

int spifram::readBytes(uint32_t addr, uint8_t* data, uint32_t num_bytes) {
    for (uint32_t i=0; i<num_bytes; i++) {
        data[i] = i;
    }
    return 0;
}

// -------------------------------------------------------------------------

void Adxl37x::convert(struct sensor_value* val, int16_t value) {
    int32_t micro_ms2 = value * (SENSOR_G / (16 * 1000 / 100));
    val->val1 = micro_ms2 / 1000000;
    val->val2 = micro_ms2 % 1000000;
}

// -------------------------------------------------------------------------

Config* Config::inst() {
    static Config myInstance;
    return &myInstance;
}

Config::Config() { }

Config::~Config() { }

stCfgGeneral* Config::getCfgGeneral() { 
    // 	std::string name;    //!< Name of the device class
	// std::string type;    //!< Type of the device
	// std::string version; //!< Version of the configuration 
    static stCfgGeneral ret = {"a","a","a"};
    return &ret;
}

stCfgMetrics* Config::getCfgMetrics() { 
    // std::string interval;
    static stCfgMetrics ret = {"a"};
    return &ret;
}

stCfgDatalog* Config::getCfgDatalog() {
    // std::string dispmodeoff; 
    // std::string rawtransferon; 
    // std::string disptransferon;  
    // std::string rms_thres;   
    // std::string max_raw_per_day;
    static stCfgDatalog ret_true = {"true","true","true","25","5"};
    static stCfgDatalog ret_false = {"false","false","false","25","5"};
    if (gbRetVal) {
        return &ret_true;
    } else {
        return &ret_false;
    }
}

stCfgDisplacement* Config::getCfgDisplacement() { 
    // std::string b1;
    static stCfgDisplacement ret = {"0.0"};
    return &ret;
}

stCfgSensor*  Config::getCfgSensor(enCfgSensorId id) { 
    // std::string name;       //!< Name of the sensor
	// std::string type;       //!< Type of the sensor
	// std::string actthres;   //!< Activation threshold
	// std::string deactthres; //!< Deactivation threshold
    static stCfgSensor ret = {"a","a","a","a"};
    return &ret;
}

// -------------------------------------------------------------------------

const char* getFwVersion() { return "9.77"; }

// -------------------------------------------------------------------------

FlashFS::FlashFS(const char* name) { }

FlashFS& FlashFS::inst() {
    static FlashFS myInstance("fs");
    return myInstance;
}

FlashFS::~FlashFS() { }

bool FlashFS::file_exists(const char* path) {
    return gbRetVal;
}

// ---------------------------------------------------------------------------

MetricsBuilder::MetricsBuilder() {  payload = "{12345}"; }
MetricsBuilder::~MetricsBuilder() {  }
bool MetricsBuilder::isComplete() { 
    if (gbRetVal) {
        return true;
    } else {
        return false;
    }
}
void MetricsBuilder::add(PoolElem* pElem) { }
void MetricsBuilder::finalize() { }
void MetricsBuilder::reset() { }
void MetricsBuilder::print() { }
std::string& MetricsBuilder::getPayload() { return payload; }
void MetricsBuilder::setConfigVersion(std::string& s) {
    tmp = s;
}
void MetricsBuilder::setActivationThres(std::string& s) {
    tmp = s;
}
void MetricsBuilder::setDeactivationThres(std::string& s) {
    tmp = s;
}
void MetricsBuilder::setDispModeOffFlag(std::string& s) {
    tmp = s;
}
void MetricsBuilder::setRawTransferOnFlag(std::string& s) {
    tmp = s;
}
void MetricsBuilder::setDispTransferOnFlag(std::string& s) {
    tmp = s;
}
void MetricsBuilder::setPublicKey(std::string& s) {
    pubkey = s;
}
void MetricsBuilder::setMetricsInterval(std::string& s) {
    tmp = s;
}
void MetricsBuilder::set_Z_RmsThres(std::string& s) {
    tmp = s;
}
void MetricsBuilder::set_max_raw_per_day(std::string& s) {
    max_raw_per_day = s;
}



MeasurementBuilder::MeasurementBuilder(bool have_http_connector)
    : have_http_connector(have_http_connector) { payload = "{12345}";}
MeasurementBuilder::~MeasurementBuilder() { }
bool MeasurementBuilder::isComplete(bool disp_mode_off, double rmsZThres) { 
    if (gbRetVal) {
        return true;
    } else {
        return false;
    }
}
void MeasurementBuilder::add(PoolElem* pElem) { }
void MeasurementBuilder::finalize() { }
void MeasurementBuilder::reset() { }
std::string& MeasurementBuilder::getPayload() { return payload; }

KeyGen* KeyGen::inst() {
    static KeyGen myInstance;
    return &myInstance;
}

KeyGen::KeyGen() { }
KeyGen::~KeyGen() { }
uint16_t KeyGen::getPublicKey(unsigned char* pBuf, size_t len) {
    int readLen = 31;
    char key[32] = "000##LF##12345\n67890##LF##";
    strncpy((char*)pBuf, key, 32); 
    return readLen;
}
```

## src/stubs.h
```c
#ifndef __STUBS_H__
#define __STUBS_H__


#include <string>
#include "rtos/mbox.h"
#include "rtos/mpelem.h"
#include "rtos/mpool.h"

extern bool gbRetVal;

#define k_timer_user_data_get(x) my_k_timer_user_data_get(x)

void* my_k_timer_user_data_get(k_timer* timer);


#define FRAM_5_SEC_RAW_DATA_SPACE     5
#define FRAM_15_SEC_RAW_DATA_SPACE   15

typedef enum _enCfgSensorId {
	eSensor_adxl372, //!< Acceleration sensor ADXL372
	eSensor_MAX      //!< Number of sensors mentioned in dynamic configuration
} enCfgSensorId;

typedef struct _stCfgGeneral {
	std::string name;    //!< Name of the device class
	std::string type;    //!< Type of the device
	std::string version; //!< Version of the configuration
} stCfgGeneral;

typedef struct _stCfgSensor {
	std::string name;       //!< Name of the sensor
	std::string type;       //!< Type of the sensor
	std::string actthres;   //!< Activation threshold
	std::string deactthres; //!< Deactivation threshold
} stCfgSensor;

typedef struct _stCfgMetrics {
	std::string interval;  //!< Metrics transmission interval
} stCfgMetrics;

typedef struct _stCfgDisplacement {
	std::string b1;  //!< Beautification factor 1
} stCfgDisplacement;

typedef struct _stCfgDatalog {	
   std::string dispmodeoff; 
   std::string rawtransferon; 
   std::string disptransferon;  
   std::string rms_thres;   
   std::string max_raw_per_day; 
} stCfgDatalog;



class Config {
 public:
    static Config* inst();
    void init();
    virtual ~Config();

    stCfgGeneral* getCfgGeneral();
    stCfgMetrics* getCfgMetrics();
    stCfgDatalog* getCfgDatalog();
    stCfgDisplacement* getCfgDisplacement();
    stCfgSensor*  getCfgSensor(enCfgSensorId id);

    //unsigned char* getConfigJson();
 private:
    Config();

};


const char* getFwVersion();

class FlashFS {
 public:
    explicit FlashFS(const char* name = "??");

    static FlashFS& inst();
    FlashFS() = delete;
    virtual ~FlashFS();
    bool file_exists(const char* path);
};

class MetricsBuilder {
 public:
    MetricsBuilder();
    ~MetricsBuilder();

    std::string payload;
    std::string tmp;
    std::string pubkey; 
    std::string max_raw_per_day; 

    void add(PoolElem* pElem);
    void setConfigVersion(std::string& s);
    void setActivationThres(std::string& s);
    void setDeactivationThres(std::string& s);
    void setDispModeOffFlag(std::string& s);
    void setRawTransferOnFlag(std::string& s);
    void setDispTransferOnFlag(std::string& s);
    void setPublicKey(std::string& s);
    void setMetricsInterval(std::string& s);
    void set_Z_RmsThres(std::string& s);
    void set_max_raw_per_day(std::string& s);

    int scaleBattIn(int32_t ad_in);  // consider voltage divider at A/D in

    void finalize(void);
    void reset();

    bool isComplete();
    void print(void);
    std::string& getPayload(void);   
};

class MeasurementBuilder {
 public:
    explicit MeasurementBuilder(bool have_http_connector = true);
    ~MeasurementBuilder();

    bool have_http_connector; 

    std::string payload;

    void add(PoolElem* pElem);

    void finalize(void);
    void reset();

    bool isComplete(bool disp_mode_off, double rmsZThres);
    std::string& getPayload(void);
};

class KeyGen {
 public:
    ~KeyGen();

    static KeyGen* inst();

    uint16_t getPublicKey(unsigned char* pBuf, size_t len);
    std::string getPrivateKey();
    
 private:
    KeyGen();
};


//void* k_timer_user_data_get(k_timer* timer);

#endif // __STUBS_H__
```
